VERSION ""

NS_ :

BS_:

BU_: DashBoard Wheel Motor TurnSignal BrakeLights BrakeActuator ThrottleActuator Speed_Control_ECU

BO_ 2147483729 BrakeCommandMessage: 8 Vector__XXX
 SG_ BrakeCommand : 0|64@1- (1,0) [0|1] "" Vector__XXX

BO_ 2147484672 SpeedCommandMessage: 8 DashBoard
 SG_ SpeedCommand : 0|64@1- (1,0) [0|100] "mph"  Speed_Control_ECU

BO_ 2147483904 SpeedMessage: 8 Wheel
 SG_ Speed : 0|64@1- (1,0) [0|100] "mph" Vector__XXX

BO_ 2147485696 RPMMessage: 8 Motor
 SG_ RPM : 0|64@1- (1,0) [0|10000] ""  DashBoard

BO_ 2147485184 TurnSignalStatusMessage: 1 DashBoard
 SG_ TurnSignalStatus : 0|3@1+ (1,0) [1|3] ""  TurnSignal

BO_ 2147484928 BrakeStatusMessage: 1 BrakeActuator
 SG_ BrakeStatus : 0|1@1+ (1,0) [0|1] ""  BrakeLights

BO_ 2147483744 ThrottleCommandMessage: 8 Speed_Control_ECU
 SG_ ThrottleCommand : 0|64@1- (1,0) [0|1] ""  ThrottleActuator

BA_DEF_ SG_  "GenSigSendType" ENUM  "Cyclic","NoSigSendType";
BA_DEF_ BO_  "GenMsgSendType" ENUM  "cyclic","noMsgSendType";
BA_DEF_ BO_  "GenMsgCycleTime" INT 0 3600000;
BA_DEF_  "BusType" STRING ;
BA_DEF_DEF_  "GenSigSendType" "NoSigSendType";
BA_DEF_DEF_  "GenMsgSendType" "noMsgSendType";
BA_DEF_DEF_  "GenMsgCycleTime" 0;
BA_DEF_DEF_  "BusType" "CAN";
BA_ "GenMsgCycleTime" BO_ 2147484672 50;
BA_ "GenMsgSendType" BO_ 2147484672 0;
BA_ "GenMsgCycleTime" BO_ 2147483904 10;
BA_ "GenMsgSendType" BO_ 2147483904 0;
BA_ "GenMsgCycleTime" BO_ 2147485696 10;
BA_ "GenMsgSendType" BO_ 2147485696 0;
BA_ "GenMsgCycleTime" BO_ 2147485184 20;
BA_ "GenMsgSendType" BO_ 2147485184 0;
BA_ "GenMsgCycleTime" BO_ 2147484928 10;
BA_ "GenMsgSendType" BO_ 2147484928 0;
BA_ "GenMsgCycleTime" BO_ 2147483744 50;
BA_ "GenMsgSendType" BO_ 2147483744 0;
SIG_VALTYPE_ 2147483729 BrakeCommand : 2;
SIG_VALTYPE_ 2147484672 SpeedCommand : 2;
SIG_VALTYPE_ 2147483904 Speed : 2;
SIG_VALTYPE_ 2147485696 RPM : 2;
SIG_VALTYPE_ 2147483744 ThrottleCommand : 2;
