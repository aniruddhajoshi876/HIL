/******************************************************************************
* ASAP2 file: inverter_hil.a2l
* Academic License - for use in teaching, academic research, and meeting
* course requirements at degree granting institutions only. Not for
* government, commercial, or other organizational use.
* Code generation for model "inverter_hil".
* Model version : 1.6
* Simulink Coder version : 24.2 (R2024b) 21-Jun-2024
* C source code generated on : Fri Aug 14 15:31:57 2026
* Target selection: speedgoat.tlc
* Embedded hardware selection: Intel->x86-64 (Linux 64)
* Code generation objectives: Unspecified
* Validation result: Not run
* (add additional file header information here)
******************************************************************************/ ASAP2_VERSION 1 71
/* Version 1.71 */
/begin PROJECT ProjectName "Project Comment Goes Here"
/begin HEADER "Header Comments go here" /end HEADER
/begin MODULE ModuleName "Module Comment Goes Here"
/begin IF_DATA XCP
 /begin PROTOCOL_LAYER 0x0100 0x03E8 0x00C8 0x0000 0x0000 0x0000 0x0000 0x0000 0xFF 0x0578 BYTE_ORDER_MSB_LAST ADDRESS_GRANULARITY_BYTE OPTIONAL_CMD ALLOC_ODT_ENTRY OPTIONAL_CMD ALLOC_ODT OPTIONAL_CMD ALLOC_DAQ OPTIONAL_CMD FREE_DAQ OPTIONAL_CMD GET_DAQ_CLOCK OPTIONAL_CMD GET_DAQ_RESOLUTION_INFO OPTIONAL_CMD GET_DAQ_PROCESSOR_INFO OPTIONAL_CMD START_STOP_SYNCH OPTIONAL_CMD START_STOP_DAQ_LIST OPTIONAL_CMD SET_DAQ_LIST_MODE OPTIONAL_CMD WRITE_DAQ OPTIONAL_CMD SET_DAQ_PTR OPTIONAL_CMD GET_CAL_PAGE OPTIONAL_CMD SET_CAL_PAGE OPTIONAL_CMD COPY_CAL_PAGE OPTIONAL_CMD SHORT_DOWNLOAD OPTIONAL_CMD DOWNLOAD_MAX OPTIONAL_CMD DOWNLOAD OPTIONAL_CMD SHORT_UPLOAD OPTIONAL_CMD UPLOAD OPTIONAL_CMD SET_MTA OPTIONAL_CMD GET_SEGMENT_INFO OPTIONAL_CMD GET_PAGE_INFO OPTIONAL_CMD SET_SEGMENT_MODE OPTIONAL_CMD GET_SEGMENT_MODE OPTIONAL_CMD GET_PAG_PROCESSOR_INFO OPTIONAL_CMD MODIFY_BITS /end PROTOCOL_LAYER
 /begin DAQ DYNAMIC 0x0000 0x0080 0x00 OPTIMISATION_TYPE_DEFAULT ADDRESS_EXTENSION_FREE IDENTIFICATION_FIELD_TYPE_RELATIVE_WORD_ALIGNED GRANULARITY_ODT_ENTRY_SIZE_DAQ_BYTE 0xFF OVERLOAD_INDICATION_PID PRESCALER_SUPPORTED /begin STIM GRANULARITY_ODT_ENTRY_SIZE_STIM_BYTE 0xFF /end STIM /begin TIMESTAMP_SUPPORTED 0x0001 SIZE_DWORD UNIT_1US TIMESTAMP_FIXED /end TIMESTAMP_SUPPORTED /begin EVENT "1 ms" "1 ms" 0x0000 DAQ_STIM 0xFF 0x01 0x06 0x00 /end EVENT /begin EVENT "5 ms" "5 ms" 0x0001 DAQ_STIM 0xFF 0x05 0x06 0x00 /end EVENT /end DAQ
 /begin XCP_ON_UDP_IP 0x0100 0x15B3 ADDRESS "10.10.10.5" /end XCP_ON_UDP_IP
/end IF_DATA
/begin MOD_PAR "MOD PAR Comment Goes Here"
 /begin MEMORY_SEGMENT RTE_Param_Service "RTE_Param_Service" DATA FLASH INTERN 0x002AA400 0xA8 -1 -1 -1 -1 -1
  /begin IF_DATA XCP
   /begin SEGMENT 0x00 0x02 0x00 0x00 0x00
    /begin PAGE 0x00 ECU_ACCESS_DONT_CARE XCP_READ_ACCESS_DONT_CARE XCP_WRITE_ACCESS_NOT_ALLOWED /end PAGE
    /begin PAGE 0x01 ECU_ACCESS_DONT_CARE XCP_READ_ACCESS_DONT_CARE XCP_WRITE_ACCESS_DONT_CARE /end PAGE
   /end SEGMENT
  /end IF_DATA
 /end MEMORY_SEGMENT
 /begin MEMORY_SEGMENT inverter_hil_cal_impl "inverter_hil_cal_impl" DATA FLASH INTERN 0x002A9100 0x12F0 -1 -1 -1 -1 -1
  /begin IF_DATA XCP
   /begin SEGMENT 0x01 0x02 0x00 0x00 0x00
    /begin PAGE 0x00 ECU_ACCESS_DONT_CARE XCP_READ_ACCESS_DONT_CARE XCP_WRITE_ACCESS_NOT_ALLOWED /end PAGE
    /begin PAGE 0x01 ECU_ACCESS_DONT_CARE XCP_READ_ACCESS_DONT_CARE XCP_WRITE_ACCESS_DONT_CARE /end PAGE
   /end SEGMENT
  /end IF_DATA
 /end MEMORY_SEGMENT
/end MOD_PAR
/begin MOD_COMMON "Mod Common Comment Here" BYTE_ORDER MSB_LAST ALIGNMENT_BYTE 1 ALIGNMENT_WORD 2 ALIGNMENT_LONG 4 ALIGNMENT_FLOAT32_IEEE 4 ALIGNMENT_FLOAT64_IEEE 8 ALIGNMENT_INT64 8 /end MOD_COMMON
/begin CHARACTERISTIC RTE_Param_Service.hil_cal_pedals_pressed_v1 "" VALUE 0x002AA400 Record_FLOAT64_IEEE 0 inverter_hil_CM_double 0.000000 5.000000 /end CHARACTERISTIC
/begin CHARACTERISTIC RTE_Param_Service.hil_cal_pedals_pressed_v2 "" VALUE 0x002AA408 Record_FLOAT64_IEEE 0 inverter_hil_CM_double 0.000000 5.000000 /end CHARACTERISTIC
/begin CHARACTERISTIC RTE_Param_Service.hil_cal_pedals_pressed_v3 "" VALUE 0x002AA410 Record_FLOAT64_IEEE 0 inverter_hil_CM_double 0.000000 5.000000 /end CHARACTERISTIC
/begin CHARACTERISTIC RTE_Param_Service.hil_cal_pedals_pressed_v4 "" VALUE 0x002AA418 Record_FLOAT64_IEEE 0 inverter_hil_CM_double 0.000000 5.000000 /end CHARACTERISTIC
/begin CHARACTERISTIC RTE_Param_Service.hil_cal_pedals_released_v1 "" VALUE 0x002AA420 Record_FLOAT64_IEEE 0 inverter_hil_CM_double 0.000000 5.000000 /end CHARACTERISTIC
/begin CHARACTERISTIC RTE_Param_Service.hil_cal_pedals_released_v2 "" VALUE 0x002AA428 Record_FLOAT64_IEEE 0 inverter_hil_CM_double 0.000000 5.000000 /end CHARACTERISTIC
/begin CHARACTERISTIC RTE_Param_Service.hil_cal_pedals_released_v3 "" VALUE 0x002AA430 Record_FLOAT64_IEEE 0 inverter_hil_CM_double 0.000000 5.000000 /end CHARACTERISTIC
/begin CHARACTERISTIC RTE_Param_Service.hil_cal_pedals_released_v4 "" VALUE 0x002AA438 Record_FLOAT64_IEEE 0 inverter_hil_CM_double 0.000000 5.000000 /end CHARACTERISTIC
/begin CHARACTERISTIC RTE_Param_Service.hil_cmd_can_drop_control_mask "" VALUE 0x002AA4A6 Record_UBYTE 0 inverter_hil_CM_uint8 0.000000 255.000000 /end CHARACTERISTIC
/begin CHARACTERISTIC RTE_Param_Service.hil_cmd_can_drop_status_mask "" VALUE 0x002AA49C Record_UWORD 0 inverter_hil_CM_uint16 0.000000 65535.000000 /end CHARACTERISTIC
/begin CHARACTERISTIC RTE_Param_Service.hil_cmd_dc_link12_v "" VALUE 0x002AA440 Record_FLOAT64_IEEE 0 inverter_hil_CM_double 0.000000 1023.984375 /end CHARACTERISTIC
/begin CHARACTERISTIC RTE_Param_Service.hil_cmd_dc_link34_v "" VALUE 0x002AA448 Record_FLOAT64_IEEE 0 inverter_hil_CM_double 0.000000 1023.984375 /end CHARACTERISTIC
/begin CHARACTERISTIC RTE_Param_Service.hil_cmd_digital_cooling_switch "" VALUE 0x002AA49E Record_BOOLEAN 0 inverter_hil_CM_boolean 0.000000 1.000000 /end CHARACTERISTIC
/begin CHARACTERISTIC RTE_Param_Service.hil_cmd_digital_main_button "" VALUE 0x002AA49F Record_BOOLEAN 0 inverter_hil_CM_boolean 0.000000 1.000000 /end CHARACTERISTIC
/begin CHARACTERISTIC RTE_Param_Service.hil_cmd_digital_main_button_sequence "" VALUE 0x002AA480 Record_ULONG 0 inverter_hil_CM_uint32 0.000000 4294967295.000000 /end CHARACTERISTIC
/begin CHARACTERISTIC RTE_Param_Service.hil_cmd_digital_precharge_sequence "" VALUE 0x002AA484 Record_ULONG 0 inverter_hil_CM_uint32 0.000000 4294967295.000000 /end CHARACTERISTIC
/begin CHARACTERISTIC RTE_Param_Service.hil_cmd_digital_shutdown_feedback "" VALUE 0x002AA4A0 Record_BOOLEAN 0 inverter_hil_CM_boolean 0.000000 1.000000 /end CHARACTERISTIC
/begin CHARACTERISTIC RTE_Param_Service.hil_cmd_gui_heartbeat "" VALUE 0x002AA488 Record_ULONG 0 inverter_hil_CM_uint32 0.000000 4294967295.000000 /end CHARACTERISTIC
/begin CHARACTERISTIC RTE_Param_Service.hil_cmd_inverter1_connected "" VALUE 0x002AA4A1 Record_BOOLEAN 0 inverter_hil_CM_boolean 0.000000 1.000000 /end CHARACTERISTIC
/begin CHARACTERISTIC RTE_Param_Service.hil_cmd_inverter1_fault_mask "" VALUE 0x002AA48C Record_ULONG 0 inverter_hil_CM_uint32 0.000000 4294967295.000000 /end CHARACTERISTIC
/begin CHARACTERISTIC RTE_Param_Service.hil_cmd_inverter1_load_nm "" VALUE 0x002AA450 Record_FLOAT64_IEEE 0 inverter_hil_CM_double -200.000000 200.000000 /end CHARACTERISTIC
/begin CHARACTERISTIC RTE_Param_Service.hil_cmd_inverter2_connected "" VALUE 0x002AA4A2 Record_BOOLEAN 0 inverter_hil_CM_boolean 0.000000 1.000000 /end CHARACTERISTIC
/begin CHARACTERISTIC RTE_Param_Service.hil_cmd_inverter2_fault_mask "" VALUE 0x002AA490 Record_ULONG 0 inverter_hil_CM_uint32 0.000000 4294967295.000000 /end CHARACTERISTIC
/begin CHARACTERISTIC RTE_Param_Service.hil_cmd_inverter2_load_nm "" VALUE 0x002AA458 Record_FLOAT64_IEEE 0 inverter_hil_CM_double -200.000000 200.000000 /end CHARACTERISTIC
/begin CHARACTERISTIC RTE_Param_Service.hil_cmd_inverter3_connected "" VALUE 0x002AA4A3 Record_BOOLEAN 0 inverter_hil_CM_boolean 0.000000 1.000000 /end CHARACTERISTIC
/begin CHARACTERISTIC RTE_Param_Service.hil_cmd_inverter3_fault_mask "" VALUE 0x002AA494 Record_ULONG 0 inverter_hil_CM_uint32 0.000000 4294967295.000000 /end CHARACTERISTIC
/begin CHARACTERISTIC RTE_Param_Service.hil_cmd_inverter3_load_nm "" VALUE 0x002AA460 Record_FLOAT64_IEEE 0 inverter_hil_CM_double -200.000000 200.000000 /end CHARACTERISTIC
/begin CHARACTERISTIC RTE_Param_Service.hil_cmd_inverter4_connected "" VALUE 0x002AA4A4 Record_BOOLEAN 0 inverter_hil_CM_boolean 0.000000 1.000000 /end CHARACTERISTIC
/begin CHARACTERISTIC RTE_Param_Service.hil_cmd_inverter4_fault_mask "" VALUE 0x002AA498 Record_ULONG 0 inverter_hil_CM_uint32 0.000000 4294967295.000000 /end CHARACTERISTIC
/begin CHARACTERISTIC RTE_Param_Service.hil_cmd_inverter4_load_nm "" VALUE 0x002AA468 Record_FLOAT64_IEEE 0 inverter_hil_CM_double -200.000000 200.000000 /end CHARACTERISTIC
/begin CHARACTERISTIC RTE_Param_Service.hil_cmd_pedals_brake "" VALUE 0x002AA470 Record_FLOAT64_IEEE 0 inverter_hil_CM_double 0.000000 1.000000 /end CHARACTERISTIC
/begin CHARACTERISTIC RTE_Param_Service.hil_cmd_pedals_plausibility_override "" VALUE 0x002AA4A5 Record_BOOLEAN 0 inverter_hil_CM_boolean 0.000000 1.000000 /end CHARACTERISTIC
/begin CHARACTERISTIC RTE_Param_Service.hil_cmd_pedals_throttle "" VALUE 0x002AA478 Record_FLOAT64_IEEE 0 inverter_hil_CM_double 0.000000 1.000000 /end CHARACTERISTIC
/begin CHARACTERISTIC inverter_hil_cal_impl.CANWrite0x383_P1 "" VAL_BLK 0x002A9FD0 Record_FLOAT64_IEEE 0 inverter_hil_CM_double -1.7E+308 1.7E+308 MATRIX_DIM 10 1 /end CHARACTERISTIC
/begin CHARACTERISTIC inverter_hil_cal_impl.CANWrite0x385_P1 "" VAL_BLK 0x002AA030 Record_FLOAT64_IEEE 0 inverter_hil_CM_double -1.7E+308 1.7E+308 MATRIX_DIM 10 1 /end CHARACTERISTIC
/begin CHARACTERISTIC inverter_hil_cal_impl.CANWrite0x393_P1 "" VAL_BLK 0x002AA090 Record_FLOAT64_IEEE 0 inverter_hil_CM_double -1.7E+308 1.7E+308 MATRIX_DIM 10 1 /end CHARACTERISTIC
/begin CHARACTERISTIC inverter_hil_cal_impl.CANWrite0x395_P1 "" VAL_BLK 0x002AA0F0 Record_FLOAT64_IEEE 0 inverter_hil_CM_double -1.7E+308 1.7E+308 MATRIX_DIM 10 1 /end CHARACTERISTIC
/begin CHARACTERISTIC inverter_hil_cal_impl.CANWrite0x3A3_P1 "" VAL_BLK 0x002AA150 Record_FLOAT64_IEEE 0 inverter_hil_CM_double -1.7E+308 1.7E+308 MATRIX_DIM 10 1 /end CHARACTERISTIC
/begin CHARACTERISTIC inverter_hil_cal_impl.CANWrite0x3A5_P1 "" VAL_BLK 0x002AA1B0 Record_FLOAT64_IEEE 0 inverter_hil_CM_double -1.7E+308 1.7E+308 MATRIX_DIM 10 1 /end CHARACTERISTIC
/begin CHARACTERISTIC inverter_hil_cal_impl.CANWrite0x3B3_P1 "" VAL_BLK 0x002AA210 Record_FLOAT64_IEEE 0 inverter_hil_CM_double -1.7E+308 1.7E+308 MATRIX_DIM 10 1 /end CHARACTERISTIC
/begin CHARACTERISTIC inverter_hil_cal_impl.CANWrite0x3B5_P1 "" VAL_BLK 0x002AA270 Record_FLOAT64_IEEE 0 inverter_hil_CM_double -1.7E+308 1.7E+308 MATRIX_DIM 10 1 /end CHARACTERISTIC
/begin CHARACTERISTIC inverter_hil_cal_impl.CANWrite0x400_P1 "" VAL_BLK 0x002AA2D0 Record_FLOAT64_IEEE 0 inverter_hil_CM_double -1.7E+308 1.7E+308 MATRIX_DIM 10 1 /end CHARACTERISTIC
/begin CHARACTERISTIC inverter_hil_cal_impl.DropStatusMaskRT_InitialConditi "" VALUE 0x002AA350 Record_UWORD 0 inverter_hil_CM_uint16 0 65535 /end CHARACTERISTIC
/begin CHARACTERISTIC inverter_hil_cal_impl.EphorusRXObservationRT_InitialC "" VALUE 0x002A9D38 Record_FLOAT64_IEEE 0 inverter_hil_CM_double -1.7E+308 1.7E+308 /end CHARACTERISTIC
/begin CHARACTERISTIC inverter_hil_cal_impl.GuiCmdDcLink12VRT_InitialCondit "" VALUE 0x002A9D40 Record_FLOAT64_IEEE 0 inverter_hil_CM_double -1.7E+308 1.7E+308 /end CHARACTERISTIC
/begin CHARACTERISTIC inverter_hil_cal_impl.GuiCmdDcLink34VRT_InitialCondit "" VALUE 0x002A9D48 Record_FLOAT64_IEEE 0 inverter_hil_CM_double -1.7E+308 1.7E+308 /end CHARACTERISTIC
/begin CHARACTERISTIC inverter_hil_cal_impl.GuiCmdInverter1ConnectedRT_Init "" VALUE 0x002AA352 Record_BOOLEAN 0 inverter_hil_CM_boolean 0 1 /end CHARACTERISTIC
/begin CHARACTERISTIC inverter_hil_cal_impl.GuiCmdInverter1LoadNmRT_Initial "" VALUE 0x002A9D50 Record_FLOAT64_IEEE 0 inverter_hil_CM_double -1.7E+308 1.7E+308 /end CHARACTERISTIC
/begin CHARACTERISTIC inverter_hil_cal_impl.GuiCmdInverter2ConnectedRT_Init "" VALUE 0x002AA353 Record_BOOLEAN 0 inverter_hil_CM_boolean 0 1 /end CHARACTERISTIC
/begin CHARACTERISTIC inverter_hil_cal_impl.GuiCmdInverter2LoadNmRT_Initial "" VALUE 0x002A9D58 Record_FLOAT64_IEEE 0 inverter_hil_CM_double -1.7E+308 1.7E+308 /end CHARACTERISTIC
/begin CHARACTERISTIC inverter_hil_cal_impl.GuiCmdInverter3ConnectedRT_Init "" VALUE 0x002AA354 Record_BOOLEAN 0 inverter_hil_CM_boolean 0 1 /end CHARACTERISTIC
/begin CHARACTERISTIC inverter_hil_cal_impl.GuiCmdInverter3LoadNmRT_Initial "" VALUE 0x002A9D60 Record_FLOAT64_IEEE 0 inverter_hil_CM_double -1.7E+308 1.7E+308 /end CHARACTERISTIC
/begin CHARACTERISTIC inverter_hil_cal_impl.GuiCmdInverter4ConnectedRT_Init "" VALUE 0x002AA355 Record_BOOLEAN 0 inverter_hil_CM_boolean 0 1 /end CHARACTERISTIC
/begin CHARACTERISTIC inverter_hil_cal_impl.GuiCmdInverter4LoadNmRT_Initial "" VALUE 0x002A9D68 Record_FLOAT64_IEEE 0 inverter_hil_CM_double -1.7E+308 1.7E+308 /end CHARACTERISTIC
/begin CHARACTERISTIC inverter_hil_cal_impl.IO183AI01AI04RailMonitor_P1 "" VALUE 0x002A9380 Record_FLOAT64_IEEE 0 inverter_hil_CM_double -1.7E+308 1.7E+308 /end CHARACTERISTIC
/begin CHARACTERISTIC inverter_hil_cal_impl.IO183AI01AI04RailMonitor_P2 "" VALUE 0x002A9398 Record_FLOAT64_IEEE 0 inverter_hil_CM_double -1.7E+308 1.7E+308 /end CHARACTERISTIC
/begin CHARACTERISTIC inverter_hil_cal_impl.IO183AI01AI04RailMonitor_P3 "" VALUE 0x002A93B0 Record_FLOAT64_IEEE 0 inverter_hil_CM_double -1.7E+308 1.7E+308 /end CHARACTERISTIC
/begin CHARACTERISTIC inverter_hil_cal_impl.IO183AI01AI04RailMonitor_P4 "" VALUE 0x002A93C8 Record_FLOAT64_IEEE 0 inverter_hil_CM_double -1.7E+308 1.7E+308 /end CHARACTERISTIC
/begin CHARACTERISTIC inverter_hil_cal_impl.IO183AI01AI04RailMonitor_P5 "" VALUE 0x002A93E0 Record_FLOAT64_IEEE 0 inverter_hil_CM_double -1.7E+308 1.7E+308 /end CHARACTERISTIC
/begin CHARACTERISTIC inverter_hil_cal_impl.IO183AO01AO04SafeZero_P1 "" VALUE 0x002A9800 Record_FLOAT64_IEEE 0 inverter_hil_CM_double -1.7E+308 1.7E+308 /end CHARACTERISTIC
/begin CHARACTERISTIC inverter_hil_cal_impl.IO183AO01AO04SafeZero_P2 "" VALUE 0x002A9818 Record_FLOAT64_IEEE 0 inverter_hil_CM_double -1.7E+308 1.7E+308 /end CHARACTERISTIC
/begin CHARACTERISTIC inverter_hil_cal_impl.IO183AO01AO04SafeZero_P3 "" VALUE 0x002A9830 Record_FLOAT64_IEEE 0 inverter_hil_CM_double -1.7E+308 1.7E+308 /end CHARACTERISTIC
/begin CHARACTERISTIC inverter_hil_cal_impl.IO183AO01AO04SafeZero_P4 "" VAL_BLK 0x002A9848 Record_FLOAT64_IEEE 0 inverter_hil_CM_double -1.7E+308 1.7E+308 MATRIX_DIM 4 1 /end CHARACTERISTIC
/begin CHARACTERISTIC inverter_hil_cal_impl.IO183AO01AO04SafeZero_P5 "" VAL_BLK 0x002A9878 Record_FLOAT64_IEEE 0 inverter_hil_CM_double -1.7E+308 1.7E+308 MATRIX_DIM 4 1 /end CHARACTERISTIC
/begin CHARACTERISTIC inverter_hil_cal_impl.IO183AO01AO04SafeZero_P6 "" VAL_BLK 0x002A98A8 Record_FLOAT64_IEEE 0 inverter_hil_CM_double -1.7E+308 1.7E+308 MATRIX_DIM 4 1 /end CHARACTERISTIC
/begin CHARACTERISTIC inverter_hil_cal_impl.IO183AO01AO04SafeZero_P7 "" VALUE 0x002A98D8 Record_FLOAT64_IEEE 0 inverter_hil_CM_double -1.7E+308 1.7E+308 /end CHARACTERISTIC
/begin CHARACTERISTIC inverter_hil_cal_impl.IO183DIO01DIO08SafeZero_P1 "" VALUE 0x002A9910 Record_FLOAT64_IEEE 0 inverter_hil_CM_double -1.7E+308 1.7E+308 /end CHARACTERISTIC
/begin CHARACTERISTIC inverter_hil_cal_impl.IO183DIO01DIO08SafeZero_P2 "" VALUE 0x002A9928 Record_FLOAT64_IEEE 0 inverter_hil_CM_double -1.7E+308 1.7E+308 /end CHARACTERISTIC
/begin CHARACTERISTIC inverter_hil_cal_impl.IO183DIO01DIO08SafeZero_P3 "" VALUE 0x002A9940 Record_FLOAT64_IEEE 0 inverter_hil_CM_double -1.7E+308 1.7E+308 /end CHARACTERISTIC
/begin CHARACTERISTIC inverter_hil_cal_impl.IO183DIO01DIO08SafeZero_P4 "" VAL_BLK 0x002A9958 Record_FLOAT64_IEEE 0 inverter_hil_CM_double -1.7E+308 1.7E+308 MATRIX_DIM 8 1 /end CHARACTERISTIC
/begin CHARACTERISTIC inverter_hil_cal_impl.IO183DIO01DIO08SafeZero_P5 "" VAL_BLK 0x002A99A8 Record_FLOAT64_IEEE 0 inverter_hil_CM_double -1.7E+308 1.7E+308 MATRIX_DIM 8 1 /end CHARACTERISTIC
/begin CHARACTERISTIC inverter_hil_cal_impl.IO183DIO01DIO08SafeZero_P6 "" VAL_BLK 0x002A99F8 Record_FLOAT64_IEEE 0 inverter_hil_CM_double -1.7E+308 1.7E+308 MATRIX_DIM 8 1 /end CHARACTERISTIC
/begin CHARACTERISTIC inverter_hil_cal_impl.IO183DIO09DIO13VCUMonitor_P1 "" VALUE 0x002A93F8 Record_FLOAT64_IEEE 0 inverter_hil_CM_double -1.7E+308 1.7E+308 /end CHARACTERISTIC
/begin CHARACTERISTIC inverter_hil_cal_impl.IO183DIO09DIO13VCUMonitor_P2 "" VALUE 0x002A9410 Record_FLOAT64_IEEE 0 inverter_hil_CM_double -1.7E+308 1.7E+308 /end CHARACTERISTIC
/begin CHARACTERISTIC inverter_hil_cal_impl.IO183DIO09DIO13VCUMonitor_P3 "" VALUE 0x002A9428 Record_FLOAT64_IEEE 0 inverter_hil_CM_double -1.7E+308 1.7E+308 /end CHARACTERISTIC
/begin CHARACTERISTIC inverter_hil_cal_impl.IO183DIO09DIO13VCUMonitor_P4 "" VAL_BLK 0x002A9440 Record_FLOAT64_IEEE 0 inverter_hil_CM_double -1.7E+308 1.7E+308 MATRIX_DIM 5 1 /end CHARACTERISTIC
/begin CHARACTERISTIC inverter_hil_cal_impl.IO183Module2Setup_P1 "" VALUE 0x002A9120 Record_FLOAT64_IEEE 0 inverter_hil_CM_double -1.7E+308 1.7E+308 /end CHARACTERISTIC
/begin CHARACTERISTIC inverter_hil_cal_impl.IO183Module2Setup_P10 "" VALUE 0x002A9238 Record_FLOAT64_IEEE 0 inverter_hil_CM_double -1.7E+308 1.7E+308 /end CHARACTERISTIC
/begin CHARACTERISTIC inverter_hil_cal_impl.IO183Module2Setup_P11 "" VALUE 0x002A9250 Record_FLOAT64_IEEE 0 inverter_hil_CM_double -1.7E+308 1.7E+308 /end CHARACTERISTIC
/begin CHARACTERISTIC inverter_hil_cal_impl.IO183Module2Setup_P2 "" VALUE 0x002A9138 Record_FLOAT64_IEEE 0 inverter_hil_CM_double -1.7E+308 1.7E+308 /end CHARACTERISTIC
/begin CHARACTERISTIC inverter_hil_cal_impl.IO183Module2Setup_P3 "" VALUE 0x002A9150 Record_FLOAT64_IEEE 0 inverter_hil_CM_double -1.7E+308 1.7E+308 /end CHARACTERISTIC
/begin CHARACTERISTIC inverter_hil_cal_impl.IO183Module2Setup_P4 "" VALUE 0x002A9168 Record_FLOAT64_IEEE 0 inverter_hil_CM_double -1.7E+308 1.7E+308 /end CHARACTERISTIC
/begin CHARACTERISTIC inverter_hil_cal_impl.IO183Module2Setup_P5 "" VALUE 0x002A9180 Record_FLOAT64_IEEE 0 inverter_hil_CM_double -1.7E+308 1.7E+308 /end CHARACTERISTIC
/begin CHARACTERISTIC inverter_hil_cal_impl.IO183Module2Setup_P6 "" VALUE 0x002A9198 Record_FLOAT64_IEEE 0 inverter_hil_CM_double -1.7E+308 1.7E+308 /end CHARACTERISTIC
/begin CHARACTERISTIC inverter_hil_cal_impl.IO183Module2Setup_P7 "" VALUE 0x002A91B0 Record_FLOAT64_IEEE 0 inverter_hil_CM_double -1.7E+308 1.7E+308 /end CHARACTERISTIC
/begin CHARACTERISTIC inverter_hil_cal_impl.IO183Module2Setup_P8 "" VAL_BLK 0x002A91C8 Record_FLOAT64_IEEE 0 inverter_hil_CM_double -1.7E+308 1.7E+308 MATRIX_DIM 9 1 /end CHARACTERISTIC
/begin CHARACTERISTIC inverter_hil_cal_impl.IO183Module2Setup_P9 "" VALUE 0x002A9220 Record_FLOAT64_IEEE 0 inverter_hil_CM_double -1.7E+308 1.7E+308 /end CHARACTERISTIC
/begin CHARACTERISTIC inverter_hil_cal_impl.IO183Setup_P1 "" VALUE 0x002A9510 Record_FLOAT64_IEEE 0 inverter_hil_CM_double -1.7E+308 1.7E+308 /end CHARACTERISTIC
/begin CHARACTERISTIC inverter_hil_cal_impl.IO183Setup_P10 "" VALUE 0x002A9628 Record_FLOAT64_IEEE 0 inverter_hil_CM_double -1.7E+308 1.7E+308 /end CHARACTERISTIC
/begin CHARACTERISTIC inverter_hil_cal_impl.IO183Setup_P11 "" VALUE 0x002A9640 Record_FLOAT64_IEEE 0 inverter_hil_CM_double -1.7E+308 1.7E+308 /end CHARACTERISTIC
/begin CHARACTERISTIC inverter_hil_cal_impl.IO183Setup_P2 "" VALUE 0x002A9528 Record_FLOAT64_IEEE 0 inverter_hil_CM_double -1.7E+308 1.7E+308 /end CHARACTERISTIC
/begin CHARACTERISTIC inverter_hil_cal_impl.IO183Setup_P3 "" VALUE 0x002A9540 Record_FLOAT64_IEEE 0 inverter_hil_CM_double -1.7E+308 1.7E+308 /end CHARACTERISTIC
/begin CHARACTERISTIC inverter_hil_cal_impl.IO183Setup_P4 "" VALUE 0x002A9558 Record_FLOAT64_IEEE 0 inverter_hil_CM_double -1.7E+308 1.7E+308 /end CHARACTERISTIC
/begin CHARACTERISTIC inverter_hil_cal_impl.IO183Setup_P5 "" VALUE 0x002A9570 Record_FLOAT64_IEEE 0 inverter_hil_CM_double -1.7E+308 1.7E+308 /end CHARACTERISTIC
/begin CHARACTERISTIC inverter_hil_cal_impl.IO183Setup_P6 "" VALUE 0x002A9588 Record_FLOAT64_IEEE 0 inverter_hil_CM_double -1.7E+308 1.7E+308 /end CHARACTERISTIC
/begin CHARACTERISTIC inverter_hil_cal_impl.IO183Setup_P7 "" VALUE 0x002A95A0 Record_FLOAT64_IEEE 0 inverter_hil_CM_double -1.7E+308 1.7E+308 /end CHARACTERISTIC
/begin CHARACTERISTIC inverter_hil_cal_impl.IO183Setup_P8 "" VAL_BLK 0x002A95B8 Record_FLOAT64_IEEE 0 inverter_hil_CM_double -1.7E+308 1.7E+308 MATRIX_DIM 9 1 /end CHARACTERISTIC
/begin CHARACTERISTIC inverter_hil_cal_impl.IO183Setup_P9 "" VALUE 0x002A9610 Record_FLOAT64_IEEE 0 inverter_hil_CM_double -1.7E+308 1.7E+308 /end CHARACTERISTIC
/begin CHARACTERISTIC inverter_hil_cal_impl.IO614CANDiagnostics_P1 "" VAL_BLK 0x002A9AC0 Record_FLOAT64_IEEE 0 inverter_hil_CM_double -1.7E+308 1.7E+308 MATRIX_DIM 15 1 /end CHARACTERISTIC
/begin CHARACTERISTIC inverter_hil_cal_impl.IO614CANFIFOReadRaw_P1 "" VAL_BLK 0x002A9A48 Record_FLOAT64_IEEE 0 inverter_hil_CM_double -1.7E+308 1.7E+308 MATRIX_DIM 13 1 /end CHARACTERISTIC
/begin CHARACTERISTIC inverter_hil_cal_impl.IO614CANSetup_P1 "" VAL_BLK 0x002A9658 Record_FLOAT64_IEEE 0 inverter_hil_CM_double -1.7E+308 1.7E+308 MATRIX_DIM 45 1 /end CHARACTERISTIC
/begin CHARACTERISTIC inverter_hil_cal_impl.IO614CANSetup_P2 "" VALUE 0x002A97D0 Record_FLOAT64_IEEE 0 inverter_hil_CM_double -1.7E+308 1.7E+308 /end CHARACTERISTIC
/begin CHARACTERISTIC inverter_hil_cal_impl.IO614CANSetup_P3 "" VALUE 0x002A97E8 Record_FLOAT64_IEEE 0 inverter_hil_CM_double -1.7E+308 1.7E+308 /end CHARACTERISTIC
/begin CHARACTERISTIC inverter_hil_cal_impl.Module1DigitalUnwired3_Value "" VALUE 0x002A92D0 Record_FLOAT64_IEEE 0 inverter_hil_CM_double -1.7E+308 1.7E+308 /end CHARACTERISTIC
/begin CHARACTERISTIC inverter_hil_cal_impl.Module1DigitalUnwired4_Value "" VALUE 0x002A92D8 Record_FLOAT64_IEEE 0 inverter_hil_CM_double -1.7E+308 1.7E+308 /end CHARACTERISTIC
/begin CHARACTERISTIC inverter_hil_cal_impl.Module1DigitalUnwired6_Value "" VALUE 0x002A92E0 Record_FLOAT64_IEEE 0 inverter_hil_CM_double -1.7E+308 1.7E+308 /end CHARACTERISTIC
/begin CHARACTERISTIC inverter_hil_cal_impl.Module1DigitalUnwired7_Value "" VALUE 0x002A92E8 Record_FLOAT64_IEEE 0 inverter_hil_CM_double -1.7E+308 1.7E+308 /end CHARACTERISTIC
/begin CHARACTERISTIC inverter_hil_cal_impl.Module1DigitalUnwired8_Value "" VALUE 0x002A92F0 Record_FLOAT64_IEEE 0 inverter_hil_CM_double -1.7E+308 1.7E+308 /end CHARACTERISTIC
/begin CHARACTERISTIC inverter_hil_cal_impl.Module2AI01AI04_P1 "" VALUE 0x002A9268 Record_FLOAT64_IEEE 0 inverter_hil_CM_double -1.7E+308 1.7E+308 /end CHARACTERISTIC
/begin CHARACTERISTIC inverter_hil_cal_impl.Module2AI01AI04_P2 "" VALUE 0x002A9280 Record_FLOAT64_IEEE 0 inverter_hil_CM_double -1.7E+308 1.7E+308 /end CHARACTERISTIC
/begin CHARACTERISTIC inverter_hil_cal_impl.Module2AI01AI04_P3 "" VALUE 0x002A9298 Record_FLOAT64_IEEE 0 inverter_hil_CM_double -1.7E+308 1.7E+308 /end CHARACTERISTIC
/begin CHARACTERISTIC inverter_hil_cal_impl.Module2AI01AI04_P4 "" VALUE 0x002A92B0 Record_FLOAT64_IEEE 0 inverter_hil_CM_double -1.7E+308 1.7E+308 /end CHARACTERISTIC
/begin CHARACTERISTIC inverter_hil_cal_impl.Module2AI01AI04_P5 "" VALUE 0x002A92C8 Record_FLOAT64_IEEE 0 inverter_hil_CM_double -1.7E+308 1.7E+308 /end CHARACTERISTIC
/begin CHARACTERISTIC inverter_hil_cal_impl.Module2DI01DI08_P1 "" VALUE 0x002A9478 Record_FLOAT64_IEEE 0 inverter_hil_CM_double -1.7E+308 1.7E+308 /end CHARACTERISTIC
/begin CHARACTERISTIC inverter_hil_cal_impl.Module2DI01DI08_P2 "" VALUE 0x002A9490 Record_FLOAT64_IEEE 0 inverter_hil_CM_double -1.7E+308 1.7E+308 /end CHARACTERISTIC
/begin CHARACTERISTIC inverter_hil_cal_impl.Module2DI01DI08_P3 "" VALUE 0x002A94A8 Record_FLOAT64_IEEE 0 inverter_hil_CM_double -1.7E+308 1.7E+308 /end CHARACTERISTIC
/begin CHARACTERISTIC inverter_hil_cal_impl.Module2DI01DI08_P4 "" VAL_BLK 0x002A94C0 Record_FLOAT64_IEEE 0 inverter_hil_CM_double -1.7E+308 1.7E+308 MATRIX_DIM 8 1 /end CHARACTERISTIC
/begin CHARACTERISTIC inverter_hil_cal_impl.PortACANFIFORead_P1 "" VAL_BLK 0x002A9308 Record_FLOAT64_IEEE 0 inverter_hil_CM_double -1.7E+308 1.7E+308 MATRIX_DIM 13 1 /end CHARACTERISTIC
/begin CHARACTERISTIC inverter_hil_cal_impl.PortACANWrite1_P1 "" VAL_BLK 0x002A9DF0 Record_FLOAT64_IEEE 0 inverter_hil_CM_double -1.7E+308 1.7E+308 MATRIX_DIM 10 1 /end CHARACTERISTIC
/begin CHARACTERISTIC inverter_hil_cal_impl.PortACANWrite2_P1 "" VAL_BLK 0x002A9E50 Record_FLOAT64_IEEE 0 inverter_hil_CM_double -1.7E+308 1.7E+308 MATRIX_DIM 10 1 /end CHARACTERISTIC
/begin CHARACTERISTIC inverter_hil_cal_impl.PortACANWrite3_P1 "" VAL_BLK 0x002A9EB0 Record_FLOAT64_IEEE 0 inverter_hil_CM_double -1.7E+308 1.7E+308 MATRIX_DIM 10 1 /end CHARACTERISTIC
/begin CHARACTERISTIC inverter_hil_cal_impl.PortACANWrite4_P1 "" VAL_BLK 0x002A9F10 Record_FLOAT64_IEEE 0 inverter_hil_CM_double -1.7E+308 1.7E+308 MATRIX_DIM 10 1 /end CHARACTERISTIC
/begin CHARACTERISTIC inverter_hil_cal_impl.PortACANWrite5_P1 "" VAL_BLK 0x002A9F70 Record_FLOAT64_IEEE 0 inverter_hil_CM_double -1.7E+308 1.7E+308 MATRIX_DIM 10 1 /end CHARACTERISTIC
/begin CHARACTERISTIC inverter_hil_cal_impl.PortAPayloadRateTransition1_Ini "" VALUE 0x002AA368 Record_UBYTE 0 inverter_hil_CM_uint8 0 255 /end CHARACTERISTIC
/begin CHARACTERISTIC inverter_hil_cal_impl.PortAPayloadRateTransition2_Ini "" VALUE 0x002AA369 Record_UBYTE 0 inverter_hil_CM_uint8 0 255 /end CHARACTERISTIC
/begin CHARACTERISTIC inverter_hil_cal_impl.PortAPayloadRateTransition3_Ini "" VALUE 0x002AA36A Record_UBYTE 0 inverter_hil_CM_uint8 0 255 /end CHARACTERISTIC
/begin CHARACTERISTIC inverter_hil_cal_impl.PortAPayloadRateTransition4_Ini "" VALUE 0x002AA36B Record_UBYTE 0 inverter_hil_CM_uint8 0 255 /end CHARACTERISTIC
/begin CHARACTERISTIC inverter_hil_cal_impl.PortAPayloadRateTransition5_Ini "" VALUE 0x002AA36C Record_UBYTE 0 inverter_hil_CM_uint8 0 255 /end CHARACTERISTIC
/begin CHARACTERISTIC inverter_hil_cal_impl.SafeCANDiagnostics_Value "" VAL_BLK 0x002AA330 Record_ULONG 0 inverter_hil_CM_uint32 0 4294967295 MATRIX_DIM 8 1 /end CHARACTERISTIC
/begin CHARACTERISTIC inverter_hil_cal_impl.SafeControlFrames_Value "" VAL_BLK 0x002AA3CD Record_UBYTE 0 inverter_hil_CM_uint8 0 255 MATRIX_DIM 8 4 /end CHARACTERISTIC
/begin CHARACTERISTIC inverter_hil_cal_impl.SafeDCLinkV_Value "" VAL_BLK 0x002A9DC0 Record_FLOAT64_IEEE 0 inverter_hil_CM_double -1.7E+308 1.7E+308 MATRIX_DIM 2 1 /end CHARACTERISTIC
/begin CHARACTERISTIC inverter_hil_cal_impl.SafeDecodedCommands_Value "" VAL_BLK 0x002AA3AD Record_UBYTE 0 inverter_hil_CM_uint8 0 255 MATRIX_DIM 8 4 /end CHARACTERISTIC
/begin CHARACTERISTIC inverter_hil_cal_impl.SafeDigitalCommand_Value "" VAL_BLK 0x002AA357 Record_BOOLEAN 0 inverter_hil_CM_boolean 0 1 MATRIX_DIM 8 1 /end CHARACTERISTIC
/begin CHARACTERISTIC inverter_hil_cal_impl.SafeDigitalStimulus_Value "" VAL_BLK 0x002AA35F Record_BOOLEAN 0 inverter_hil_CM_boolean 0 1 MATRIX_DIM 8 1 /end CHARACTERISTIC
/begin CHARACTERISTIC inverter_hil_cal_impl.SafeFaultMask_Value "" VAL_BLK 0x002AA320 Record_ULONG 0 inverter_hil_CM_uint32 0 4294967295 MATRIX_DIM 4 1 /end CHARACTERISTIC
/begin CHARACTERISTIC inverter_hil_cal_impl.SafeLoadTorqueNm_Value "" VAL_BLK 0x002A9DA0 Record_FLOAT64_IEEE 0 inverter_hil_CM_double -1.7E+308 1.7E+308 MATRIX_DIM 4 1 /end CHARACTERISTIC
/begin CHARACTERISTIC inverter_hil_cal_impl.SafeObservations_Ch1_Value "" VAL_BLK 0x002A9B38 Record_FLOAT64_IEEE 0 inverter_hil_CM_double -1.7E+308 1.7E+308 MATRIX_DIM 16 1 /end CHARACTERISTIC
/begin CHARACTERISTIC inverter_hil_cal_impl.SafeObservations_Ch2_Value "" VAL_BLK 0x002A9BB8 Record_FLOAT64_IEEE 0 inverter_hil_CM_double -1.7E+308 1.7E+308 MATRIX_DIM 16 1 /end CHARACTERISTIC
/begin CHARACTERISTIC inverter_hil_cal_impl.SafeObservations_Ch3_Value "" VAL_BLK 0x002A9C38 Record_FLOAT64_IEEE 0 inverter_hil_CM_double -1.7E+308 1.7E+308 MATRIX_DIM 16 1 /end CHARACTERISTIC
/begin CHARACTERISTIC inverter_hil_cal_impl.SafeObservations_Ch4_Value "" VAL_BLK 0x002A9CB8 Record_FLOAT64_IEEE 0 inverter_hil_CM_double -1.7E+308 1.7E+308 MATRIX_DIM 16 1 /end CHARACTERISTIC
/begin CHARACTERISTIC inverter_hil_cal_impl.SafePedalCommand_Value "" VAL_BLK 0x002A9D90 Record_FLOAT64_IEEE 0 inverter_hil_CM_double -1.7E+308 1.7E+308 MATRIX_DIM 2 1 /end CHARACTERISTIC
/begin CHARACTERISTIC inverter_hil_cal_impl.SafePedalVoltageV_Value "" VAL_BLK 0x002A9D70 Record_FLOAT64_IEEE 0 inverter_hil_CM_double -1.7E+308 1.7E+308 MATRIX_DIM 4 1 /end CHARACTERISTIC
/begin CHARACTERISTIC inverter_hil_cal_impl.SafePreflightSafe_Value "" VALUE 0x002AA356 Record_BOOLEAN 0 inverter_hil_CM_boolean 0 1 /end CHARACTERISTIC
/begin CHARACTERISTIC inverter_hil_cal_impl.SafeStatus3X3_Ch1_Value "" VAL_BLK 0x002AA36D Record_UBYTE 0 inverter_hil_CM_uint8 0 255 MATRIX_DIM 8 1 /end CHARACTERISTIC
/begin CHARACTERISTIC inverter_hil_cal_impl.SafeStatus3X3_Ch2_Value "" VAL_BLK 0x002AA37D Record_UBYTE 0 inverter_hil_CM_uint8 0 255 MATRIX_DIM 8 1 /end CHARACTERISTIC
/begin CHARACTERISTIC inverter_hil_cal_impl.SafeStatus3X3_Ch3_Value "" VAL_BLK 0x002AA38D Record_UBYTE 0 inverter_hil_CM_uint8 0 255 MATRIX_DIM 8 1 /end CHARACTERISTIC
/begin CHARACTERISTIC inverter_hil_cal_impl.SafeStatus3X3_Ch4_Value "" VAL_BLK 0x002AA39D Record_UBYTE 0 inverter_hil_CM_uint8 0 255 MATRIX_DIM 8 1 /end CHARACTERISTIC
/begin CHARACTERISTIC inverter_hil_cal_impl.SafeStatus3X5_Ch1_Value "" VAL_BLK 0x002AA375 Record_UBYTE 0 inverter_hil_CM_uint8 0 255 MATRIX_DIM 8 1 /end CHARACTERISTIC
/begin CHARACTERISTIC inverter_hil_cal_impl.SafeStatus3X5_Ch2_Value "" VAL_BLK 0x002AA385 Record_UBYTE 0 inverter_hil_CM_uint8 0 255 MATRIX_DIM 8 1 /end CHARACTERISTIC
/begin CHARACTERISTIC inverter_hil_cal_impl.SafeStatus3X5_Ch3_Value "" VAL_BLK 0x002AA395 Record_UBYTE 0 inverter_hil_CM_uint8 0 255 MATRIX_DIM 8 1 /end CHARACTERISTIC
/begin CHARACTERISTIC inverter_hil_cal_impl.SafeStatus3X5_Ch4_Value "" VAL_BLK 0x002AA3A5 Record_UBYTE 0 inverter_hil_CM_uint8 0 255 MATRIX_DIM 8 1 /end CHARACTERISTIC
/begin CHARACTERISTIC inverter_hil_cal_impl.UnusedSW_IN_1_Value "" VALUE 0x002A98E0 Record_FLOAT64_IEEE 0 inverter_hil_CM_double -1.7E+308 1.7E+308 /end CHARACTERISTIC
/begin CHARACTERISTIC inverter_hil_cal_impl.UnusedSW_IN_2_Value "" VALUE 0x002A98E8 Record_FLOAT64_IEEE 0 inverter_hil_CM_double -1.7E+308 1.7E+308 /end CHARACTERISTIC
/begin CHARACTERISTIC inverter_hil_cal_impl.UnusedSW_IN_3_Value "" VALUE 0x002A98F0 Record_FLOAT64_IEEE 0 inverter_hil_CM_double -1.7E+308 1.7E+308 /end CHARACTERISTIC
/begin CHARACTERISTIC inverter_hil_cal_impl.UnusedSW_IN_4_Value "" VALUE 0x002A98F8 Record_FLOAT64_IEEE 0 inverter_hil_CM_double -1.7E+308 1.7E+308 /end CHARACTERISTIC
/begin CHARACTERISTIC inverter_hil_cal_impl.XCPBrakePercentToFraction_Gain "" VALUE 0x002A9100 Record_FLOAT64_IEEE 0 inverter_hil_CM_double -1.7E+308 1.7E+308 /end CHARACTERISTIC
/begin CHARACTERISTIC inverter_hil_cal_impl.XCPThrottlePercentToFraction_Ga "" VALUE 0x002A9108 Record_FLOAT64_IEEE 0 inverter_hil_CM_double -1.7E+308 1.7E+308 /end CHARACTERISTIC
/begin CHARACTERISTIC inverter_hil_cal_impl.hil_cmd_xcp_pedals_active_Initi "" VALUE 0x002AA367 Record_BOOLEAN 0 inverter_hil_CM_boolean 0 1 /end CHARACTERISTIC
/begin CHARACTERISTIC inverter_hil_cal_impl.hil_cmd_xcp_pedals_brake_Initia "" VALUE 0x002A9DD0 Record_FLOAT64_IEEE 0 inverter_hil_CM_double -1.7E+308 1.7E+308 /end CHARACTERISTIC
/begin CHARACTERISTIC inverter_hil_cal_impl.hil_cmd_xcp_pedals_throttle_Ini "" VALUE 0x002A9DD8 Record_FLOAT64_IEEE 0 inverter_hil_CM_double -1.7E+308 1.7E+308 /end CHARACTERISTIC
/begin MEASUREMENT hil_cmd_xcp_pedals_active "" UBYTE inverter_hil_CM_boolean 0 0 0.000000 1.000000 ECU_ADDRESS 0x002BA2C8
 /begin IF_DATA XCP
  /begin DAQ_EVENT VARIABLE /begin DEFAULT_EVENT_LIST EVENT 0x0000 /end DEFAULT_EVENT_LIST /end DAQ_EVENT
 /end IF_DATA
/end MEASUREMENT
/begin MEASUREMENT hil_cmd_xcp_pedals_brake "" FLOAT64_IEEE inverter_hil_CM_double 0 0 0.000000 100.000000 ECU_ADDRESS 0x002BA2F0
 /begin IF_DATA XCP
  /begin DAQ_EVENT VARIABLE /begin DEFAULT_EVENT_LIST EVENT 0x0000 /end DEFAULT_EVENT_LIST /end DAQ_EVENT
 /end IF_DATA
/end MEASUREMENT
/begin MEASUREMENT hil_cmd_xcp_pedals_throttle "" FLOAT64_IEEE inverter_hil_CM_double 0 0 0.000000 100.000000 ECU_ADDRESS 0x002BA2E8
 /begin IF_DATA XCP
  /begin DAQ_EVENT VARIABLE /begin DEFAULT_EVENT_LIST EVENT 0x0000 /end DEFAULT_EVENT_LIST /end DAQ_EVENT
 /end IF_DATA
/end MEASUREMENT
/begin MEASUREMENT hil_obs_virtual_vcu_apps_brake_fault "Virtual VCU APPS/brake plausibility-fault indicator." UBYTE inverter_hil_CM_boolean 0 0 0 1 ECU_ADDRESS 0x002BA2F8
 /begin IF_DATA XCP
  /begin DAQ_EVENT VARIABLE /begin DEFAULT_EVENT_LIST EVENT 0x0000 /end DEFAULT_EVENT_LIST /end DAQ_EVENT
 /end IF_DATA
/end MEASUREMENT
/begin MEASUREMENT hil_obs_virtual_vcu_control_frame_1 "Virtual VCU control-frame 1 CAN payload." UBYTE inverter_hil_CM_uint8 0 0 0 255 LAYOUT COLUMN_DIR MATRIX_DIM 1 8 ECU_ADDRESS 0x002BA300
 /begin IF_DATA XCP
  /begin DAQ_EVENT VARIABLE /begin DEFAULT_EVENT_LIST EVENT 0x0000 /end DEFAULT_EVENT_LIST /end DAQ_EVENT
 /end IF_DATA
/end MEASUREMENT
/begin MEASUREMENT hil_obs_virtual_vcu_inverter_control_enable "Virtual VCU inverter-control-enable output." UBYTE inverter_hil_CM_uint8 0 0 0 255 ECU_ADDRESS 0x002BA308
 /begin IF_DATA XCP
  /begin DAQ_EVENT VARIABLE /begin DEFAULT_EVENT_LIST EVENT 0x0000 /end DEFAULT_EVENT_LIST /end DAQ_EVENT
 /end IF_DATA
/end MEASUREMENT
/begin MEASUREMENT hil_obs_virtual_vcu_main_enable "Virtual VCU main-enable output." UBYTE inverter_hil_CM_uint8 0 0 0 255 ECU_ADDRESS 0x002BA30A
 /begin IF_DATA XCP
  /begin DAQ_EVENT VARIABLE /begin DEFAULT_EVENT_LIST EVENT 0x0000 /end DEFAULT_EVENT_LIST /end DAQ_EVENT
 /end IF_DATA
/end MEASUREMENT
/begin MEASUREMENT hil_obs_virtual_vcu_pedal_payload "Virtual VCU transmitted pedal CAN payload." UBYTE inverter_hil_CM_uint8 0 0 0 255 LAYOUT COLUMN_DIR MATRIX_DIM 1 8 ECU_ADDRESS 0x002BA310
 /begin IF_DATA XCP
  /begin DAQ_EVENT VARIABLE /begin DEFAULT_EVENT_LIST EVENT 0x0000 /end DEFAULT_EVENT_LIST /end DAQ_EVENT
 /end IF_DATA
/end MEASUREMENT
/begin MEASUREMENT hil_obs_virtual_vcu_pedal_tx_count "Virtual VCU pedal transmit counter." ULONG inverter_hil_CM_uint32 0 0 0 4294967295 ECU_ADDRESS 0x002BA318
 /begin IF_DATA XCP
  /begin DAQ_EVENT VARIABLE /begin DEFAULT_EVENT_LIST EVENT 0x0001 /end DEFAULT_EVENT_LIST /end DAQ_EVENT
 /end IF_DATA
/end MEASUREMENT
/begin MEASUREMENT hil_obs_virtual_vcu_precharge_enable "Virtual VCU precharge-enable output." UBYTE inverter_hil_CM_uint8 0 0 0 255 ECU_ADDRESS 0x002BA309
 /begin IF_DATA XCP
  /begin DAQ_EVENT VARIABLE /begin DEFAULT_EVENT_LIST EVENT 0x0000 /end DEFAULT_EVENT_LIST /end DAQ_EVENT
 /end IF_DATA
/end MEASUREMENT
/begin MEASUREMENT hil_obs_virtual_vcu_state_id "Virtual VCU state identifier." UBYTE inverter_hil_CM_uint8 0 0 0 255 ECU_ADDRESS 0x002BA30B
 /begin IF_DATA XCP
  /begin DAQ_EVENT VARIABLE /begin DEFAULT_EVENT_LIST EVENT 0x0000 /end DEFAULT_EVENT_LIST /end DAQ_EVENT
 /end IF_DATA
/end MEASUREMENT
/begin MEASUREMENT hil_obs_virtual_vcu_torque_request_nm "Virtual VCU decoded torque request in Nm." FLOAT64_IEEE inverter_hil_CM_double 0 0 -1.7E+308 1.7E+308 ECU_ADDRESS 0x002BA320
 /begin IF_DATA XCP
  /begin DAQ_EVENT VARIABLE /begin DEFAULT_EVENT_LIST EVENT 0x0000 /end DEFAULT_EVENT_LIST /end DAQ_EVENT
 /end IF_DATA
/end MEASUREMENT
/begin MEASUREMENT inverter_hil_B.AnalogInputsSignalCopy "" FLOAT64_IEEE inverter_hil_CM_double 0 0 -1.7E+308 1.7E+308 LAYOUT COLUMN_DIR MATRIX_DIM 4 ECU_ADDRESS 0x002B8D80
 /begin IF_DATA XCP
  /begin DAQ_EVENT VARIABLE /begin DEFAULT_EVENT_LIST EVENT 0x0000 /end DEFAULT_EVENT_LIST /end DAQ_EVENT
 /end IF_DATA
/end MEASUREMENT
/begin MEASUREMENT inverter_hil_B.BrakeSourceSwitch "" FLOAT64_IEEE inverter_hil_CM_double 0 0 -1.7E+308 1.7E+308 ECU_ADDRESS 0x002B8B40
 /begin IF_DATA XCP
  /begin DAQ_EVENT VARIABLE /begin DEFAULT_EVENT_LIST EVENT 0x0000 /end DEFAULT_EVENT_LIST /end DAQ_EVENT
 /end IF_DATA
/end MEASUREMENT
/begin MEASUREMENT inverter_hil_B.CANWrite0x383 "" UBYTE inverter_hil_CM_boolean 0 0 0 1 ECU_ADDRESS 0x002BA2B7
 /begin IF_DATA XCP
  /begin DAQ_EVENT VARIABLE /begin DEFAULT_EVENT_LIST EVENT 0x0001 /end DEFAULT_EVENT_LIST /end DAQ_EVENT
 /end IF_DATA
/end MEASUREMENT
/begin MEASUREMENT inverter_hil_B.CANWrite0x385 "" UBYTE inverter_hil_CM_boolean 0 0 0 1 ECU_ADDRESS 0x002BA2B8
 /begin IF_DATA XCP
  /begin DAQ_EVENT VARIABLE /begin DEFAULT_EVENT_LIST EVENT 0x0001 /end DEFAULT_EVENT_LIST /end DAQ_EVENT
 /end IF_DATA
/end MEASUREMENT
/begin MEASUREMENT inverter_hil_B.CANWrite0x393 "" UBYTE inverter_hil_CM_boolean 0 0 0 1 ECU_ADDRESS 0x002BA2B9
 /begin IF_DATA XCP
  /begin DAQ_EVENT VARIABLE /begin DEFAULT_EVENT_LIST EVENT 0x0001 /end DEFAULT_EVENT_LIST /end DAQ_EVENT
 /end IF_DATA
/end MEASUREMENT
/begin MEASUREMENT inverter_hil_B.CANWrite0x395 "" UBYTE inverter_hil_CM_boolean 0 0 0 1 ECU_ADDRESS 0x002BA2BA
 /begin IF_DATA XCP
  /begin DAQ_EVENT VARIABLE /begin DEFAULT_EVENT_LIST EVENT 0x0001 /end DEFAULT_EVENT_LIST /end DAQ_EVENT
 /end IF_DATA
/end MEASUREMENT
/begin MEASUREMENT inverter_hil_B.CANWrite0x3A3 "" UBYTE inverter_hil_CM_boolean 0 0 0 1 ECU_ADDRESS 0x002BA2BB
 /begin IF_DATA XCP
  /begin DAQ_EVENT VARIABLE /begin DEFAULT_EVENT_LIST EVENT 0x0001 /end DEFAULT_EVENT_LIST /end DAQ_EVENT
 /end IF_DATA
/end MEASUREMENT
/begin MEASUREMENT inverter_hil_B.CANWrite0x3A5 "" UBYTE inverter_hil_CM_boolean 0 0 0 1 ECU_ADDRESS 0x002BA2BC
 /begin IF_DATA XCP
  /begin DAQ_EVENT VARIABLE /begin DEFAULT_EVENT_LIST EVENT 0x0001 /end DEFAULT_EVENT_LIST /end DAQ_EVENT
 /end IF_DATA
/end MEASUREMENT
/begin MEASUREMENT inverter_hil_B.CANWrite0x3B3 "" UBYTE inverter_hil_CM_boolean 0 0 0 1 ECU_ADDRESS 0x002BA2BD
 /begin IF_DATA XCP
  /begin DAQ_EVENT VARIABLE /begin DEFAULT_EVENT_LIST EVENT 0x0001 /end DEFAULT_EVENT_LIST /end DAQ_EVENT
 /end IF_DATA
/end MEASUREMENT
/begin MEASUREMENT inverter_hil_B.CANWrite0x3B5 "" UBYTE inverter_hil_CM_boolean 0 0 0 1 ECU_ADDRESS 0x002BA2BE
 /begin IF_DATA XCP
  /begin DAQ_EVENT VARIABLE /begin DEFAULT_EVENT_LIST EVENT 0x0001 /end DEFAULT_EVENT_LIST /end DAQ_EVENT
 /end IF_DATA
/end MEASUREMENT
/begin MEASUREMENT inverter_hil_B.CANWrite0x400 "" UBYTE inverter_hil_CM_boolean 0 0 0 1 ECU_ADDRESS 0x002BA2BF
 /begin IF_DATA XCP
  /begin DAQ_EVENT VARIABLE /begin DEFAULT_EVENT_LIST EVENT 0x0001 /end DEFAULT_EVENT_LIST /end DAQ_EVENT
 /end IF_DATA
/end MEASUREMENT
/begin MEASUREMENT inverter_hil_B.CastRefhil_cmd_digital_cooling_ "" FLOAT64_IEEE inverter_hil_CM_double 0 0 -1.7E+308 1.7E+308 ECU_ADDRESS 0x002B8B48
 /begin IF_DATA XCP
  /begin DAQ_EVENT VARIABLE /begin DEFAULT_EVENT_LIST EVENT 0x0000 /end DEFAULT_EVENT_LIST /end DAQ_EVENT
 /end IF_DATA
/end MEASUREMENT
/begin MEASUREMENT inverter_hil_B.CastRefhil_cmd_digital_shutdown "" FLOAT64_IEEE inverter_hil_CM_double 0 0 -1.7E+308 1.7E+308 ECU_ADDRESS 0x002B8B50
 /begin IF_DATA XCP
  /begin DAQ_EVENT VARIABLE /begin DEFAULT_EVENT_LIST EVENT 0x0000 /end DEFAULT_EVENT_LIST /end DAQ_EVENT
 /end IF_DATA
/end MEASUREMENT
/begin MEASUREMENT inverter_hil_B.Cmdhil_cal_pedals_pressed_v1 "" FLOAT64_IEEE inverter_hil_CM_double 0 0 -1.7E+308 1.7E+308 ECU_ADDRESS 0x002B8E00
 /begin IF_DATA XCP
  /begin DAQ_EVENT VARIABLE /begin DEFAULT_EVENT_LIST EVENT 0x0000 /end DEFAULT_EVENT_LIST /end DAQ_EVENT
 /end IF_DATA
/end MEASUREMENT
/begin MEASUREMENT inverter_hil_B.Cmdhil_cal_pedals_pressed_v2 "" FLOAT64_IEEE inverter_hil_CM_double 0 0 -1.7E+308 1.7E+308 ECU_ADDRESS 0x002B8E08
 /begin IF_DATA XCP
  /begin DAQ_EVENT VARIABLE /begin DEFAULT_EVENT_LIST EVENT 0x0000 /end DEFAULT_EVENT_LIST /end DAQ_EVENT
 /end IF_DATA
/end MEASUREMENT
/begin MEASUREMENT inverter_hil_B.Cmdhil_cal_pedals_pressed_v3 "" FLOAT64_IEEE inverter_hil_CM_double 0 0 -1.7E+308 1.7E+308 ECU_ADDRESS 0x002B8E10
 /begin IF_DATA XCP
  /begin DAQ_EVENT VARIABLE /begin DEFAULT_EVENT_LIST EVENT 0x0000 /end DEFAULT_EVENT_LIST /end DAQ_EVENT
 /end IF_DATA
/end MEASUREMENT
/begin MEASUREMENT inverter_hil_B.Cmdhil_cal_pedals_pressed_v4 "" FLOAT64_IEEE inverter_hil_CM_double 0 0 -1.7E+308 1.7E+308 ECU_ADDRESS 0x002B8E18
 /begin IF_DATA XCP
  /begin DAQ_EVENT VARIABLE /begin DEFAULT_EVENT_LIST EVENT 0x0000 /end DEFAULT_EVENT_LIST /end DAQ_EVENT
 /end IF_DATA
/end MEASUREMENT
/begin MEASUREMENT inverter_hil_B.Cmdhil_cal_pedals_released_v1 "" FLOAT64_IEEE inverter_hil_CM_double 0 0 -1.7E+308 1.7E+308 ECU_ADDRESS 0x002B8E20
 /begin IF_DATA XCP
  /begin DAQ_EVENT VARIABLE /begin DEFAULT_EVENT_LIST EVENT 0x0000 /end DEFAULT_EVENT_LIST /end DAQ_EVENT
 /end IF_DATA
/end MEASUREMENT
/begin MEASUREMENT inverter_hil_B.Cmdhil_cal_pedals_released_v2 "" FLOAT64_IEEE inverter_hil_CM_double 0 0 -1.7E+308 1.7E+308 ECU_ADDRESS 0x002B8E28
 /begin IF_DATA XCP
  /begin DAQ_EVENT VARIABLE /begin DEFAULT_EVENT_LIST EVENT 0x0000 /end DEFAULT_EVENT_LIST /end DAQ_EVENT
 /end IF_DATA
/end MEASUREMENT
/begin MEASUREMENT inverter_hil_B.Cmdhil_cal_pedals_released_v3 "" FLOAT64_IEEE inverter_hil_CM_double 0 0 -1.7E+308 1.7E+308 ECU_ADDRESS 0x002B8E30
 /begin IF_DATA XCP
  /begin DAQ_EVENT VARIABLE /begin DEFAULT_EVENT_LIST EVENT 0x0000 /end DEFAULT_EVENT_LIST /end DAQ_EVENT
 /end IF_DATA
/end MEASUREMENT
/begin MEASUREMENT inverter_hil_B.Cmdhil_cal_pedals_released_v4 "" FLOAT64_IEEE inverter_hil_CM_double 0 0 -1.7E+308 1.7E+308 ECU_ADDRESS 0x002B8E38
 /begin IF_DATA XCP
  /begin DAQ_EVENT VARIABLE /begin DEFAULT_EVENT_LIST EVENT 0x0000 /end DEFAULT_EVENT_LIST /end DAQ_EVENT
 /end IF_DATA
/end MEASUREMENT
/begin MEASUREMENT inverter_hil_B.Cmdhil_cmd_dc_link12_v "" FLOAT64_IEEE inverter_hil_CM_double 0 0 -1.7E+308 1.7E+308 ECU_ADDRESS 0x002B8E40
 /begin IF_DATA XCP
  /begin DAQ_EVENT VARIABLE /begin DEFAULT_EVENT_LIST EVENT 0x0000 /end DEFAULT_EVENT_LIST /end DAQ_EVENT
 /end IF_DATA
/end MEASUREMENT
/begin MEASUREMENT inverter_hil_B.Cmdhil_cmd_dc_link34_v "" FLOAT64_IEEE inverter_hil_CM_double 0 0 -1.7E+308 1.7E+308 ECU_ADDRESS 0x002B8E48
 /begin IF_DATA XCP
  /begin DAQ_EVENT VARIABLE /begin DEFAULT_EVENT_LIST EVENT 0x0000 /end DEFAULT_EVENT_LIST /end DAQ_EVENT
 /end IF_DATA
/end MEASUREMENT
/begin MEASUREMENT inverter_hil_B.Cmdhil_cmd_digital_cooling_swit "" UBYTE inverter_hil_CM_boolean 0 0 0 1 ECU_ADDRESS 0x002BA2AA
 /begin IF_DATA XCP
  /begin DAQ_EVENT VARIABLE /begin DEFAULT_EVENT_LIST EVENT 0x0000 /end DEFAULT_EVENT_LIST /end DAQ_EVENT
 /end IF_DATA
/end MEASUREMENT
/begin MEASUREMENT inverter_hil_B.Cmdhil_cmd_digital_main_button "" UBYTE inverter_hil_CM_boolean 0 0 0 1 ECU_ADDRESS 0x002BA2AB
 /begin IF_DATA XCP
  /begin DAQ_EVENT VARIABLE /begin DEFAULT_EVENT_LIST EVENT 0x0000 /end DEFAULT_EVENT_LIST /end DAQ_EVENT
 /end IF_DATA
/end MEASUREMENT
/begin MEASUREMENT inverter_hil_B.Cmdhil_cmd_digital_main_button_ "" ULONG inverter_hil_CM_uint32 0 0 0 4294967295 ECU_ADDRESS 0x002BA0E4
 /begin IF_DATA XCP
  /begin DAQ_EVENT VARIABLE /begin DEFAULT_EVENT_LIST EVENT 0x0000 /end DEFAULT_EVENT_LIST /end DAQ_EVENT
 /end IF_DATA
/end MEASUREMENT
/begin MEASUREMENT inverter_hil_B.Cmdhil_cmd_digital_precharge_se "" ULONG inverter_hil_CM_uint32 0 0 0 4294967295 ECU_ADDRESS 0x002BA0E8
 /begin IF_DATA XCP
  /begin DAQ_EVENT VARIABLE /begin DEFAULT_EVENT_LIST EVENT 0x0000 /end DEFAULT_EVENT_LIST /end DAQ_EVENT
 /end IF_DATA
/end MEASUREMENT
/begin MEASUREMENT inverter_hil_B.Cmdhil_cmd_digital_shutdown_fee "" UBYTE inverter_hil_CM_boolean 0 0 0 1 ECU_ADDRESS 0x002BA2AC
 /begin IF_DATA XCP
  /begin DAQ_EVENT VARIABLE /begin DEFAULT_EVENT_LIST EVENT 0x0000 /end DEFAULT_EVENT_LIST /end DAQ_EVENT
 /end IF_DATA
/end MEASUREMENT
/begin MEASUREMENT inverter_hil_B.Cmdhil_cmd_gui_heartbeat "" ULONG inverter_hil_CM_uint32 0 0 0 4294967295 ECU_ADDRESS 0x002BA0EC
 /begin IF_DATA XCP
  /begin DAQ_EVENT VARIABLE /begin DEFAULT_EVENT_LIST EVENT 0x0000 /end DEFAULT_EVENT_LIST /end DAQ_EVENT
 /end IF_DATA
/end MEASUREMENT
/begin MEASUREMENT inverter_hil_B.Cmdhil_cmd_inverter1_fault_mask "" ULONG inverter_hil_CM_uint32 0 0 0 4294967295 ECU_ADDRESS 0x002BA0F0
 /begin IF_DATA XCP
  /begin DAQ_EVENT VARIABLE /begin DEFAULT_EVENT_LIST EVENT 0x0000 /end DEFAULT_EVENT_LIST /end DAQ_EVENT
 /end IF_DATA
/end MEASUREMENT
/begin MEASUREMENT inverter_hil_B.Cmdhil_cmd_inverter2_fault_mask "" ULONG inverter_hil_CM_uint32 0 0 0 4294967295 ECU_ADDRESS 0x002BA0F4
 /begin IF_DATA XCP
  /begin DAQ_EVENT VARIABLE /begin DEFAULT_EVENT_LIST EVENT 0x0000 /end DEFAULT_EVENT_LIST /end DAQ_EVENT
 /end IF_DATA
/end MEASUREMENT
/begin MEASUREMENT inverter_hil_B.Cmdhil_cmd_inverter3_fault_mask "" ULONG inverter_hil_CM_uint32 0 0 0 4294967295 ECU_ADDRESS 0x002BA0F8
 /begin IF_DATA XCP
  /begin DAQ_EVENT VARIABLE /begin DEFAULT_EVENT_LIST EVENT 0x0000 /end DEFAULT_EVENT_LIST /end DAQ_EVENT
 /end IF_DATA
/end MEASUREMENT
/begin MEASUREMENT inverter_hil_B.Cmdhil_cmd_inverter4_fault_mask "" ULONG inverter_hil_CM_uint32 0 0 0 4294967295 ECU_ADDRESS 0x002BA0FC
 /begin IF_DATA XCP
  /begin DAQ_EVENT VARIABLE /begin DEFAULT_EVENT_LIST EVENT 0x0000 /end DEFAULT_EVENT_LIST /end DAQ_EVENT
 /end IF_DATA
/end MEASUREMENT
/begin MEASUREMENT inverter_hil_B.Cmdhil_cmd_pedals_brake "" FLOAT64_IEEE inverter_hil_CM_double 0 0 -1.7E+308 1.7E+308 ECU_ADDRESS 0x002B8E50
 /begin IF_DATA XCP
  /begin DAQ_EVENT VARIABLE /begin DEFAULT_EVENT_LIST EVENT 0x0000 /end DEFAULT_EVENT_LIST /end DAQ_EVENT
 /end IF_DATA
/end MEASUREMENT
/begin MEASUREMENT inverter_hil_B.Cmdhil_cmd_pedals_plausibility_ "" UBYTE inverter_hil_CM_boolean 0 0 0 1 ECU_ADDRESS 0x002BA2AD
 /begin IF_DATA XCP
  /begin DAQ_EVENT VARIABLE /begin DEFAULT_EVENT_LIST EVENT 0x0000 /end DEFAULT_EVENT_LIST /end DAQ_EVENT
 /end IF_DATA
/end MEASUREMENT
/begin MEASUREMENT inverter_hil_B.Cmdhil_cmd_pedals_throttle "" FLOAT64_IEEE inverter_hil_CM_double 0 0 -1.7E+308 1.7E+308 ECU_ADDRESS 0x002B8E58
 /begin IF_DATA XCP
  /begin DAQ_EVENT VARIABLE /begin DEFAULT_EVENT_LIST EVENT 0x0000 /end DEFAULT_EVENT_LIST /end DAQ_EVENT
 /end IF_DATA
/end MEASUREMENT
/begin MEASUREMENT inverter_hil_B.DropStatusMaskRT "" UWORD inverter_hil_CM_uint16 0 0 0 65535 ECU_ADDRESS 0x002BA12C
 /begin IF_DATA XCP
  /begin DAQ_EVENT VARIABLE /begin DEFAULT_EVENT_LIST EVENT 0x0001 /end DEFAULT_EVENT_LIST /end DAQ_EVENT
 /end IF_DATA
/end MEASUREMENT
/begin MEASUREMENT inverter_hil_B.EphorusRXObservationRT "" FLOAT64_IEEE inverter_hil_CM_double 0 0 -1.7E+308 1.7E+308 LAYOUT COLUMN_DIR MATRIX_DIM 14 13 ECU_ADDRESS 0x002B8E60
 /begin IF_DATA XCP
  /begin DAQ_EVENT VARIABLE /begin DEFAULT_EVENT_LIST EVENT 0x0001 /end DEFAULT_EVENT_LIST /end DAQ_EVENT
 /end IF_DATA
/end MEASUREMENT
/begin MEASUREMENT inverter_hil_B.GuiCmdDcLink12VRT "" FLOAT64_IEEE inverter_hil_CM_double 0 0 -1.7E+308 1.7E+308 ECU_ADDRESS 0x002B9430
 /begin IF_DATA XCP
  /begin DAQ_EVENT VARIABLE /begin DEFAULT_EVENT_LIST EVENT 0x0001 /end DEFAULT_EVENT_LIST /end DAQ_EVENT
 /end IF_DATA
/end MEASUREMENT
/begin MEASUREMENT inverter_hil_B.GuiCmdDcLink34VRT "" FLOAT64_IEEE inverter_hil_CM_double 0 0 -1.7E+308 1.7E+308 ECU_ADDRESS 0x002B9438
 /begin IF_DATA XCP
  /begin DAQ_EVENT VARIABLE /begin DEFAULT_EVENT_LIST EVENT 0x0001 /end DEFAULT_EVENT_LIST /end DAQ_EVENT
 /end IF_DATA
/end MEASUREMENT
/begin MEASUREMENT inverter_hil_B.GuiCmdInverter1ConnectedRT "" UBYTE inverter_hil_CM_boolean 0 0 0 1 ECU_ADDRESS 0x002BA2B3
 /begin IF_DATA XCP
  /begin DAQ_EVENT VARIABLE /begin DEFAULT_EVENT_LIST EVENT 0x0001 /end DEFAULT_EVENT_LIST /end DAQ_EVENT
 /end IF_DATA
/end MEASUREMENT
/begin MEASUREMENT inverter_hil_B.GuiCmdInverter1LoadNmRT "" FLOAT64_IEEE inverter_hil_CM_double 0 0 -1.7E+308 1.7E+308 ECU_ADDRESS 0x002B9410
 /begin IF_DATA XCP
  /begin DAQ_EVENT VARIABLE /begin DEFAULT_EVENT_LIST EVENT 0x0001 /end DEFAULT_EVENT_LIST /end DAQ_EVENT
 /end IF_DATA
/end MEASUREMENT
/begin MEASUREMENT inverter_hil_B.GuiCmdInverter2ConnectedRT "" UBYTE inverter_hil_CM_boolean 0 0 0 1 ECU_ADDRESS 0x002BA2B4
 /begin IF_DATA XCP
  /begin DAQ_EVENT VARIABLE /begin DEFAULT_EVENT_LIST EVENT 0x0001 /end DEFAULT_EVENT_LIST /end DAQ_EVENT
 /end IF_DATA
/end MEASUREMENT
/begin MEASUREMENT inverter_hil_B.GuiCmdInverter2LoadNmRT "" FLOAT64_IEEE inverter_hil_CM_double 0 0 -1.7E+308 1.7E+308 ECU_ADDRESS 0x002B9418
 /begin IF_DATA XCP
  /begin DAQ_EVENT VARIABLE /begin DEFAULT_EVENT_LIST EVENT 0x0001 /end DEFAULT_EVENT_LIST /end DAQ_EVENT
 /end IF_DATA
/end MEASUREMENT
/begin MEASUREMENT inverter_hil_B.GuiCmdInverter3ConnectedRT "" UBYTE inverter_hil_CM_boolean 0 0 0 1 ECU_ADDRESS 0x002BA2B5
 /begin IF_DATA XCP
  /begin DAQ_EVENT VARIABLE /begin DEFAULT_EVENT_LIST EVENT 0x0001 /end DEFAULT_EVENT_LIST /end DAQ_EVENT
 /end IF_DATA
/end MEASUREMENT
/begin MEASUREMENT inverter_hil_B.GuiCmdInverter3LoadNmRT "" FLOAT64_IEEE inverter_hil_CM_double 0 0 -1.7E+308 1.7E+308 ECU_ADDRESS 0x002B9420
 /begin IF_DATA XCP
  /begin DAQ_EVENT VARIABLE /begin DEFAULT_EVENT_LIST EVENT 0x0001 /end DEFAULT_EVENT_LIST /end DAQ_EVENT
 /end IF_DATA
/end MEASUREMENT
/begin MEASUREMENT inverter_hil_B.GuiCmdInverter4ConnectedRT "" UBYTE inverter_hil_CM_boolean 0 0 0 1 ECU_ADDRESS 0x002BA2B6
 /begin IF_DATA XCP
  /begin DAQ_EVENT VARIABLE /begin DEFAULT_EVENT_LIST EVENT 0x0001 /end DEFAULT_EVENT_LIST /end DAQ_EVENT
 /end IF_DATA
/end MEASUREMENT
/begin MEASUREMENT inverter_hil_B.GuiCmdInverter4LoadNmRT "" FLOAT64_IEEE inverter_hil_CM_double 0 0 -1.7E+308 1.7E+308 ECU_ADDRESS 0x002B9428
 /begin IF_DATA XCP
  /begin DAQ_EVENT VARIABLE /begin DEFAULT_EVENT_LIST EVENT 0x0001 /end DEFAULT_EVENT_LIST /end DAQ_EVENT
 /end IF_DATA
/end MEASUREMENT
/begin MEASUREMENT inverter_hil_B.IO183AI01AI04RailMonitor_o1 "" FLOAT64_IEEE inverter_hil_CM_double 0 0 -1.7E+308 1.7E+308 ECU_ADDRESS 0x002B8A00
 /begin IF_DATA XCP
  /begin DAQ_EVENT VARIABLE /begin DEFAULT_EVENT_LIST EVENT 0x0000 /end DEFAULT_EVENT_LIST /end DAQ_EVENT
 /end IF_DATA
/end MEASUREMENT
/begin MEASUREMENT inverter_hil_B.IO183AI01AI04RailMonitor_o2 "" FLOAT64_IEEE inverter_hil_CM_double 0 0 -1.7E+308 1.7E+308 ECU_ADDRESS 0x002B8A08
 /begin IF_DATA XCP
  /begin DAQ_EVENT VARIABLE /begin DEFAULT_EVENT_LIST EVENT 0x0000 /end DEFAULT_EVENT_LIST /end DAQ_EVENT
 /end IF_DATA
/end MEASUREMENT
/begin MEASUREMENT inverter_hil_B.IO183AI01AI04RailMonitor_o3 "" FLOAT64_IEEE inverter_hil_CM_double 0 0 -1.7E+308 1.7E+308 ECU_ADDRESS 0x002B8A10
 /begin IF_DATA XCP
  /begin DAQ_EVENT VARIABLE /begin DEFAULT_EVENT_LIST EVENT 0x0000 /end DEFAULT_EVENT_LIST /end DAQ_EVENT
 /end IF_DATA
/end MEASUREMENT
/begin MEASUREMENT inverter_hil_B.IO183AI01AI04RailMonitor_o4 "" FLOAT64_IEEE inverter_hil_CM_double 0 0 -1.7E+308 1.7E+308 ECU_ADDRESS 0x002B8A18
 /begin IF_DATA XCP
  /begin DAQ_EVENT VARIABLE /begin DEFAULT_EVENT_LIST EVENT 0x0000 /end DEFAULT_EVENT_LIST /end DAQ_EVENT
 /end IF_DATA
/end MEASUREMENT
/begin MEASUREMENT inverter_hil_B.IO183DIO09DIO13VCUMonitor_o1 "" FLOAT64_IEEE inverter_hil_CM_double 0 0 -1.7E+308 1.7E+308 ECU_ADDRESS 0x002B8A20
 /begin IF_DATA XCP
  /begin DAQ_EVENT VARIABLE /begin DEFAULT_EVENT_LIST EVENT 0x0000 /end DEFAULT_EVENT_LIST /end DAQ_EVENT
 /end IF_DATA
/end MEASUREMENT
/begin MEASUREMENT inverter_hil_B.IO183DIO09DIO13VCUMonitor_o2 "" FLOAT64_IEEE inverter_hil_CM_double 0 0 -1.7E+308 1.7E+308 ECU_ADDRESS 0x002B8A28
 /begin IF_DATA XCP
  /begin DAQ_EVENT VARIABLE /begin DEFAULT_EVENT_LIST EVENT 0x0000 /end DEFAULT_EVENT_LIST /end DAQ_EVENT
 /end IF_DATA
/end MEASUREMENT
/begin MEASUREMENT inverter_hil_B.IO183DIO09DIO13VCUMonitor_o3 "" FLOAT64_IEEE inverter_hil_CM_double 0 0 -1.7E+308 1.7E+308 ECU_ADDRESS 0x002B8A30
 /begin IF_DATA XCP
  /begin DAQ_EVENT VARIABLE /begin DEFAULT_EVENT_LIST EVENT 0x0000 /end DEFAULT_EVENT_LIST /end DAQ_EVENT
 /end IF_DATA
/end MEASUREMENT
/begin MEASUREMENT inverter_hil_B.IO183DIO09DIO13VCUMonitor_o4 "" FLOAT64_IEEE inverter_hil_CM_double 0 0 -1.7E+308 1.7E+308 ECU_ADDRESS 0x002B8A38
 /begin IF_DATA XCP
  /begin DAQ_EVENT VARIABLE /begin DEFAULT_EVENT_LIST EVENT 0x0000 /end DEFAULT_EVENT_LIST /end DAQ_EVENT
 /end IF_DATA
/end MEASUREMENT
/begin MEASUREMENT inverter_hil_B.IO183DIO09DIO13VCUMonitor_o5 "" FLOAT64_IEEE inverter_hil_CM_double 0 0 -1.7E+308 1.7E+308 ECU_ADDRESS 0x002B8A40
 /begin IF_DATA XCP
  /begin DAQ_EVENT VARIABLE /begin DEFAULT_EVENT_LIST EVENT 0x0000 /end DEFAULT_EVENT_LIST /end DAQ_EVENT
 /end IF_DATA
/end MEASUREMENT
/begin MEASUREMENT inverter_hil_B.IO614CANDiagnostics_o1 "" FLOAT64_IEEE inverter_hil_CM_double 0 0 -1.7E+308 1.7E+308 ECU_ADDRESS 0x002B8B78
 /begin IF_DATA XCP
  /begin DAQ_EVENT VARIABLE /begin DEFAULT_EVENT_LIST EVENT 0x0000 /end DEFAULT_EVENT_LIST /end DAQ_EVENT
 /end IF_DATA
/end MEASUREMENT
/begin MEASUREMENT inverter_hil_B.IO614CANDiagnostics_o2 "" UBYTE inverter_hil_CM_boolean 0 0 0 1 ECU_ADDRESS 0x002BA295
 /begin IF_DATA XCP
  /begin DAQ_EVENT VARIABLE /begin DEFAULT_EVENT_LIST EVENT 0x0000 /end DEFAULT_EVENT_LIST /end DAQ_EVENT
 /end IF_DATA
/end MEASUREMENT
/begin MEASUREMENT inverter_hil_B.IO614CANDiagnostics_o3 "" ULONG inverter_hil_CM_uint32 0 0 0 4294967295 ECU_ADDRESS 0x002BA0B0
 /begin IF_DATA XCP
  /begin DAQ_EVENT VARIABLE /begin DEFAULT_EVENT_LIST EVENT 0x0000 /end DEFAULT_EVENT_LIST /end DAQ_EVENT
 /end IF_DATA
/end MEASUREMENT
/begin MEASUREMENT inverter_hil_B.IO614CANDiagnostics_o4 "" UBYTE inverter_hil_CM_boolean 0 0 0 1 ECU_ADDRESS 0x002BA296
 /begin IF_DATA XCP
  /begin DAQ_EVENT VARIABLE /begin DEFAULT_EVENT_LIST EVENT 0x0000 /end DEFAULT_EVENT_LIST /end DAQ_EVENT
 /end IF_DATA
/end MEASUREMENT
/begin MEASUREMENT inverter_hil_B.IO614CANDiagnostics_o5 "" UBYTE inverter_hil_CM_boolean 0 0 0 1 ECU_ADDRESS 0x002BA297
 /begin IF_DATA XCP
  /begin DAQ_EVENT VARIABLE /begin DEFAULT_EVENT_LIST EVENT 0x0000 /end DEFAULT_EVENT_LIST /end DAQ_EVENT
 /end IF_DATA
/end MEASUREMENT
/begin MEASUREMENT inverter_hil_B.IO614CANDiagnostics_o6 "" UBYTE inverter_hil_CM_boolean 0 0 0 1 ECU_ADDRESS 0x002BA298
 /begin IF_DATA XCP
  /begin DAQ_EVENT VARIABLE /begin DEFAULT_EVENT_LIST EVENT 0x0000 /end DEFAULT_EVENT_LIST /end DAQ_EVENT
 /end IF_DATA
/end MEASUREMENT
/begin MEASUREMENT inverter_hil_B.IO614CANFIFOReadRaw_o1 "" UBYTE inverter_hil_CM_boolean 0 0 0 1 ECU_ADDRESS 0x002BA294
 /begin IF_DATA XCP
  /begin DAQ_EVENT VARIABLE /begin DEFAULT_EVENT_LIST EVENT 0x0000 /end DEFAULT_EVENT_LIST /end DAQ_EVENT
 /end IF_DATA
/end MEASUREMENT
/begin MEASUREMENT inverter_hil_B.IO614CANFIFOReadRaw_o2.Data "" UBYTE inverter_hil_CM_uint8 0 0 0 255 LAYOUT COLUMN_DIR MATRIX_DIM 8 ECU_ADDRESS 0x002B8888
 /begin IF_DATA XCP
  /begin DAQ_EVENT VARIABLE /begin DEFAULT_EVENT_LIST EVENT 0x0000 /end DEFAULT_EVENT_LIST /end DAQ_EVENT
 /end IF_DATA
/end MEASUREMENT
/begin MEASUREMENT inverter_hil_B.IO614CANFIFOReadRaw_o2.Error "" UBYTE inverter_hil_CM_uint8 0 0 0 255 ECU_ADDRESS 0x002B887B
 /begin IF_DATA XCP
  /begin DAQ_EVENT VARIABLE /begin DEFAULT_EVENT_LIST EVENT 0x0000 /end DEFAULT_EVENT_LIST /end DAQ_EVENT
 /end IF_DATA
/end MEASUREMENT
/begin MEASUREMENT inverter_hil_B.IO614CANFIFOReadRaw_o2.Extended "" UBYTE inverter_hil_CM_uint8 0 0 0 255 ECU_ADDRESS 0x002B8878
 /begin IF_DATA XCP
  /begin DAQ_EVENT VARIABLE /begin DEFAULT_EVENT_LIST EVENT 0x0000 /end DEFAULT_EVENT_LIST /end DAQ_EVENT
 /end IF_DATA
/end MEASUREMENT
/begin MEASUREMENT inverter_hil_B.IO614CANFIFOReadRaw_o2.ID "" ULONG inverter_hil_CM_uint32 0 0 0 4294967295 ECU_ADDRESS 0x002B887C
 /begin IF_DATA XCP
  /begin DAQ_EVENT VARIABLE /begin DEFAULT_EVENT_LIST EVENT 0x0000 /end DEFAULT_EVENT_LIST /end DAQ_EVENT
 /end IF_DATA
/end MEASUREMENT
/begin MEASUREMENT inverter_hil_B.IO614CANFIFOReadRaw_o2.Length "" UBYTE inverter_hil_CM_uint8 0 0 0 255 ECU_ADDRESS 0x002B8879
 /begin IF_DATA XCP
  /begin DAQ_EVENT VARIABLE /begin DEFAULT_EVENT_LIST EVENT 0x0000 /end DEFAULT_EVENT_LIST /end DAQ_EVENT
 /end IF_DATA
/end MEASUREMENT
/begin MEASUREMENT inverter_hil_B.IO614CANFIFOReadRaw_o2.Remote "" UBYTE inverter_hil_CM_uint8 0 0 0 255 ECU_ADDRESS 0x002B887A
 /begin IF_DATA XCP
  /begin DAQ_EVENT VARIABLE /begin DEFAULT_EVENT_LIST EVENT 0x0000 /end DEFAULT_EVENT_LIST /end DAQ_EVENT
 /end IF_DATA
/end MEASUREMENT
/begin MEASUREMENT inverter_hil_B.IO614CANFIFOReadRaw_o2.Timestamp "" FLOAT64_IEEE inverter_hil_CM_double 0 0 -1.7E+308 1.7E+308 ECU_ADDRESS 0x002B8880
 /begin IF_DATA XCP
  /begin DAQ_EVENT VARIABLE /begin DEFAULT_EVENT_LIST EVENT 0x0000 /end DEFAULT_EVENT_LIST /end DAQ_EVENT
 /end IF_DATA
/end MEASUREMENT
/begin MEASUREMENT inverter_hil_B.Module2AI01AI04_o1 "" FLOAT64_IEEE inverter_hil_CM_double 0 0 -1.7E+308 1.7E+308 ECU_ADDRESS 0x002B89E0
 /begin IF_DATA XCP
  /begin DAQ_EVENT VARIABLE /begin DEFAULT_EVENT_LIST EVENT 0x0000 /end DEFAULT_EVENT_LIST /end DAQ_EVENT
 /end IF_DATA
/end MEASUREMENT
/begin MEASUREMENT inverter_hil_B.Module2AI01AI04_o2 "" FLOAT64_IEEE inverter_hil_CM_double 0 0 -1.7E+308 1.7E+308 ECU_ADDRESS 0x002B89E8
 /begin IF_DATA XCP
  /begin DAQ_EVENT VARIABLE /begin DEFAULT_EVENT_LIST EVENT 0x0000 /end DEFAULT_EVENT_LIST /end DAQ_EVENT
 /end IF_DATA
/end MEASUREMENT
/begin MEASUREMENT inverter_hil_B.Module2AI01AI04_o3 "" FLOAT64_IEEE inverter_hil_CM_double 0 0 -1.7E+308 1.7E+308 ECU_ADDRESS 0x002B89F0
 /begin IF_DATA XCP
  /begin DAQ_EVENT VARIABLE /begin DEFAULT_EVENT_LIST EVENT 0x0000 /end DEFAULT_EVENT_LIST /end DAQ_EVENT
 /end IF_DATA
/end MEASUREMENT
/begin MEASUREMENT inverter_hil_B.Module2AI01AI04_o4 "" FLOAT64_IEEE inverter_hil_CM_double 0 0 -1.7E+308 1.7E+308 ECU_ADDRESS 0x002B89F8
 /begin IF_DATA XCP
  /begin DAQ_EVENT VARIABLE /begin DEFAULT_EVENT_LIST EVENT 0x0000 /end DEFAULT_EVENT_LIST /end DAQ_EVENT
 /end IF_DATA
/end MEASUREMENT
/begin MEASUREMENT inverter_hil_B.Module2DI01DI08_o1 "" FLOAT64_IEEE inverter_hil_CM_double 0 0 -1.7E+308 1.7E+308 ECU_ADDRESS 0x002B8AE8
 /begin IF_DATA XCP
  /begin DAQ_EVENT VARIABLE /begin DEFAULT_EVENT_LIST EVENT 0x0000 /end DEFAULT_EVENT_LIST /end DAQ_EVENT
 /end IF_DATA
/end MEASUREMENT
/begin MEASUREMENT inverter_hil_B.Module2DI01DI08_o2 "" FLOAT64_IEEE inverter_hil_CM_double 0 0 -1.7E+308 1.7E+308 ECU_ADDRESS 0x002B8AF0
 /begin IF_DATA XCP
  /begin DAQ_EVENT VARIABLE /begin DEFAULT_EVENT_LIST EVENT 0x0000 /end DEFAULT_EVENT_LIST /end DAQ_EVENT
 /end IF_DATA
/end MEASUREMENT
/begin MEASUREMENT inverter_hil_B.Module2DI01DI08_o3 "" FLOAT64_IEEE inverter_hil_CM_double 0 0 -1.7E+308 1.7E+308 ECU_ADDRESS 0x002B8AF8
 /begin IF_DATA XCP
  /begin DAQ_EVENT VARIABLE /begin DEFAULT_EVENT_LIST EVENT 0x0000 /end DEFAULT_EVENT_LIST /end DAQ_EVENT
 /end IF_DATA
/end MEASUREMENT
/begin MEASUREMENT inverter_hil_B.Module2DI01DI08_o4 "" FLOAT64_IEEE inverter_hil_CM_double 0 0 -1.7E+308 1.7E+308 ECU_ADDRESS 0x002B8B00
 /begin IF_DATA XCP
  /begin DAQ_EVENT VARIABLE /begin DEFAULT_EVENT_LIST EVENT 0x0000 /end DEFAULT_EVENT_LIST /end DAQ_EVENT
 /end IF_DATA
/end MEASUREMENT
/begin MEASUREMENT inverter_hil_B.Module2DI01DI08_o5 "" FLOAT64_IEEE inverter_hil_CM_double 0 0 -1.7E+308 1.7E+308 ECU_ADDRESS 0x002B8B08
 /begin IF_DATA XCP
  /begin DAQ_EVENT VARIABLE /begin DEFAULT_EVENT_LIST EVENT 0x0000 /end DEFAULT_EVENT_LIST /end DAQ_EVENT
 /end IF_DATA
/end MEASUREMENT
/begin MEASUREMENT inverter_hil_B.Module2DI01DI08_o6 "" FLOAT64_IEEE inverter_hil_CM_double 0 0 -1.7E+308 1.7E+308 ECU_ADDRESS 0x002B8B10
 /begin IF_DATA XCP
  /begin DAQ_EVENT VARIABLE /begin DEFAULT_EVENT_LIST EVENT 0x0000 /end DEFAULT_EVENT_LIST /end DAQ_EVENT
 /end IF_DATA
/end MEASUREMENT
/begin MEASUREMENT inverter_hil_B.Module2DI01DI08_o7 "" FLOAT64_IEEE inverter_hil_CM_double 0 0 -1.7E+308 1.7E+308 ECU_ADDRESS 0x002B8B18
 /begin IF_DATA XCP
  /begin DAQ_EVENT VARIABLE /begin DEFAULT_EVENT_LIST EVENT 0x0000 /end DEFAULT_EVENT_LIST /end DAQ_EVENT
 /end IF_DATA
/end MEASUREMENT
/begin MEASUREMENT inverter_hil_B.Module2DI01DI08_o8 "" FLOAT64_IEEE inverter_hil_CM_double 0 0 -1.7E+308 1.7E+308 ECU_ADDRESS 0x002B8B20
 /begin IF_DATA XCP
  /begin DAQ_EVENT VARIABLE /begin DEFAULT_EVENT_LIST EVENT 0x0000 /end DEFAULT_EVENT_LIST /end DAQ_EVENT
 /end IF_DATA
/end MEASUREMENT
/begin MEASUREMENT inverter_hil_B.PortACANFIFORead_o1 "" UBYTE inverter_hil_CM_boolean 0 0 0 1 ECU_ADDRESS 0x002BA292
 /begin IF_DATA XCP
  /begin DAQ_EVENT VARIABLE /begin DEFAULT_EVENT_LIST EVENT 0x0000 /end DEFAULT_EVENT_LIST /end DAQ_EVENT
 /end IF_DATA
/end MEASUREMENT
/begin MEASUREMENT inverter_hil_B.PortACANFIFORead_o2.Data "" UBYTE inverter_hil_CM_uint8 0 0 0 255 LAYOUT COLUMN_DIR MATRIX_DIM 8 ECU_ADDRESS 0x002B8870
 /begin IF_DATA XCP
  /begin DAQ_EVENT VARIABLE /begin DEFAULT_EVENT_LIST EVENT 0x0000 /end DEFAULT_EVENT_LIST /end DAQ_EVENT
 /end IF_DATA
/end MEASUREMENT
/begin MEASUREMENT inverter_hil_B.PortACANFIFORead_o2.Error "" UBYTE inverter_hil_CM_uint8 0 0 0 255 ECU_ADDRESS 0x002B8863
 /begin IF_DATA XCP
  /begin DAQ_EVENT VARIABLE /begin DEFAULT_EVENT_LIST EVENT 0x0000 /end DEFAULT_EVENT_LIST /end DAQ_EVENT
 /end IF_DATA
/end MEASUREMENT
/begin MEASUREMENT inverter_hil_B.PortACANFIFORead_o2.Extended "" UBYTE inverter_hil_CM_uint8 0 0 0 255 ECU_ADDRESS 0x002B8860
 /begin IF_DATA XCP
  /begin DAQ_EVENT VARIABLE /begin DEFAULT_EVENT_LIST EVENT 0x0000 /end DEFAULT_EVENT_LIST /end DAQ_EVENT
 /end IF_DATA
/end MEASUREMENT
/begin MEASUREMENT inverter_hil_B.PortACANFIFORead_o2.ID "" ULONG inverter_hil_CM_uint32 0 0 0 4294967295 ECU_ADDRESS 0x002B8864
 /begin IF_DATA XCP
  /begin DAQ_EVENT VARIABLE /begin DEFAULT_EVENT_LIST EVENT 0x0000 /end DEFAULT_EVENT_LIST /end DAQ_EVENT
 /end IF_DATA
/end MEASUREMENT
/begin MEASUREMENT inverter_hil_B.PortACANFIFORead_o2.Length "" UBYTE inverter_hil_CM_uint8 0 0 0 255 ECU_ADDRESS 0x002B8861
 /begin IF_DATA XCP
  /begin DAQ_EVENT VARIABLE /begin DEFAULT_EVENT_LIST EVENT 0x0000 /end DEFAULT_EVENT_LIST /end DAQ_EVENT
 /end IF_DATA
/end MEASUREMENT
/begin MEASUREMENT inverter_hil_B.PortACANFIFORead_o2.Remote "" UBYTE inverter_hil_CM_uint8 0 0 0 255 ECU_ADDRESS 0x002B8862
 /begin IF_DATA XCP
  /begin DAQ_EVENT VARIABLE /begin DEFAULT_EVENT_LIST EVENT 0x0000 /end DEFAULT_EVENT_LIST /end DAQ_EVENT
 /end IF_DATA
/end MEASUREMENT
/begin MEASUREMENT inverter_hil_B.PortACANFIFORead_o2.Timestamp "" FLOAT64_IEEE inverter_hil_CM_double 0 0 -1.7E+308 1.7E+308 ECU_ADDRESS 0x002B8868
 /begin IF_DATA XCP
  /begin DAQ_EVENT VARIABLE /begin DEFAULT_EVENT_LIST EVENT 0x0000 /end DEFAULT_EVENT_LIST /end DAQ_EVENT
 /end IF_DATA
/end MEASUREMENT
/begin MEASUREMENT inverter_hil_B.PortACANWrite1 "" UBYTE inverter_hil_CM_boolean 0 0 0 1 ECU_ADDRESS 0x002BA2AE
 /begin IF_DATA XCP
  /begin DAQ_EVENT VARIABLE /begin DEFAULT_EVENT_LIST EVENT 0x0001 /end DEFAULT_EVENT_LIST /end DAQ_EVENT
 /end IF_DATA
/end MEASUREMENT
/begin MEASUREMENT inverter_hil_B.PortACANWrite2 "" UBYTE inverter_hil_CM_boolean 0 0 0 1 ECU_ADDRESS 0x002BA2AF
 /begin IF_DATA XCP
  /begin DAQ_EVENT VARIABLE /begin DEFAULT_EVENT_LIST EVENT 0x0001 /end DEFAULT_EVENT_LIST /end DAQ_EVENT
 /end IF_DATA
/end MEASUREMENT
/begin MEASUREMENT inverter_hil_B.PortACANWrite3 "" UBYTE inverter_hil_CM_boolean 0 0 0 1 ECU_ADDRESS 0x002BA2B0
 /begin IF_DATA XCP
  /begin DAQ_EVENT VARIABLE /begin DEFAULT_EVENT_LIST EVENT 0x0001 /end DEFAULT_EVENT_LIST /end DAQ_EVENT
 /end IF_DATA
/end MEASUREMENT
/begin MEASUREMENT inverter_hil_B.PortACANWrite4 "" UBYTE inverter_hil_CM_boolean 0 0 0 1 ECU_ADDRESS 0x002BA2B1
 /begin IF_DATA XCP
  /begin DAQ_EVENT VARIABLE /begin DEFAULT_EVENT_LIST EVENT 0x0001 /end DEFAULT_EVENT_LIST /end DAQ_EVENT
 /end IF_DATA
/end MEASUREMENT
/begin MEASUREMENT inverter_hil_B.PortACANWrite5 "" UBYTE inverter_hil_CM_boolean 0 0 0 1 ECU_ADDRESS 0x002BA2B2
 /begin IF_DATA XCP
  /begin DAQ_EVENT VARIABLE /begin DEFAULT_EVENT_LIST EVENT 0x0001 /end DEFAULT_EVENT_LIST /end DAQ_EVENT
 /end IF_DATA
/end MEASUREMENT
/begin MEASUREMENT inverter_hil_B.PortAPayloadRateTransition1 "" UBYTE inverter_hil_CM_uint8 0 0 0 255 LAYOUT COLUMN_DIR MATRIX_DIM 1 8 ECU_ADDRESS 0x002BA1AE
 /begin IF_DATA XCP
  /begin DAQ_EVENT VARIABLE /begin DEFAULT_EVENT_LIST EVENT 0x0001 /end DEFAULT_EVENT_LIST /end DAQ_EVENT
 /end IF_DATA
/end MEASUREMENT
/begin MEASUREMENT inverter_hil_B.PortAPayloadRateTransition2 "" UBYTE inverter_hil_CM_uint8 0 0 0 255 LAYOUT COLUMN_DIR MATRIX_DIM 1 8 ECU_ADDRESS 0x002BA1B6
 /begin IF_DATA XCP
  /begin DAQ_EVENT VARIABLE /begin DEFAULT_EVENT_LIST EVENT 0x0001 /end DEFAULT_EVENT_LIST /end DAQ_EVENT
 /end IF_DATA
/end MEASUREMENT
/begin MEASUREMENT inverter_hil_B.PortAPayloadRateTransition3 "" UBYTE inverter_hil_CM_uint8 0 0 0 255 LAYOUT COLUMN_DIR MATRIX_DIM 1 8 ECU_ADDRESS 0x002BA1BE
 /begin IF_DATA XCP
  /begin DAQ_EVENT VARIABLE /begin DEFAULT_EVENT_LIST EVENT 0x0001 /end DEFAULT_EVENT_LIST /end DAQ_EVENT
 /end IF_DATA
/end MEASUREMENT
/begin MEASUREMENT inverter_hil_B.PortAPayloadRateTransition4 "" UBYTE inverter_hil_CM_uint8 0 0 0 255 LAYOUT COLUMN_DIR MATRIX_DIM 1 8 ECU_ADDRESS 0x002BA1C6
 /begin IF_DATA XCP
  /begin DAQ_EVENT VARIABLE /begin DEFAULT_EVENT_LIST EVENT 0x0001 /end DEFAULT_EVENT_LIST /end DAQ_EVENT
 /end IF_DATA
/end MEASUREMENT
/begin MEASUREMENT inverter_hil_B.PortAPayloadRateTransition5 "" UBYTE inverter_hil_CM_uint8 0 0 0 255 LAYOUT COLUMN_DIR MATRIX_DIM 1 8 ECU_ADDRESS 0x002BA1CE
 /begin IF_DATA XCP
  /begin DAQ_EVENT VARIABLE /begin DEFAULT_EVENT_LIST EVENT 0x0001 /end DEFAULT_EVENT_LIST /end DAQ_EVENT
 /end IF_DATA
/end MEASUREMENT
/begin MEASUREMENT inverter_hil_B.Refhil_cmd_xcp_pedals_active "" UBYTE inverter_hil_CM_boolean 0 0 0 1 ECU_ADDRESS 0x002BA293
 /begin IF_DATA XCP
  /begin DAQ_EVENT VARIABLE /begin DEFAULT_EVENT_LIST EVENT 0x0000 /end DEFAULT_EVENT_LIST /end DAQ_EVENT
 /end IF_DATA
/end MEASUREMENT
/begin MEASUREMENT inverter_hil_B.Refhil_cmd_xcp_pedals_brake "" FLOAT64_IEEE inverter_hil_CM_double 0 0 -1.7E+308 1.7E+308 ECU_ADDRESS 0x002B8B38
 /begin IF_DATA XCP
  /begin DAQ_EVENT VARIABLE /begin DEFAULT_EVENT_LIST EVENT 0x0000 /end DEFAULT_EVENT_LIST /end DAQ_EVENT
 /end IF_DATA
/end MEASUREMENT
/begin MEASUREMENT inverter_hil_B.Refhil_cmd_xcp_pedals_throttle "" FLOAT64_IEEE inverter_hil_CM_double 0 0 -1.7E+308 1.7E+308 ECU_ADDRESS 0x002B8B28
 /begin IF_DATA XCP
  /begin DAQ_EVENT VARIABLE /begin DEFAULT_EVENT_LIST EVENT 0x0000 /end DEFAULT_EVENT_LIST /end DAQ_EVENT
 /end IF_DATA
/end MEASUREMENT
/begin MEASUREMENT inverter_hil_B.SafeCANDiagnostics "" ULONG inverter_hil_CM_uint32 0 0 0 4294967295 LAYOUT COLUMN_DIR MATRIX_DIM 8 ECU_ADDRESS 0x002BA0C4
 /begin IF_DATA XCP
  /begin DAQ_EVENT VARIABLE /begin DEFAULT_EVENT_LIST EVENT 0x0000 /end DEFAULT_EVENT_LIST /end DAQ_EVENT
 /end IF_DATA
/end MEASUREMENT
/begin MEASUREMENT inverter_hil_B.SafeControlFrames "" UBYTE inverter_hil_CM_uint8 0 0 0 255 LAYOUT COLUMN_DIR MATRIX_DIM 8 4 ECU_ADDRESS 0x002BA18E
 /begin IF_DATA XCP
  /begin DAQ_EVENT VARIABLE /begin DEFAULT_EVENT_LIST EVENT 0x0000 /end DEFAULT_EVENT_LIST /end DAQ_EVENT
 /end IF_DATA
/end MEASUREMENT
/begin MEASUREMENT inverter_hil_B.SafeDCLinkV "" FLOAT64_IEEE inverter_hil_CM_double 0 0 -1.7E+308 1.7E+308 LAYOUT COLUMN_DIR MATRIX_DIM 2 ECU_ADDRESS 0x002B8DF0
 /begin IF_DATA XCP
  /begin DAQ_EVENT VARIABLE /begin DEFAULT_EVENT_LIST EVENT 0x0000 /end DEFAULT_EVENT_LIST /end DAQ_EVENT
 /end IF_DATA
/end MEASUREMENT
/begin MEASUREMENT inverter_hil_B.SafeDecodedCommands "" UBYTE inverter_hil_CM_uint8 0 0 0 255 LAYOUT COLUMN_DIR MATRIX_DIM 8 4 ECU_ADDRESS 0x002BA16E
 /begin IF_DATA XCP
  /begin DAQ_EVENT VARIABLE /begin DEFAULT_EVENT_LIST EVENT 0x0000 /end DEFAULT_EVENT_LIST /end DAQ_EVENT
 /end IF_DATA
/end MEASUREMENT
/begin MEASUREMENT inverter_hil_B.SafeDigitalCommand "" UBYTE inverter_hil_CM_boolean 0 0 0 1 LAYOUT COLUMN_DIR MATRIX_DIM 8 ECU_ADDRESS 0x002BA29A
 /begin IF_DATA XCP
  /begin DAQ_EVENT VARIABLE /begin DEFAULT_EVENT_LIST EVENT 0x0000 /end DEFAULT_EVENT_LIST /end DAQ_EVENT
 /end IF_DATA
/end MEASUREMENT
/begin MEASUREMENT inverter_hil_B.SafeDigitalStimulus "" UBYTE inverter_hil_CM_boolean 0 0 0 1 LAYOUT COLUMN_DIR MATRIX_DIM 8 ECU_ADDRESS 0x002BA2A2
 /begin IF_DATA XCP
  /begin DAQ_EVENT VARIABLE /begin DEFAULT_EVENT_LIST EVENT 0x0000 /end DEFAULT_EVENT_LIST /end DAQ_EVENT
 /end IF_DATA
/end MEASUREMENT
/begin MEASUREMENT inverter_hil_B.SafeFaultMask "" ULONG inverter_hil_CM_uint32 0 0 0 4294967295 LAYOUT COLUMN_DIR MATRIX_DIM 4 ECU_ADDRESS 0x002BA0B4
 /begin IF_DATA XCP
  /begin DAQ_EVENT VARIABLE /begin DEFAULT_EVENT_LIST EVENT 0x0000 /end DEFAULT_EVENT_LIST /end DAQ_EVENT
 /end IF_DATA
/end MEASUREMENT
/begin MEASUREMENT inverter_hil_B.SafeLoadTorqueNm "" FLOAT64_IEEE inverter_hil_CM_double 0 0 -1.7E+308 1.7E+308 LAYOUT COLUMN_DIR MATRIX_DIM 4 ECU_ADDRESS 0x002B8DD0
 /begin IF_DATA XCP
  /begin DAQ_EVENT VARIABLE /begin DEFAULT_EVENT_LIST EVENT 0x0000 /end DEFAULT_EVENT_LIST /end DAQ_EVENT
 /end IF_DATA
/end MEASUREMENT
/begin MEASUREMENT inverter_hil_B.SafeObservations_Ch1 "" FLOAT64_IEEE inverter_hil_CM_double 0 0 -1.7E+308 1.7E+308 LAYOUT COLUMN_DIR MATRIX_DIM 16 ECU_ADDRESS 0x002B8B80
 /begin IF_DATA XCP
  /begin DAQ_EVENT VARIABLE /begin DEFAULT_EVENT_LIST EVENT 0x0000 /end DEFAULT_EVENT_LIST /end DAQ_EVENT
 /end IF_DATA
/end MEASUREMENT
/begin MEASUREMENT inverter_hil_B.SafeObservations_Ch2 "" FLOAT64_IEEE inverter_hil_CM_double 0 0 -1.7E+308 1.7E+308 LAYOUT COLUMN_DIR MATRIX_DIM 16 ECU_ADDRESS 0x002B8C00
 /begin IF_DATA XCP
  /begin DAQ_EVENT VARIABLE /begin DEFAULT_EVENT_LIST EVENT 0x0000 /end DEFAULT_EVENT_LIST /end DAQ_EVENT
 /end IF_DATA
/end MEASUREMENT
/begin MEASUREMENT inverter_hil_B.SafeObservations_Ch3 "" FLOAT64_IEEE inverter_hil_CM_double 0 0 -1.7E+308 1.7E+308 LAYOUT COLUMN_DIR MATRIX_DIM 16 ECU_ADDRESS 0x002B8C80
 /begin IF_DATA XCP
  /begin DAQ_EVENT VARIABLE /begin DEFAULT_EVENT_LIST EVENT 0x0000 /end DEFAULT_EVENT_LIST /end DAQ_EVENT
 /end IF_DATA
/end MEASUREMENT
/begin MEASUREMENT inverter_hil_B.SafeObservations_Ch4 "" FLOAT64_IEEE inverter_hil_CM_double 0 0 -1.7E+308 1.7E+308 LAYOUT COLUMN_DIR MATRIX_DIM 16 ECU_ADDRESS 0x002B8D00
 /begin IF_DATA XCP
  /begin DAQ_EVENT VARIABLE /begin DEFAULT_EVENT_LIST EVENT 0x0000 /end DEFAULT_EVENT_LIST /end DAQ_EVENT
 /end IF_DATA
/end MEASUREMENT
/begin MEASUREMENT inverter_hil_B.SafePedalCommand "" FLOAT64_IEEE inverter_hil_CM_double 0 0 -1.7E+308 1.7E+308 LAYOUT COLUMN_DIR MATRIX_DIM 2 ECU_ADDRESS 0x002B8DC0
 /begin IF_DATA XCP
  /begin DAQ_EVENT VARIABLE /begin DEFAULT_EVENT_LIST EVENT 0x0000 /end DEFAULT_EVENT_LIST /end DAQ_EVENT
 /end IF_DATA
/end MEASUREMENT
/begin MEASUREMENT inverter_hil_B.SafePedalVoltageV "" FLOAT64_IEEE inverter_hil_CM_double 0 0 -1.7E+308 1.7E+308 LAYOUT COLUMN_DIR MATRIX_DIM 4 ECU_ADDRESS 0x002B8DA0
 /begin IF_DATA XCP
  /begin DAQ_EVENT VARIABLE /begin DEFAULT_EVENT_LIST EVENT 0x0000 /end DEFAULT_EVENT_LIST /end DAQ_EVENT
 /end IF_DATA
/end MEASUREMENT
/begin MEASUREMENT inverter_hil_B.SafePreflightSafe "" UBYTE inverter_hil_CM_boolean 0 0 0 1 ECU_ADDRESS 0x002BA299
 /begin IF_DATA XCP
  /begin DAQ_EVENT VARIABLE /begin DEFAULT_EVENT_LIST EVENT 0x0000 /end DEFAULT_EVENT_LIST /end DAQ_EVENT
 /end IF_DATA
/end MEASUREMENT
/begin MEASUREMENT inverter_hil_B.SafeStatus3X3_Ch1 "" UBYTE inverter_hil_CM_uint8 0 0 0 255 LAYOUT COLUMN_DIR MATRIX_DIM 8 ECU_ADDRESS 0x002BA12E
 /begin IF_DATA XCP
  /begin DAQ_EVENT VARIABLE /begin DEFAULT_EVENT_LIST EVENT 0x0000 /end DEFAULT_EVENT_LIST /end DAQ_EVENT
 /end IF_DATA
/end MEASUREMENT
/begin MEASUREMENT inverter_hil_B.SafeStatus3X3_Ch2 "" UBYTE inverter_hil_CM_uint8 0 0 0 255 LAYOUT COLUMN_DIR MATRIX_DIM 8 ECU_ADDRESS 0x002BA13E
 /begin IF_DATA XCP
  /begin DAQ_EVENT VARIABLE /begin DEFAULT_EVENT_LIST EVENT 0x0000 /end DEFAULT_EVENT_LIST /end DAQ_EVENT
 /end IF_DATA
/end MEASUREMENT
/begin MEASUREMENT inverter_hil_B.SafeStatus3X3_Ch3 "" UBYTE inverter_hil_CM_uint8 0 0 0 255 LAYOUT COLUMN_DIR MATRIX_DIM 8 ECU_ADDRESS 0x002BA14E
 /begin IF_DATA XCP
  /begin DAQ_EVENT VARIABLE /begin DEFAULT_EVENT_LIST EVENT 0x0000 /end DEFAULT_EVENT_LIST /end DAQ_EVENT
 /end IF_DATA
/end MEASUREMENT
/begin MEASUREMENT inverter_hil_B.SafeStatus3X3_Ch4 "" UBYTE inverter_hil_CM_uint8 0 0 0 255 LAYOUT COLUMN_DIR MATRIX_DIM 8 ECU_ADDRESS 0x002BA15E
 /begin IF_DATA XCP
  /begin DAQ_EVENT VARIABLE /begin DEFAULT_EVENT_LIST EVENT 0x0000 /end DEFAULT_EVENT_LIST /end DAQ_EVENT
 /end IF_DATA
/end MEASUREMENT
/begin MEASUREMENT inverter_hil_B.SafeStatus3X5_Ch1 "" UBYTE inverter_hil_CM_uint8 0 0 0 255 LAYOUT COLUMN_DIR MATRIX_DIM 8 ECU_ADDRESS 0x002BA136
 /begin IF_DATA XCP
  /begin DAQ_EVENT VARIABLE /begin DEFAULT_EVENT_LIST EVENT 0x0000 /end DEFAULT_EVENT_LIST /end DAQ_EVENT
 /end IF_DATA
/end MEASUREMENT
/begin MEASUREMENT inverter_hil_B.SafeStatus3X5_Ch2 "" UBYTE inverter_hil_CM_uint8 0 0 0 255 LAYOUT COLUMN_DIR MATRIX_DIM 8 ECU_ADDRESS 0x002BA146
 /begin IF_DATA XCP
  /begin DAQ_EVENT VARIABLE /begin DEFAULT_EVENT_LIST EVENT 0x0000 /end DEFAULT_EVENT_LIST /end DAQ_EVENT
 /end IF_DATA
/end MEASUREMENT
/begin MEASUREMENT inverter_hil_B.SafeStatus3X5_Ch3 "" UBYTE inverter_hil_CM_uint8 0 0 0 255 LAYOUT COLUMN_DIR MATRIX_DIM 8 ECU_ADDRESS 0x002BA156
 /begin IF_DATA XCP
  /begin DAQ_EVENT VARIABLE /begin DEFAULT_EVENT_LIST EVENT 0x0000 /end DEFAULT_EVENT_LIST /end DAQ_EVENT
 /end IF_DATA
/end MEASUREMENT
/begin MEASUREMENT inverter_hil_B.SafeStatus3X5_Ch4 "" UBYTE inverter_hil_CM_uint8 0 0 0 255 LAYOUT COLUMN_DIR MATRIX_DIM 8 ECU_ADDRESS 0x002BA166
 /begin IF_DATA XCP
  /begin DAQ_EVENT VARIABLE /begin DEFAULT_EVENT_LIST EVENT 0x0000 /end DEFAULT_EVENT_LIST /end DAQ_EVENT
 /end IF_DATA
/end MEASUREMENT
/begin MEASUREMENT inverter_hil_B.ThrottleSourceSwitch "" FLOAT64_IEEE inverter_hil_CM_double 0 0 -1.7E+308 1.7E+308 ECU_ADDRESS 0x002B8B30
 /begin IF_DATA XCP
  /begin DAQ_EVENT VARIABLE /begin DEFAULT_EVENT_LIST EVENT 0x0000 /end DEFAULT_EVENT_LIST /end DAQ_EVENT
 /end IF_DATA
/end MEASUREMENT
/begin MEASUREMENT inverter_hil_B.TmpSignalConversionAtSFunctionI "" FLOAT64_IEEE inverter_hil_CM_double 0 0 -1.7E+308 1.7E+308 LAYOUT COLUMN_DIR MATRIX_DIM 24 ECU_ADDRESS 0x002B9440
 /begin IF_DATA XCP
  /begin DAQ_EVENT VARIABLE /begin DEFAULT_EVENT_LIST EVENT 0x0000 /end DEFAULT_EVENT_LIST /end DAQ_EVENT
 /end IF_DATA
/end MEASUREMENT
/begin MEASUREMENT inverter_hil_B.UnusedSW_IN_1 "" FLOAT64_IEEE inverter_hil_CM_double 0 0 -1.7E+308 1.7E+308 ECU_ADDRESS 0x002B8B58
 /begin IF_DATA XCP
  /begin DAQ_EVENT VARIABLE /begin DEFAULT_EVENT_LIST EVENT 0x0000 /end DEFAULT_EVENT_LIST /end DAQ_EVENT
 /end IF_DATA
/end MEASUREMENT
/begin MEASUREMENT inverter_hil_B.UnusedSW_IN_2 "" FLOAT64_IEEE inverter_hil_CM_double 0 0 -1.7E+308 1.7E+308 ECU_ADDRESS 0x002B8B60
 /begin IF_DATA XCP
  /begin DAQ_EVENT VARIABLE /begin DEFAULT_EVENT_LIST EVENT 0x0000 /end DEFAULT_EVENT_LIST /end DAQ_EVENT
 /end IF_DATA
/end MEASUREMENT
/begin MEASUREMENT inverter_hil_B.UnusedSW_IN_3 "" FLOAT64_IEEE inverter_hil_CM_double 0 0 -1.7E+308 1.7E+308 ECU_ADDRESS 0x002B8B68
 /begin IF_DATA XCP
  /begin DAQ_EVENT VARIABLE /begin DEFAULT_EVENT_LIST EVENT 0x0000 /end DEFAULT_EVENT_LIST /end DAQ_EVENT
 /end IF_DATA
/end MEASUREMENT
/begin MEASUREMENT inverter_hil_B.UnusedSW_IN_4 "" FLOAT64_IEEE inverter_hil_CM_double 0 0 -1.7E+308 1.7E+308 ECU_ADDRESS 0x002B8B70
 /begin IF_DATA XCP
  /begin DAQ_EVENT VARIABLE /begin DEFAULT_EVENT_LIST EVENT 0x0000 /end DEFAULT_EVENT_LIST /end DAQ_EVENT
 /end IF_DATA
/end MEASUREMENT
/begin MEASUREMENT inverter_hil_B.VCUInputDouble2 "" FLOAT64_IEEE inverter_hil_CM_double 0 0 -1.7E+308 1.7E+308 LAYOUT COLUMN_DIR MATRIX_DIM 8 ECU_ADDRESS 0x002B8A48
 /begin IF_DATA XCP
  /begin DAQ_EVENT VARIABLE /begin DEFAULT_EVENT_LIST EVENT 0x0000 /end DEFAULT_EVENT_LIST /end DAQ_EVENT
 /end IF_DATA
/end MEASUREMENT
/begin MEASUREMENT inverter_hil_B.VCUInputDouble3 "" FLOAT64_IEEE inverter_hil_CM_double 0 0 -1.7E+308 1.7E+308 ECU_ADDRESS 0x002B8A88
 /begin IF_DATA XCP
  /begin DAQ_EVENT VARIABLE /begin DEFAULT_EVENT_LIST EVENT 0x0000 /end DEFAULT_EVENT_LIST /end DAQ_EVENT
 /end IF_DATA
/end MEASUREMENT
/begin MEASUREMENT inverter_hil_B.VCUInputDouble4 "" FLOAT64_IEEE inverter_hil_CM_double 0 0 -1.7E+308 1.7E+308 ECU_ADDRESS 0x002B8A90
 /begin IF_DATA XCP
  /begin DAQ_EVENT VARIABLE /begin DEFAULT_EVENT_LIST EVENT 0x0000 /end DEFAULT_EVENT_LIST /end DAQ_EVENT
 /end IF_DATA
/end MEASUREMENT
/begin MEASUREMENT inverter_hil_B.VCUInputDouble5 "" FLOAT64_IEEE inverter_hil_CM_double 0 0 -1.7E+308 1.7E+308 ECU_ADDRESS 0x002B8A98
 /begin IF_DATA XCP
  /begin DAQ_EVENT VARIABLE /begin DEFAULT_EVENT_LIST EVENT 0x0000 /end DEFAULT_EVENT_LIST /end DAQ_EVENT
 /end IF_DATA
/end MEASUREMENT
/begin MEASUREMENT inverter_hil_B.VCUInputDouble6 "" FLOAT64_IEEE inverter_hil_CM_double 0 0 -1.7E+308 1.7E+308 ECU_ADDRESS 0x002B8AA0
 /begin IF_DATA XCP
  /begin DAQ_EVENT VARIABLE /begin DEFAULT_EVENT_LIST EVENT 0x0000 /end DEFAULT_EVENT_LIST /end DAQ_EVENT
 /end IF_DATA
/end MEASUREMENT
/begin MEASUREMENT inverter_hil_B.VCUInputDouble7 "" FLOAT64_IEEE inverter_hil_CM_double 0 0 -1.7E+308 1.7E+308 LAYOUT COLUMN_DIR MATRIX_DIM 8 ECU_ADDRESS 0x002B8AA8
 /begin IF_DATA XCP
  /begin DAQ_EVENT VARIABLE /begin DEFAULT_EVENT_LIST EVENT 0x0000 /end DEFAULT_EVENT_LIST /end DAQ_EVENT
 /end IF_DATA
/end MEASUREMENT
/begin MEASUREMENT inverter_hil_B.XCPBrakePercentToFraction "" FLOAT64_IEEE inverter_hil_CM_double 0 0 -1.7E+308 1.7E+308 ECU_ADDRESS 0x002B9518
 /begin IF_DATA XCP
  /begin DAQ_EVENT VARIABLE /begin DEFAULT_EVENT_LIST EVENT 0x0000 /end DEFAULT_EVENT_LIST /end DAQ_EVENT
 /end IF_DATA
/end MEASUREMENT
/begin MEASUREMENT inverter_hil_B.XCPThrottlePercentToFraction "" FLOAT64_IEEE inverter_hil_CM_double 0 0 -1.7E+308 1.7E+308 ECU_ADDRESS 0x002B9510
 /begin IF_DATA XCP
  /begin DAQ_EVENT VARIABLE /begin DEFAULT_EVENT_LIST EVENT 0x0000 /end DEFAULT_EVENT_LIST /end DAQ_EVENT
 /end IF_DATA
/end MEASUREMENT
/begin MEASUREMENT inverter_hil_B.active "" FLOAT64_IEEE inverter_hil_CM_double 0 0 -1.7E+308 1.7E+308 ECU_ADDRESS 0x002B9520
 /begin IF_DATA XCP
  /begin DAQ_EVENT VARIABLE /begin DEFAULT_EVENT_LIST EVENT 0x0000 /end DEFAULT_EVENT_LIST /end DAQ_EVENT
 /end IF_DATA
/end MEASUREMENT
/begin MEASUREMENT inverter_hil_B.active_n "" FLOAT64_IEEE inverter_hil_CM_double 0 0 -1.7E+308 1.7E+308 ECU_ADDRESS 0x002B9548
 /begin IF_DATA XCP
  /begin DAQ_EVENT VARIABLE /begin DEFAULT_EVENT_LIST EVENT 0x0000 /end DEFAULT_EVENT_LIST /end DAQ_EVENT
 /end IF_DATA
/end MEASUREMENT
/begin MEASUREMENT inverter_hil_B.ao1 "" FLOAT64_IEEE inverter_hil_CM_double 0 0 -1.7E+308 1.7E+308 ECU_ADDRESS 0x002B9528
 /begin IF_DATA XCP
  /begin DAQ_EVENT VARIABLE /begin DEFAULT_EVENT_LIST EVENT 0x0000 /end DEFAULT_EVENT_LIST /end DAQ_EVENT
 /end IF_DATA
/end MEASUREMENT
/begin MEASUREMENT inverter_hil_B.ao2 "" FLOAT64_IEEE inverter_hil_CM_double 0 0 -1.7E+308 1.7E+308 ECU_ADDRESS 0x002B9530
 /begin IF_DATA XCP
  /begin DAQ_EVENT VARIABLE /begin DEFAULT_EVENT_LIST EVENT 0x0000 /end DEFAULT_EVENT_LIST /end DAQ_EVENT
 /end IF_DATA
/end MEASUREMENT
/begin MEASUREMENT inverter_hil_B.ao3 "" FLOAT64_IEEE inverter_hil_CM_double 0 0 -1.7E+308 1.7E+308 ECU_ADDRESS 0x002B9538
 /begin IF_DATA XCP
  /begin DAQ_EVENT VARIABLE /begin DEFAULT_EVENT_LIST EVENT 0x0000 /end DEFAULT_EVENT_LIST /end DAQ_EVENT
 /end IF_DATA
/end MEASUREMENT
/begin MEASUREMENT inverter_hil_B.ao4 "" FLOAT64_IEEE inverter_hil_CM_double 0 0 -1.7E+308 1.7E+308 ECU_ADDRESS 0x002B9540
 /begin IF_DATA XCP
  /begin DAQ_EVENT VARIABLE /begin DEFAULT_EVENT_LIST EVENT 0x0000 /end DEFAULT_EVENT_LIST /end DAQ_EVENT
 /end IF_DATA
/end MEASUREMENT
/begin MEASUREMENT inverter_hil_B.appsBrakeFault "" UBYTE inverter_hil_CM_boolean 0 0 0 1 ECU_ADDRESS 0x002BA2C0
 /begin IF_DATA XCP
  /begin DAQ_EVENT VARIABLE /begin DEFAULT_EVENT_LIST EVENT 0x0000 /end DEFAULT_EVENT_LIST /end DAQ_EVENT
 /end IF_DATA
/end MEASUREMENT
/begin MEASUREMENT inverter_hil_B.count "" ULONG inverter_hil_CM_uint32 0 0 0 4294967295 ECU_ADDRESS 0x002BA100
 /begin IF_DATA XCP
  /begin DAQ_EVENT VARIABLE /begin DEFAULT_EVENT_LIST EVENT 0x0001 /end DEFAULT_EVENT_LIST /end DAQ_EVENT
 /end IF_DATA
/end MEASUREMENT
/begin MEASUREMENT inverter_hil_B.dcLinkV "" FLOAT64_IEEE inverter_hil_CM_double 0 0 -1.7E+308 1.7E+308 ECU_ADDRESS 0x002B9500
 /begin IF_DATA XCP
  /begin DAQ_EVENT VARIABLE /begin DEFAULT_EVENT_LIST EVENT 0x0000 /end DEFAULT_EVENT_LIST /end DAQ_EVENT
 /end IF_DATA
/end MEASUREMENT
/begin MEASUREMENT inverter_hil_B.f1 "" UBYTE inverter_hil_CM_uint8 0 0 0 255 LAYOUT COLUMN_DIR MATRIX_DIM 8 1 ECU_ADDRESS 0x002BA202
 /begin IF_DATA XCP
  /begin DAQ_EVENT VARIABLE /begin DEFAULT_EVENT_LIST EVENT 0x0001 /end DEFAULT_EVENT_LIST /end DAQ_EVENT
 /end IF_DATA
/end MEASUREMENT
/begin MEASUREMENT inverter_hil_B.f2 "" UBYTE inverter_hil_CM_uint8 0 0 0 255 LAYOUT COLUMN_DIR MATRIX_DIM 8 1 ECU_ADDRESS 0x002BA20A
 /begin IF_DATA XCP
  /begin DAQ_EVENT VARIABLE /begin DEFAULT_EVENT_LIST EVENT 0x0001 /end DEFAULT_EVENT_LIST /end DAQ_EVENT
 /end IF_DATA
/end MEASUREMENT
/begin MEASUREMENT inverter_hil_B.f3 "" UBYTE inverter_hil_CM_uint8 0 0 0 255 LAYOUT COLUMN_DIR MATRIX_DIM 8 1 ECU_ADDRESS 0x002BA212
 /begin IF_DATA XCP
  /begin DAQ_EVENT VARIABLE /begin DEFAULT_EVENT_LIST EVENT 0x0001 /end DEFAULT_EVENT_LIST /end DAQ_EVENT
 /end IF_DATA
/end MEASUREMENT
/begin MEASUREMENT inverter_hil_B.f4 "" UBYTE inverter_hil_CM_uint8 0 0 0 255 LAYOUT COLUMN_DIR MATRIX_DIM 8 1 ECU_ADDRESS 0x002BA21A
 /begin IF_DATA XCP
  /begin DAQ_EVENT VARIABLE /begin DEFAULT_EVENT_LIST EVENT 0x0001 /end DEFAULT_EVENT_LIST /end DAQ_EVENT
 /end IF_DATA
/end MEASUREMENT
/begin MEASUREMENT inverter_hil_B.f5 "" UBYTE inverter_hil_CM_uint8 0 0 0 255 LAYOUT COLUMN_DIR MATRIX_DIM 8 1 ECU_ADDRESS 0x002BA222
 /begin IF_DATA XCP
  /begin DAQ_EVENT VARIABLE /begin DEFAULT_EVENT_LIST EVENT 0x0001 /end DEFAULT_EVENT_LIST /end DAQ_EVENT
 /end IF_DATA
/end MEASUREMENT
/begin MEASUREMENT inverter_hil_B.f6 "" UBYTE inverter_hil_CM_uint8 0 0 0 255 LAYOUT COLUMN_DIR MATRIX_DIM 8 1 ECU_ADDRESS 0x002BA22A
 /begin IF_DATA XCP
  /begin DAQ_EVENT VARIABLE /begin DEFAULT_EVENT_LIST EVENT 0x0001 /end DEFAULT_EVENT_LIST /end DAQ_EVENT
 /end IF_DATA
/end MEASUREMENT
/begin MEASUREMENT inverter_hil_B.f7 "" UBYTE inverter_hil_CM_uint8 0 0 0 255 LAYOUT COLUMN_DIR MATRIX_DIM 8 1 ECU_ADDRESS 0x002BA232
 /begin IF_DATA XCP
  /begin DAQ_EVENT VARIABLE /begin DEFAULT_EVENT_LIST EVENT 0x0001 /end DEFAULT_EVENT_LIST /end DAQ_EVENT
 /end IF_DATA
/end MEASUREMENT
/begin MEASUREMENT inverter_hil_B.f8 "" UBYTE inverter_hil_CM_uint8 0 0 0 255 LAYOUT COLUMN_DIR MATRIX_DIM 8 1 ECU_ADDRESS 0x002BA23A
 /begin IF_DATA XCP
  /begin DAQ_EVENT VARIABLE /begin DEFAULT_EVENT_LIST EVENT 0x0001 /end DEFAULT_EVENT_LIST /end DAQ_EVENT
 /end IF_DATA
/end MEASUREMENT
/begin MEASUREMENT inverter_hil_B.f9 "" UBYTE inverter_hil_CM_uint8 0 0 0 255 LAYOUT COLUMN_DIR MATRIX_DIM 8 1 ECU_ADDRESS 0x002BA242
 /begin IF_DATA XCP
  /begin DAQ_EVENT VARIABLE /begin DEFAULT_EVENT_LIST EVENT 0x0001 /end DEFAULT_EVENT_LIST /end DAQ_EVENT
 /end IF_DATA
/end MEASUREMENT
/begin MEASUREMENT inverter_hil_B.k1 "" ULONG inverter_hil_CM_uint32 0 0 0 4294967295 ECU_ADDRESS 0x002BA104
 /begin IF_DATA XCP
  /begin DAQ_EVENT VARIABLE /begin DEFAULT_EVENT_LIST EVENT 0x0001 /end DEFAULT_EVENT_LIST /end DAQ_EVENT
 /end IF_DATA
/end MEASUREMENT
/begin MEASUREMENT inverter_hil_B.k2 "" ULONG inverter_hil_CM_uint32 0 0 0 4294967295 ECU_ADDRESS 0x002BA108
 /begin IF_DATA XCP
  /begin DAQ_EVENT VARIABLE /begin DEFAULT_EVENT_LIST EVENT 0x0001 /end DEFAULT_EVENT_LIST /end DAQ_EVENT
 /end IF_DATA
/end MEASUREMENT
/begin MEASUREMENT inverter_hil_B.k3 "" ULONG inverter_hil_CM_uint32 0 0 0 4294967295 ECU_ADDRESS 0x002BA10C
 /begin IF_DATA XCP
  /begin DAQ_EVENT VARIABLE /begin DEFAULT_EVENT_LIST EVENT 0x0001 /end DEFAULT_EVENT_LIST /end DAQ_EVENT
 /end IF_DATA
/end MEASUREMENT
/begin MEASUREMENT inverter_hil_B.k4 "" ULONG inverter_hil_CM_uint32 0 0 0 4294967295 ECU_ADDRESS 0x002BA110
 /begin IF_DATA XCP
  /begin DAQ_EVENT VARIABLE /begin DEFAULT_EVENT_LIST EVENT 0x0001 /end DEFAULT_EVENT_LIST /end DAQ_EVENT
 /end IF_DATA
/end MEASUREMENT
/begin MEASUREMENT inverter_hil_B.k5 "" ULONG inverter_hil_CM_uint32 0 0 0 4294967295 ECU_ADDRESS 0x002BA114
 /begin IF_DATA XCP
  /begin DAQ_EVENT VARIABLE /begin DEFAULT_EVENT_LIST EVENT 0x0001 /end DEFAULT_EVENT_LIST /end DAQ_EVENT
 /end IF_DATA
/end MEASUREMENT
/begin MEASUREMENT inverter_hil_B.k6 "" ULONG inverter_hil_CM_uint32 0 0 0 4294967295 ECU_ADDRESS 0x002BA118
 /begin IF_DATA XCP
  /begin DAQ_EVENT VARIABLE /begin DEFAULT_EVENT_LIST EVENT 0x0001 /end DEFAULT_EVENT_LIST /end DAQ_EVENT
 /end IF_DATA
/end MEASUREMENT
/begin MEASUREMENT inverter_hil_B.k7 "" ULONG inverter_hil_CM_uint32 0 0 0 4294967295 ECU_ADDRESS 0x002BA11C
 /begin IF_DATA XCP
  /begin DAQ_EVENT VARIABLE /begin DEFAULT_EVENT_LIST EVENT 0x0001 /end DEFAULT_EVENT_LIST /end DAQ_EVENT
 /end IF_DATA
/end MEASUREMENT
/begin MEASUREMENT inverter_hil_B.k8 "" ULONG inverter_hil_CM_uint32 0 0 0 4294967295 ECU_ADDRESS 0x002BA120
 /begin IF_DATA XCP
  /begin DAQ_EVENT VARIABLE /begin DEFAULT_EVENT_LIST EVENT 0x0001 /end DEFAULT_EVENT_LIST /end DAQ_EVENT
 /end IF_DATA
/end MEASUREMENT
/begin MEASUREMENT inverter_hil_B.k9 "" ULONG inverter_hil_CM_uint32 0 0 0 4294967295 ECU_ADDRESS 0x002BA124
 /begin IF_DATA XCP
  /begin DAQ_EVENT VARIABLE /begin DEFAULT_EVENT_LIST EVENT 0x0001 /end DEFAULT_EVENT_LIST /end DAQ_EVENT
 /end IF_DATA
/end MEASUREMENT
/begin MEASUREMENT inverter_hil_B.payloads "" UBYTE inverter_hil_CM_uint8 0 0 0 255 LAYOUT COLUMN_DIR MATRIX_DIM 1 44 ECU_ADDRESS 0x002BA1D6
 /begin IF_DATA XCP
  /begin DAQ_EVENT VARIABLE /begin DEFAULT_EVENT_LIST EVENT 0x0000 /end DEFAULT_EVENT_LIST /end DAQ_EVENT
 /end IF_DATA
/end MEASUREMENT
/begin MEASUREMENT inverter_hil_B.payloads_e "" UBYTE inverter_hil_CM_uint8 0 0 0 255 LAYOUT COLUMN_DIR MATRIX_DIM 8 9 ECU_ADDRESS 0x002BA24A
 /begin IF_DATA XCP
  /begin DAQ_EVENT VARIABLE /begin DEFAULT_EVENT_LIST EVENT 0x0001 /end DEFAULT_EVENT_LIST /end DAQ_EVENT
 /end IF_DATA
/end MEASUREMENT
/begin MEASUREMENT inverter_hil_B.rxObservation "" FLOAT64_IEEE inverter_hil_CM_double 0 0 -1.7E+308 1.7E+308 LAYOUT COLUMN_DIR MATRIX_DIM 14 13 ECU_ADDRESS 0x002B9B00
 /begin IF_DATA XCP
  /begin DAQ_EVENT VARIABLE /begin DEFAULT_EVENT_LIST EVENT 0x0000 /end DEFAULT_EVENT_LIST /end DAQ_EVENT
 /end IF_DATA
/end MEASUREMENT
/begin MEASUREMENT inverter_hil_B.rxObservationOut "" FLOAT64_IEEE inverter_hil_CM_double 0 0 -1.7E+308 1.7E+308 LAYOUT COLUMN_DIR MATRIX_DIM 14 13 ECU_ADDRESS 0x002B9550
 /begin IF_DATA XCP
  /begin DAQ_EVENT VARIABLE /begin DEFAULT_EVENT_LIST EVENT 0x0001 /end DEFAULT_EVENT_LIST /end DAQ_EVENT
 /end IF_DATA
/end MEASUREMENT
/begin MEASUREMENT inverter_hil_B.torqueRequestNm "" FLOAT64_IEEE inverter_hil_CM_double 0 0 -1.7E+308 1.7E+308 ECU_ADDRESS 0x002B9508
 /begin IF_DATA XCP
  /begin DAQ_EVENT VARIABLE /begin DEFAULT_EVENT_LIST EVENT 0x0000 /end DEFAULT_EVENT_LIST /end DAQ_EVENT
 /end IF_DATA
/end MEASUREMENT
/begin MEASUREMENT inverter_hil_B.txCount "" ULONG inverter_hil_CM_uint32 0 0 0 4294967295 ECU_ADDRESS 0x002BA128
 /begin IF_DATA XCP
  /begin DAQ_EVENT VARIABLE /begin DEFAULT_EVENT_LIST EVENT 0x0001 /end DEFAULT_EVENT_LIST /end DAQ_EVENT
 /end IF_DATA
/end MEASUREMENT
/begin MEASUREMENT inverter_hil_DW.DropStatusMaskRT_Buf "" UWORD inverter_hil_CM_uint16 0 0 0 65535 LAYOUT COLUMN_DIR MATRIX_DIM 2 ECU_ADDRESS 0x002B87A8
 /begin IF_DATA XCP
  /begin DAQ_EVENT VARIABLE /begin DEFAULT_EVENT_LIST EVENT 0x0000 /end DEFAULT_EVENT_LIST /end DAQ_EVENT
 /end IF_DATA
/end MEASUREMENT
/begin MEASUREMENT inverter_hil_DW.DropStatusMaskRT_RdBufIdx "" SBYTE inverter_hil_CM_int8 0 0 -128 127 ECU_ADDRESS 0x002B87B6
 /begin IF_DATA XCP
  /begin DAQ_EVENT VARIABLE /begin DEFAULT_EVENT_LIST EVENT 0x0000 /end DEFAULT_EVENT_LIST /end DAQ_EVENT
 /end IF_DATA
/end MEASUREMENT
/begin MEASUREMENT inverter_hil_DW.DropStatusMaskRT_WrBufIdx "" SBYTE inverter_hil_CM_int8 0 0 -128 127 ECU_ADDRESS 0x002B87B7
 /begin IF_DATA XCP
  /begin DAQ_EVENT VARIABLE /begin DEFAULT_EVENT_LIST EVENT 0x0000 /end DEFAULT_EVENT_LIST /end DAQ_EVENT
 /end IF_DATA
/end MEASUREMENT
/begin MEASUREMENT inverter_hil_DW.EphorusRXObservationRT_Buf "" FLOAT64_IEEE inverter_hil_CM_double 0 0 -1.7E+308 1.7E+308 LAYOUT COLUMN_DIR MATRIX_DIM 364 ECU_ADDRESS 0x002B7AC0
 /begin IF_DATA XCP
  /begin DAQ_EVENT VARIABLE /begin DEFAULT_EVENT_LIST EVENT 0x0000 /end DEFAULT_EVENT_LIST /end DAQ_EVENT
 /end IF_DATA
/end MEASUREMENT
/begin MEASUREMENT inverter_hil_DW.EphorusRXObservationRT_RdBufIdx "" SBYTE inverter_hil_CM_int8 0 0 -128 127 ECU_ADDRESS 0x002B87B8
 /begin IF_DATA XCP
  /begin DAQ_EVENT VARIABLE /begin DEFAULT_EVENT_LIST EVENT 0x0000 /end DEFAULT_EVENT_LIST /end DAQ_EVENT
 /end IF_DATA
/end MEASUREMENT
/begin MEASUREMENT inverter_hil_DW.EphorusRXObservationRT_WrBufIdx "" SBYTE inverter_hil_CM_int8 0 0 -128 127 ECU_ADDRESS 0x002B87B9
 /begin IF_DATA XCP
  /begin DAQ_EVENT VARIABLE /begin DEFAULT_EVENT_LIST EVENT 0x0000 /end DEFAULT_EVENT_LIST /end DAQ_EVENT
 /end IF_DATA
/end MEASUREMENT
/begin MEASUREMENT inverter_hil_DW.GuiCmdDcLink12VRT_Buf "" FLOAT64_IEEE inverter_hil_CM_double 0 0 -1.7E+308 1.7E+308 LAYOUT COLUMN_DIR MATRIX_DIM 2 ECU_ADDRESS 0x002B8620
 /begin IF_DATA XCP
  /begin DAQ_EVENT VARIABLE /begin DEFAULT_EVENT_LIST EVENT 0x0000 /end DEFAULT_EVENT_LIST /end DAQ_EVENT
 /end IF_DATA
/end MEASUREMENT
/begin MEASUREMENT inverter_hil_DW.GuiCmdDcLink12VRT_RdBufIdx "" SBYTE inverter_hil_CM_int8 0 0 -128 127 ECU_ADDRESS 0x002B87BA
 /begin IF_DATA XCP
  /begin DAQ_EVENT VARIABLE /begin DEFAULT_EVENT_LIST EVENT 0x0000 /end DEFAULT_EVENT_LIST /end DAQ_EVENT
 /end IF_DATA
/end MEASUREMENT
/begin MEASUREMENT inverter_hil_DW.GuiCmdDcLink12VRT_WrBufIdx "" SBYTE inverter_hil_CM_int8 0 0 -128 127 ECU_ADDRESS 0x002B87BB
 /begin IF_DATA XCP
  /begin DAQ_EVENT VARIABLE /begin DEFAULT_EVENT_LIST EVENT 0x0000 /end DEFAULT_EVENT_LIST /end DAQ_EVENT
 /end IF_DATA
/end MEASUREMENT
/begin MEASUREMENT inverter_hil_DW.GuiCmdDcLink34VRT_Buf "" FLOAT64_IEEE inverter_hil_CM_double 0 0 -1.7E+308 1.7E+308 LAYOUT COLUMN_DIR MATRIX_DIM 2 ECU_ADDRESS 0x002B8630
 /begin IF_DATA XCP
  /begin DAQ_EVENT VARIABLE /begin DEFAULT_EVENT_LIST EVENT 0x0000 /end DEFAULT_EVENT_LIST /end DAQ_EVENT
 /end IF_DATA
/end MEASUREMENT
/begin MEASUREMENT inverter_hil_DW.GuiCmdDcLink34VRT_RdBufIdx "" SBYTE inverter_hil_CM_int8 0 0 -128 127 ECU_ADDRESS 0x002B87BC
 /begin IF_DATA XCP
  /begin DAQ_EVENT VARIABLE /begin DEFAULT_EVENT_LIST EVENT 0x0000 /end DEFAULT_EVENT_LIST /end DAQ_EVENT
 /end IF_DATA
/end MEASUREMENT
/begin MEASUREMENT inverter_hil_DW.GuiCmdDcLink34VRT_WrBufIdx "" SBYTE inverter_hil_CM_int8 0 0 -128 127 ECU_ADDRESS 0x002B87BD
 /begin IF_DATA XCP
  /begin DAQ_EVENT VARIABLE /begin DEFAULT_EVENT_LIST EVENT 0x0000 /end DEFAULT_EVENT_LIST /end DAQ_EVENT
 /end IF_DATA
/end MEASUREMENT
/begin MEASUREMENT inverter_hil_DW.GuiCmdInverter1ConnectedRT_Buf "" UBYTE inverter_hil_CM_boolean 0 0 0 1 LAYOUT COLUMN_DIR MATRIX_DIM 2 ECU_ADDRESS 0x002B881F
 /begin IF_DATA XCP
  /begin DAQ_EVENT VARIABLE /begin DEFAULT_EVENT_LIST EVENT 0x0000 /end DEFAULT_EVENT_LIST /end DAQ_EVENT
 /end IF_DATA
/end MEASUREMENT
/begin MEASUREMENT inverter_hil_DW.GuiCmdInverter1ConnectedRT_RdBu "" SBYTE inverter_hil_CM_int8 0 0 -128 127 ECU_ADDRESS 0x002B87BE
 /begin IF_DATA XCP
  /begin DAQ_EVENT VARIABLE /begin DEFAULT_EVENT_LIST EVENT 0x0000 /end DEFAULT_EVENT_LIST /end DAQ_EVENT
 /end IF_DATA
/end MEASUREMENT
/begin MEASUREMENT inverter_hil_DW.GuiCmdInverter1ConnectedRT_WrBu "" SBYTE inverter_hil_CM_int8 0 0 -128 127 ECU_ADDRESS 0x002B87BF
 /begin IF_DATA XCP
  /begin DAQ_EVENT VARIABLE /begin DEFAULT_EVENT_LIST EVENT 0x0000 /end DEFAULT_EVENT_LIST /end DAQ_EVENT
 /end IF_DATA
/end MEASUREMENT
/begin MEASUREMENT inverter_hil_DW.GuiCmdInverter1LoadNmRT_Buf "" FLOAT64_IEEE inverter_hil_CM_double 0 0 -1.7E+308 1.7E+308 LAYOUT COLUMN_DIR MATRIX_DIM 2 ECU_ADDRESS 0x002B8640
 /begin IF_DATA XCP
  /begin DAQ_EVENT VARIABLE /begin DEFAULT_EVENT_LIST EVENT 0x0000 /end DEFAULT_EVENT_LIST /end DAQ_EVENT
 /end IF_DATA
/end MEASUREMENT
/begin MEASUREMENT inverter_hil_DW.GuiCmdInverter1LoadNmRT_RdBufId "" SBYTE inverter_hil_CM_int8 0 0 -128 127 ECU_ADDRESS 0x002B87C0
 /begin IF_DATA XCP
  /begin DAQ_EVENT VARIABLE /begin DEFAULT_EVENT_LIST EVENT 0x0000 /end DEFAULT_EVENT_LIST /end DAQ_EVENT
 /end IF_DATA
/end MEASUREMENT
/begin MEASUREMENT inverter_hil_DW.GuiCmdInverter1LoadNmRT_WrBufId "" SBYTE inverter_hil_CM_int8 0 0 -128 127 ECU_ADDRESS 0x002B87C1
 /begin IF_DATA XCP
  /begin DAQ_EVENT VARIABLE /begin DEFAULT_EVENT_LIST EVENT 0x0000 /end DEFAULT_EVENT_LIST /end DAQ_EVENT
 /end IF_DATA
/end MEASUREMENT
/begin MEASUREMENT inverter_hil_DW.GuiCmdInverter2ConnectedRT_Buf "" UBYTE inverter_hil_CM_boolean 0 0 0 1 LAYOUT COLUMN_DIR MATRIX_DIM 2 ECU_ADDRESS 0x002B8821
 /begin IF_DATA XCP
  /begin DAQ_EVENT VARIABLE /begin DEFAULT_EVENT_LIST EVENT 0x0000 /end DEFAULT_EVENT_LIST /end DAQ_EVENT
 /end IF_DATA
/end MEASUREMENT
/begin MEASUREMENT inverter_hil_DW.GuiCmdInverter2ConnectedRT_RdBu "" SBYTE inverter_hil_CM_int8 0 0 -128 127 ECU_ADDRESS 0x002B87C2
 /begin IF_DATA XCP
  /begin DAQ_EVENT VARIABLE /begin DEFAULT_EVENT_LIST EVENT 0x0000 /end DEFAULT_EVENT_LIST /end DAQ_EVENT
 /end IF_DATA
/end MEASUREMENT
/begin MEASUREMENT inverter_hil_DW.GuiCmdInverter2ConnectedRT_WrBu "" SBYTE inverter_hil_CM_int8 0 0 -128 127 ECU_ADDRESS 0x002B87C3
 /begin IF_DATA XCP
  /begin DAQ_EVENT VARIABLE /begin DEFAULT_EVENT_LIST EVENT 0x0000 /end DEFAULT_EVENT_LIST /end DAQ_EVENT
 /end IF_DATA
/end MEASUREMENT
/begin MEASUREMENT inverter_hil_DW.GuiCmdInverter2LoadNmRT_Buf "" FLOAT64_IEEE inverter_hil_CM_double 0 0 -1.7E+308 1.7E+308 LAYOUT COLUMN_DIR MATRIX_DIM 2 ECU_ADDRESS 0x002B8650
 /begin IF_DATA XCP
  /begin DAQ_EVENT VARIABLE /begin DEFAULT_EVENT_LIST EVENT 0x0000 /end DEFAULT_EVENT_LIST /end DAQ_EVENT
 /end IF_DATA
/end MEASUREMENT
/begin MEASUREMENT inverter_hil_DW.GuiCmdInverter2LoadNmRT_RdBufId "" SBYTE inverter_hil_CM_int8 0 0 -128 127 ECU_ADDRESS 0x002B87C4
 /begin IF_DATA XCP
  /begin DAQ_EVENT VARIABLE /begin DEFAULT_EVENT_LIST EVENT 0x0000 /end DEFAULT_EVENT_LIST /end DAQ_EVENT
 /end IF_DATA
/end MEASUREMENT
/begin MEASUREMENT inverter_hil_DW.GuiCmdInverter2LoadNmRT_WrBufId "" SBYTE inverter_hil_CM_int8 0 0 -128 127 ECU_ADDRESS 0x002B87C5
 /begin IF_DATA XCP
  /begin DAQ_EVENT VARIABLE /begin DEFAULT_EVENT_LIST EVENT 0x0000 /end DEFAULT_EVENT_LIST /end DAQ_EVENT
 /end IF_DATA
/end MEASUREMENT
/begin MEASUREMENT inverter_hil_DW.GuiCmdInverter3ConnectedRT_Buf "" UBYTE inverter_hil_CM_boolean 0 0 0 1 LAYOUT COLUMN_DIR MATRIX_DIM 2 ECU_ADDRESS 0x002B8823
 /begin IF_DATA XCP
  /begin DAQ_EVENT VARIABLE /begin DEFAULT_EVENT_LIST EVENT 0x0000 /end DEFAULT_EVENT_LIST /end DAQ_EVENT
 /end IF_DATA
/end MEASUREMENT
/begin MEASUREMENT inverter_hil_DW.GuiCmdInverter3ConnectedRT_RdBu "" SBYTE inverter_hil_CM_int8 0 0 -128 127 ECU_ADDRESS 0x002B87C6
 /begin IF_DATA XCP
  /begin DAQ_EVENT VARIABLE /begin DEFAULT_EVENT_LIST EVENT 0x0000 /end DEFAULT_EVENT_LIST /end DAQ_EVENT
 /end IF_DATA
/end MEASUREMENT
/begin MEASUREMENT inverter_hil_DW.GuiCmdInverter3ConnectedRT_WrBu "" SBYTE inverter_hil_CM_int8 0 0 -128 127 ECU_ADDRESS 0x002B87C7
 /begin IF_DATA XCP
  /begin DAQ_EVENT VARIABLE /begin DEFAULT_EVENT_LIST EVENT 0x0000 /end DEFAULT_EVENT_LIST /end DAQ_EVENT
 /end IF_DATA
/end MEASUREMENT
/begin MEASUREMENT inverter_hil_DW.GuiCmdInverter3LoadNmRT_Buf "" FLOAT64_IEEE inverter_hil_CM_double 0 0 -1.7E+308 1.7E+308 LAYOUT COLUMN_DIR MATRIX_DIM 2 ECU_ADDRESS 0x002B8660
 /begin IF_DATA XCP
  /begin DAQ_EVENT VARIABLE /begin DEFAULT_EVENT_LIST EVENT 0x0000 /end DEFAULT_EVENT_LIST /end DAQ_EVENT
 /end IF_DATA
/end MEASUREMENT
/begin MEASUREMENT inverter_hil_DW.GuiCmdInverter3LoadNmRT_RdBufId "" SBYTE inverter_hil_CM_int8 0 0 -128 127 ECU_ADDRESS 0x002B87C8
 /begin IF_DATA XCP
  /begin DAQ_EVENT VARIABLE /begin DEFAULT_EVENT_LIST EVENT 0x0000 /end DEFAULT_EVENT_LIST /end DAQ_EVENT
 /end IF_DATA
/end MEASUREMENT
/begin MEASUREMENT inverter_hil_DW.GuiCmdInverter3LoadNmRT_WrBufId "" SBYTE inverter_hil_CM_int8 0 0 -128 127 ECU_ADDRESS 0x002B87C9
 /begin IF_DATA XCP
  /begin DAQ_EVENT VARIABLE /begin DEFAULT_EVENT_LIST EVENT 0x0000 /end DEFAULT_EVENT_LIST /end DAQ_EVENT
 /end IF_DATA
/end MEASUREMENT
/begin MEASUREMENT inverter_hil_DW.GuiCmdInverter4ConnectedRT_Buf "" UBYTE inverter_hil_CM_boolean 0 0 0 1 LAYOUT COLUMN_DIR MATRIX_DIM 2 ECU_ADDRESS 0x002B8825
 /begin IF_DATA XCP
  /begin DAQ_EVENT VARIABLE /begin DEFAULT_EVENT_LIST EVENT 0x0000 /end DEFAULT_EVENT_LIST /end DAQ_EVENT
 /end IF_DATA
/end MEASUREMENT
/begin MEASUREMENT inverter_hil_DW.GuiCmdInverter4ConnectedRT_RdBu "" SBYTE inverter_hil_CM_int8 0 0 -128 127 ECU_ADDRESS 0x002B87CA
 /begin IF_DATA XCP
  /begin DAQ_EVENT VARIABLE /begin DEFAULT_EVENT_LIST EVENT 0x0000 /end DEFAULT_EVENT_LIST /end DAQ_EVENT
 /end IF_DATA
/end MEASUREMENT
/begin MEASUREMENT inverter_hil_DW.GuiCmdInverter4ConnectedRT_WrBu "" SBYTE inverter_hil_CM_int8 0 0 -128 127 ECU_ADDRESS 0x002B87CB
 /begin IF_DATA XCP
  /begin DAQ_EVENT VARIABLE /begin DEFAULT_EVENT_LIST EVENT 0x0000 /end DEFAULT_EVENT_LIST /end DAQ_EVENT
 /end IF_DATA
/end MEASUREMENT
/begin MEASUREMENT inverter_hil_DW.GuiCmdInverter4LoadNmRT_Buf "" FLOAT64_IEEE inverter_hil_CM_double 0 0 -1.7E+308 1.7E+308 LAYOUT COLUMN_DIR MATRIX_DIM 2 ECU_ADDRESS 0x002B8670
 /begin IF_DATA XCP
  /begin DAQ_EVENT VARIABLE /begin DEFAULT_EVENT_LIST EVENT 0x0000 /end DEFAULT_EVENT_LIST /end DAQ_EVENT
 /end IF_DATA
/end MEASUREMENT
/begin MEASUREMENT inverter_hil_DW.GuiCmdInverter4LoadNmRT_RdBufId "" SBYTE inverter_hil_CM_int8 0 0 -128 127 ECU_ADDRESS 0x002B87CC
 /begin IF_DATA XCP
  /begin DAQ_EVENT VARIABLE /begin DEFAULT_EVENT_LIST EVENT 0x0000 /end DEFAULT_EVENT_LIST /end DAQ_EVENT
 /end IF_DATA
/end MEASUREMENT
/begin MEASUREMENT inverter_hil_DW.GuiCmdInverter4LoadNmRT_WrBufId "" SBYTE inverter_hil_CM_int8 0 0 -128 127 ECU_ADDRESS 0x002B87CD
 /begin IF_DATA XCP
  /begin DAQ_EVENT VARIABLE /begin DEFAULT_EVENT_LIST EVENT 0x0000 /end DEFAULT_EVENT_LIST /end DAQ_EVENT
 /end IF_DATA
/end MEASUREMENT
/begin MEASUREMENT inverter_hil_DW.PortAPayloadRateTransition1_Buf "" UBYTE inverter_hil_CM_uint8 0 0 0 255 LAYOUT COLUMN_DIR MATRIX_DIM 16 ECU_ADDRESS 0x002B87CE
 /begin IF_DATA XCP
  /begin DAQ_EVENT VARIABLE /begin DEFAULT_EVENT_LIST EVENT 0x0000 /end DEFAULT_EVENT_LIST /end DAQ_EVENT
 /end IF_DATA
/end MEASUREMENT
/begin MEASUREMENT inverter_hil_DW.PortAPayloadRateTransition1_RdB "" SBYTE inverter_hil_CM_int8 0 0 -128 127 ECU_ADDRESS 0x002B87AC
 /begin IF_DATA XCP
  /begin DAQ_EVENT VARIABLE /begin DEFAULT_EVENT_LIST EVENT 0x0000 /end DEFAULT_EVENT_LIST /end DAQ_EVENT
 /end IF_DATA
/end MEASUREMENT
/begin MEASUREMENT inverter_hil_DW.PortAPayloadRateTransition1_WrB "" SBYTE inverter_hil_CM_int8 0 0 -128 127 ECU_ADDRESS 0x002B87AD
 /begin IF_DATA XCP
  /begin DAQ_EVENT VARIABLE /begin DEFAULT_EVENT_LIST EVENT 0x0000 /end DEFAULT_EVENT_LIST /end DAQ_EVENT
 /end IF_DATA
/end MEASUREMENT
/begin MEASUREMENT inverter_hil_DW.PortAPayloadRateTransition2_Buf "" UBYTE inverter_hil_CM_uint8 0 0 0 255 LAYOUT COLUMN_DIR MATRIX_DIM 16 ECU_ADDRESS 0x002B87DE
 /begin IF_DATA XCP
  /begin DAQ_EVENT VARIABLE /begin DEFAULT_EVENT_LIST EVENT 0x0000 /end DEFAULT_EVENT_LIST /end DAQ_EVENT
 /end IF_DATA
/end MEASUREMENT
/begin MEASUREMENT inverter_hil_DW.PortAPayloadRateTransition2_RdB "" SBYTE inverter_hil_CM_int8 0 0 -128 127 ECU_ADDRESS 0x002B87AE
 /begin IF_DATA XCP
  /begin DAQ_EVENT VARIABLE /begin DEFAULT_EVENT_LIST EVENT 0x0000 /end DEFAULT_EVENT_LIST /end DAQ_EVENT
 /end IF_DATA
/end MEASUREMENT
/begin MEASUREMENT inverter_hil_DW.PortAPayloadRateTransition2_WrB "" SBYTE inverter_hil_CM_int8 0 0 -128 127 ECU_ADDRESS 0x002B87AF
 /begin IF_DATA XCP
  /begin DAQ_EVENT VARIABLE /begin DEFAULT_EVENT_LIST EVENT 0x0000 /end DEFAULT_EVENT_LIST /end DAQ_EVENT
 /end IF_DATA
/end MEASUREMENT
/begin MEASUREMENT inverter_hil_DW.PortAPayloadRateTransition3_Buf "" UBYTE inverter_hil_CM_uint8 0 0 0 255 LAYOUT COLUMN_DIR MATRIX_DIM 16 ECU_ADDRESS 0x002B87EE
 /begin IF_DATA XCP
  /begin DAQ_EVENT VARIABLE /begin DEFAULT_EVENT_LIST EVENT 0x0000 /end DEFAULT_EVENT_LIST /end DAQ_EVENT
 /end IF_DATA
/end MEASUREMENT
/begin MEASUREMENT inverter_hil_DW.PortAPayloadRateTransition3_RdB "" SBYTE inverter_hil_CM_int8 0 0 -128 127 ECU_ADDRESS 0x002B87B0
 /begin IF_DATA XCP
  /begin DAQ_EVENT VARIABLE /begin DEFAULT_EVENT_LIST EVENT 0x0000 /end DEFAULT_EVENT_LIST /end DAQ_EVENT
 /end IF_DATA
/end MEASUREMENT
/begin MEASUREMENT inverter_hil_DW.PortAPayloadRateTransition3_WrB "" SBYTE inverter_hil_CM_int8 0 0 -128 127 ECU_ADDRESS 0x002B87B1
 /begin IF_DATA XCP
  /begin DAQ_EVENT VARIABLE /begin DEFAULT_EVENT_LIST EVENT 0x0000 /end DEFAULT_EVENT_LIST /end DAQ_EVENT
 /end IF_DATA
/end MEASUREMENT
/begin MEASUREMENT inverter_hil_DW.PortAPayloadRateTransition4_Buf "" UBYTE inverter_hil_CM_uint8 0 0 0 255 LAYOUT COLUMN_DIR MATRIX_DIM 16 ECU_ADDRESS 0x002B87FE
 /begin IF_DATA XCP
  /begin DAQ_EVENT VARIABLE /begin DEFAULT_EVENT_LIST EVENT 0x0000 /end DEFAULT_EVENT_LIST /end DAQ_EVENT
 /end IF_DATA
/end MEASUREMENT
/begin MEASUREMENT inverter_hil_DW.PortAPayloadRateTransition4_RdB "" SBYTE inverter_hil_CM_int8 0 0 -128 127 ECU_ADDRESS 0x002B87B2
 /begin IF_DATA XCP
  /begin DAQ_EVENT VARIABLE /begin DEFAULT_EVENT_LIST EVENT 0x0000 /end DEFAULT_EVENT_LIST /end DAQ_EVENT
 /end IF_DATA
/end MEASUREMENT
/begin MEASUREMENT inverter_hil_DW.PortAPayloadRateTransition4_WrB "" SBYTE inverter_hil_CM_int8 0 0 -128 127 ECU_ADDRESS 0x002B87B3
 /begin IF_DATA XCP
  /begin DAQ_EVENT VARIABLE /begin DEFAULT_EVENT_LIST EVENT 0x0000 /end DEFAULT_EVENT_LIST /end DAQ_EVENT
 /end IF_DATA
/end MEASUREMENT
/begin MEASUREMENT inverter_hil_DW.PortAPayloadRateTransition5_Buf "" UBYTE inverter_hil_CM_uint8 0 0 0 255 LAYOUT COLUMN_DIR MATRIX_DIM 16 ECU_ADDRESS 0x002B880E
 /begin IF_DATA XCP
  /begin DAQ_EVENT VARIABLE /begin DEFAULT_EVENT_LIST EVENT 0x0000 /end DEFAULT_EVENT_LIST /end DAQ_EVENT
 /end IF_DATA
/end MEASUREMENT
/begin MEASUREMENT inverter_hil_DW.PortAPayloadRateTransition5_RdB "" SBYTE inverter_hil_CM_int8 0 0 -128 127 ECU_ADDRESS 0x002B87B4
 /begin IF_DATA XCP
  /begin DAQ_EVENT VARIABLE /begin DEFAULT_EVENT_LIST EVENT 0x0000 /end DEFAULT_EVENT_LIST /end DAQ_EVENT
 /end IF_DATA
/end MEASUREMENT
/begin MEASUREMENT inverter_hil_DW.PortAPayloadRateTransition5_WrB "" SBYTE inverter_hil_CM_int8 0 0 -128 127 ECU_ADDRESS 0x002B87B5
 /begin IF_DATA XCP
  /begin DAQ_EVENT VARIABLE /begin DEFAULT_EVENT_LIST EVENT 0x0000 /end DEFAULT_EVENT_LIST /end DAQ_EVENT
 /end IF_DATA
/end MEASUREMENT
/begin MEASUREMENT inverter_hil_DW.appsErrorLatch "" UBYTE inverter_hil_CM_boolean 0 0 0 1 ECU_ADDRESS 0x002B882C
 /begin IF_DATA XCP
  /begin DAQ_EVENT VARIABLE /begin DEFAULT_EVENT_LIST EVENT 0x0000 /end DEFAULT_EVENT_LIST /end DAQ_EVENT
 /end IF_DATA
/end MEASUREMENT
/begin MEASUREMENT inverter_hil_DW.appsErrorLatch_not_empty "" UBYTE inverter_hil_CM_boolean 0 0 0 1 ECU_ADDRESS 0x002B882D
 /begin IF_DATA XCP
  /begin DAQ_EVENT VARIABLE /begin DEFAULT_EVENT_LIST EVENT 0x0000 /end DEFAULT_EVENT_LIST /end DAQ_EVENT
 /end IF_DATA
/end MEASUREMENT
/begin MEASUREMENT inverter_hil_DW.bank_not_empty "" UBYTE inverter_hil_CM_boolean 0 0 0 1 ECU_ADDRESS 0x002B8840
 /begin IF_DATA XCP
  /begin DAQ_EVENT VARIABLE /begin DEFAULT_EVENT_LIST EVENT 0x0001 /end DEFAULT_EVENT_LIST /end DAQ_EVENT
 /end IF_DATA
/end MEASUREMENT
/begin MEASUREMENT inverter_hil_DW.bank_not_empty_f "" UBYTE inverter_hil_CM_boolean 0 0 0 1 ECU_ADDRESS 0x002B8843
 /begin IF_DATA XCP
  /begin DAQ_EVENT VARIABLE /begin DEFAULT_EVENT_LIST EVENT 0x0000 /end DEFAULT_EVENT_LIST /end DAQ_EVENT
 /end IF_DATA
/end MEASUREMENT
/begin MEASUREMENT inverter_hil_DW.dcLinkAccum "" FLOAT64_IEEE inverter_hil_CM_double 0 0 -1.7E+308 1.7E+308 ECU_ADDRESS 0x002B86A0
 /begin IF_DATA XCP
  /begin DAQ_EVENT VARIABLE /begin DEFAULT_EVENT_LIST EVENT 0x0000 /end DEFAULT_EVENT_LIST /end DAQ_EVENT
 /end IF_DATA
/end MEASUREMENT
/begin MEASUREMENT inverter_hil_DW.dcLinkAccum_not_empty "" UBYTE inverter_hil_CM_boolean 0 0 0 1 ECU_ADDRESS 0x002B882B
 /begin IF_DATA XCP
  /begin DAQ_EVENT VARIABLE /begin DEFAULT_EVENT_LIST EVENT 0x0000 /end DEFAULT_EVENT_LIST /end DAQ_EVENT
 /end IF_DATA
/end MEASUREMENT
/begin MEASUREMENT inverter_hil_DW.doneDoubleBufferReInit "" UBYTE inverter_hil_CM_boolean 0 0 0 1 ECU_ADDRESS 0x002B8827
 /begin IF_DATA XCP
  /begin DAQ_EVENT VARIABLE /begin DEFAULT_EVENT_LIST EVENT 0x0000 /end DEFAULT_EVENT_LIST /end DAQ_EVENT
 /end IF_DATA
/end MEASUREMENT
/begin MEASUREMENT inverter_hil_DW.doneDoubleBufferReInit_b "" UBYTE inverter_hil_CM_boolean 0 0 0 1 ECU_ADDRESS 0x002B8837
 /begin IF_DATA XCP
  /begin DAQ_EVENT VARIABLE /begin DEFAULT_EVENT_LIST EVENT 0x0000 /end DEFAULT_EVENT_LIST /end DAQ_EVENT
 /end IF_DATA
/end MEASUREMENT
/begin MEASUREMENT inverter_hil_DW.doneDoubleBufferReInit_c "" UBYTE inverter_hil_CM_boolean 0 0 0 1 ECU_ADDRESS 0x002B8842
 /begin IF_DATA XCP
  /begin DAQ_EVENT VARIABLE /begin DEFAULT_EVENT_LIST EVENT 0x0000 /end DEFAULT_EVENT_LIST /end DAQ_EVENT
 /end IF_DATA
/end MEASUREMENT
/begin MEASUREMENT inverter_hil_DW.doneDoubleBufferReInit_d "" UBYTE inverter_hil_CM_boolean 0 0 0 1 ECU_ADDRESS 0x002B8830
 /begin IF_DATA XCP
  /begin DAQ_EVENT VARIABLE /begin DEFAULT_EVENT_LIST EVENT 0x0001 /end DEFAULT_EVENT_LIST /end DAQ_EVENT
 /end IF_DATA
/end MEASUREMENT
/begin MEASUREMENT inverter_hil_DW.doneDoubleBufferReInit_e "" UBYTE inverter_hil_CM_boolean 0 0 0 1 ECU_ADDRESS 0x002B8831
 /begin IF_DATA XCP
  /begin DAQ_EVENT VARIABLE /begin DEFAULT_EVENT_LIST EVENT 0x0000 /end DEFAULT_EVENT_LIST /end DAQ_EVENT
 /end IF_DATA
/end MEASUREMENT
/begin MEASUREMENT inverter_hil_DW.doneDoubleBufferReInit_j "" UBYTE inverter_hil_CM_boolean 0 0 0 1 ECU_ADDRESS 0x002B883D
 /begin IF_DATA XCP
  /begin DAQ_EVENT VARIABLE /begin DEFAULT_EVENT_LIST EVENT 0x0001 /end DEFAULT_EVENT_LIST /end DAQ_EVENT
 /end IF_DATA
/end MEASUREMENT
/begin MEASUREMENT inverter_hil_DW.doneDoubleBufferReInit_m "" UBYTE inverter_hil_CM_boolean 0 0 0 1 ECU_ADDRESS 0x002B8836
 /begin IF_DATA XCP
  /begin DAQ_EVENT VARIABLE /begin DEFAULT_EVENT_LIST EVENT 0x0000 /end DEFAULT_EVENT_LIST /end DAQ_EVENT
 /end IF_DATA
/end MEASUREMENT
/begin MEASUREMENT inverter_hil_DW.doneDoubleBufferReInit_n "" UBYTE inverter_hil_CM_boolean 0 0 0 1 ECU_ADDRESS 0x002B882E
 /begin IF_DATA XCP
  /begin DAQ_EVENT VARIABLE /begin DEFAULT_EVENT_LIST EVENT 0x0001 /end DEFAULT_EVENT_LIST /end DAQ_EVENT
 /end IF_DATA
/end MEASUREMENT
/begin MEASUREMENT inverter_hil_DW.doneDoubleBufferReInit_p "" UBYTE inverter_hil_CM_boolean 0 0 0 1 ECU_ADDRESS 0x002B883C
 /begin IF_DATA XCP
  /begin DAQ_EVENT VARIABLE /begin DEFAULT_EVENT_LIST EVENT 0x0001 /end DEFAULT_EVENT_LIST /end DAQ_EVENT
 /end IF_DATA
/end MEASUREMENT
/begin MEASUREMENT inverter_hil_DW.initialized "" UBYTE inverter_hil_CM_boolean 0 0 0 1 ECU_ADDRESS 0x002B8834
 /begin IF_DATA XCP
  /begin DAQ_EVENT VARIABLE /begin DEFAULT_EVENT_LIST EVENT 0x0000 /end DEFAULT_EVENT_LIST /end DAQ_EVENT
 /end IF_DATA
/end MEASUREMENT
/begin MEASUREMENT inverter_hil_DW.initialized_a "" UBYTE inverter_hil_CM_boolean 0 0 0 1 ECU_ADDRESS 0x002B883A
 /begin IF_DATA XCP
  /begin DAQ_EVENT VARIABLE /begin DEFAULT_EVENT_LIST EVENT 0x0000 /end DEFAULT_EVENT_LIST /end DAQ_EVENT
 /end IF_DATA
/end MEASUREMENT
/begin MEASUREMENT inverter_hil_DW.initialized_not_empty "" UBYTE inverter_hil_CM_boolean 0 0 0 1 ECU_ADDRESS 0x002B8835
 /begin IF_DATA XCP
  /begin DAQ_EVENT VARIABLE /begin DEFAULT_EVENT_LIST EVENT 0x0000 /end DEFAULT_EVENT_LIST /end DAQ_EVENT
 /end IF_DATA
/end MEASUREMENT
/begin MEASUREMENT inverter_hil_DW.initialized_not_empty_m "" UBYTE inverter_hil_CM_boolean 0 0 0 1 ECU_ADDRESS 0x002B883B
 /begin IF_DATA XCP
  /begin DAQ_EVENT VARIABLE /begin DEFAULT_EVENT_LIST EVENT 0x0000 /end DEFAULT_EVENT_LIST /end DAQ_EVENT
 /end IF_DATA
/end MEASUREMENT
/begin MEASUREMENT inverter_hil_DW.n "" ULONG inverter_hil_CM_uint32 0 0 0 4294967295 ECU_ADDRESS 0x002B8710
 /begin IF_DATA XCP
  /begin DAQ_EVENT VARIABLE /begin DEFAULT_EVENT_LIST EVENT 0x0001 /end DEFAULT_EVENT_LIST /end DAQ_EVENT
 /end IF_DATA
/end MEASUREMENT
/begin MEASUREMENT inverter_hil_DW.n_not_empty "" UBYTE inverter_hil_CM_boolean 0 0 0 1 ECU_ADDRESS 0x002B882F
 /begin IF_DATA XCP
  /begin DAQ_EVENT VARIABLE /begin DEFAULT_EVENT_LIST EVENT 0x0001 /end DEFAULT_EVENT_LIST /end DAQ_EVENT
 /end IF_DATA
/end MEASUREMENT
/begin MEASUREMENT inverter_hil_DW.plantState_not_empty "" UBYTE inverter_hil_CM_boolean 0 0 0 1 ECU_ADDRESS 0x002B883F
 /begin IF_DATA XCP
  /begin DAQ_EVENT VARIABLE /begin DEFAULT_EVENT_LIST EVENT 0x0001 /end DEFAULT_EVENT_LIST /end DAQ_EVENT
 /end IF_DATA
/end MEASUREMENT
/begin MEASUREMENT inverter_hil_DW.prevCounter "" ULONG inverter_hil_CM_uint32 0 0 0 4294967295 ECU_ADDRESS 0x002B8714
 /begin IF_DATA XCP
  /begin DAQ_EVENT VARIABLE /begin DEFAULT_EVENT_LIST EVENT 0x0000 /end DEFAULT_EVENT_LIST /end DAQ_EVENT
 /end IF_DATA
/end MEASUREMENT
/begin MEASUREMENT inverter_hil_DW.prevCounter_b "" ULONG inverter_hil_CM_uint32 0 0 0 4294967295 ECU_ADDRESS 0x002B871C
 /begin IF_DATA XCP
  /begin DAQ_EVENT VARIABLE /begin DEFAULT_EVENT_LIST EVENT 0x0000 /end DEFAULT_EVENT_LIST /end DAQ_EVENT
 /end IF_DATA
/end MEASUREMENT
/begin MEASUREMENT inverter_hil_DW.prevCounter_not_empty "" UBYTE inverter_hil_CM_boolean 0 0 0 1 ECU_ADDRESS 0x002B8832
 /begin IF_DATA XCP
  /begin DAQ_EVENT VARIABLE /begin DEFAULT_EVENT_LIST EVENT 0x0000 /end DEFAULT_EVENT_LIST /end DAQ_EVENT
 /end IF_DATA
/end MEASUREMENT
/begin MEASUREMENT inverter_hil_DW.prevCounter_not_empty_k "" UBYTE inverter_hil_CM_boolean 0 0 0 1 ECU_ADDRESS 0x002B8838
 /begin IF_DATA XCP
  /begin DAQ_EVENT VARIABLE /begin DEFAULT_EVENT_LIST EVENT 0x0000 /end DEFAULT_EVENT_LIST /end DAQ_EVENT
 /end IF_DATA
/end MEASUREMENT
/begin MEASUREMENT inverter_hil_DW.rawFilt "" FLOAT64_IEEE inverter_hil_CM_double 0 0 -1.7E+308 1.7E+308 LAYOUT COLUMN_DIR MATRIX_DIM 4 ECU_ADDRESS 0x002B8680
 /begin IF_DATA XCP
  /begin DAQ_EVENT VARIABLE /begin DEFAULT_EVENT_LIST EVENT 0x0000 /end DEFAULT_EVENT_LIST /end DAQ_EVENT
 /end IF_DATA
/end MEASUREMENT
/begin MEASUREMENT inverter_hil_DW.rawFilt_not_empty "" UBYTE inverter_hil_CM_boolean 0 0 0 1 ECU_ADDRESS 0x002B882A
 /begin IF_DATA XCP
  /begin DAQ_EVENT VARIABLE /begin DEFAULT_EVENT_LIST EVENT 0x0000 /end DEFAULT_EVENT_LIST /end DAQ_EVENT
 /end IF_DATA
/end MEASUREMENT
/begin MEASUREMENT inverter_hil_DW.sfEvent "" SLONG inverter_hil_CM_int32 0 0 -2147483648 2147483647 ECU_ADDRESS 0x002B86E8
 /begin IF_DATA XCP
  /begin DAQ_EVENT VARIABLE /begin DEFAULT_EVENT_LIST EVENT 0x0000 /end DEFAULT_EVENT_LIST /end DAQ_EVENT
 /end IF_DATA
/end MEASUREMENT
/begin MEASUREMENT inverter_hil_DW.sfEvent_e "" SLONG inverter_hil_CM_int32 0 0 -2147483648 2147483647 ECU_ADDRESS 0x002B8708
 /begin IF_DATA XCP
  /begin DAQ_EVENT VARIABLE /begin DEFAULT_EVENT_LIST EVENT 0x0000 /end DEFAULT_EVENT_LIST /end DAQ_EVENT
 /end IF_DATA
/end MEASUREMENT
/begin MEASUREMENT inverter_hil_DW.sfEvent_h "" SLONG inverter_hil_CM_int32 0 0 -2147483648 2147483647 ECU_ADDRESS 0x002B8704
 /begin IF_DATA XCP
  /begin DAQ_EVENT VARIABLE /begin DEFAULT_EVENT_LIST EVENT 0x0001 /end DEFAULT_EVENT_LIST /end DAQ_EVENT
 /end IF_DATA
/end MEASUREMENT
/begin MEASUREMENT inverter_hil_DW.sfEvent_j "" SLONG inverter_hil_CM_int32 0 0 -2147483648 2147483647 ECU_ADDRESS 0x002B8700
 /begin IF_DATA XCP
  /begin DAQ_EVENT VARIABLE /begin DEFAULT_EVENT_LIST EVENT 0x0001 /end DEFAULT_EVENT_LIST /end DAQ_EVENT
 /end IF_DATA
/end MEASUREMENT
/begin MEASUREMENT inverter_hil_DW.sfEvent_l "" SLONG inverter_hil_CM_int32 0 0 -2147483648 2147483647 ECU_ADDRESS 0x002B86F0
 /begin IF_DATA XCP
  /begin DAQ_EVENT VARIABLE /begin DEFAULT_EVENT_LIST EVENT 0x0001 /end DEFAULT_EVENT_LIST /end DAQ_EVENT
 /end IF_DATA
/end MEASUREMENT
/begin MEASUREMENT inverter_hil_DW.sfEvent_l3 "" SLONG inverter_hil_CM_int32 0 0 -2147483648 2147483647 ECU_ADDRESS 0x002B86F8
 /begin IF_DATA XCP
  /begin DAQ_EVENT VARIABLE /begin DEFAULT_EVENT_LIST EVENT 0x0000 /end DEFAULT_EVENT_LIST /end DAQ_EVENT
 /end IF_DATA
/end MEASUREMENT
/begin MEASUREMENT inverter_hil_DW.sfEvent_m "" SLONG inverter_hil_CM_int32 0 0 -2147483648 2147483647 ECU_ADDRESS 0x002B86EC
 /begin IF_DATA XCP
  /begin DAQ_EVENT VARIABLE /begin DEFAULT_EVENT_LIST EVENT 0x0001 /end DEFAULT_EVENT_LIST /end DAQ_EVENT
 /end IF_DATA
/end MEASUREMENT
/begin MEASUREMENT inverter_hil_DW.sfEvent_mr "" SLONG inverter_hil_CM_int32 0 0 -2147483648 2147483647 ECU_ADDRESS 0x002B86F4
 /begin IF_DATA XCP
  /begin DAQ_EVENT VARIABLE /begin DEFAULT_EVENT_LIST EVENT 0x0000 /end DEFAULT_EVENT_LIST /end DAQ_EVENT
 /end IF_DATA
/end MEASUREMENT
/begin MEASUREMENT inverter_hil_DW.sfEvent_p "" SLONG inverter_hil_CM_int32 0 0 -2147483648 2147483647 ECU_ADDRESS 0x002B86FC
 /begin IF_DATA XCP
  /begin DAQ_EVENT VARIABLE /begin DEFAULT_EVENT_LIST EVENT 0x0000 /end DEFAULT_EVENT_LIST /end DAQ_EVENT
 /end IF_DATA
/end MEASUREMENT
/begin MEASUREMENT inverter_hil_DW.state_j "" UBYTE inverter_hil_CM_uint8 0 0 0 255 ECU_ADDRESS 0x002B881E
 /begin IF_DATA XCP
  /begin DAQ_EVENT VARIABLE /begin DEFAULT_EVENT_LIST EVENT 0x0000 /end DEFAULT_EVENT_LIST /end DAQ_EVENT
 /end IF_DATA
/end MEASUREMENT
/begin MEASUREMENT inverter_hil_DW.state_not_empty "" UBYTE inverter_hil_CM_boolean 0 0 0 1 ECU_ADDRESS 0x002B8828
 /begin IF_DATA XCP
  /begin DAQ_EVENT VARIABLE /begin DEFAULT_EVENT_LIST EVENT 0x0000 /end DEFAULT_EVENT_LIST /end DAQ_EVENT
 /end IF_DATA
/end MEASUREMENT
/begin MEASUREMENT inverter_hil_DW.state_not_empty_b "" UBYTE inverter_hil_CM_boolean 0 0 0 1 ECU_ADDRESS 0x002B883E
 /begin IF_DATA XCP
  /begin DAQ_EVENT VARIABLE /begin DEFAULT_EVENT_LIST EVENT 0x0001 /end DEFAULT_EVENT_LIST /end DAQ_EVENT
 /end IF_DATA
/end MEASUREMENT
/begin MEASUREMENT inverter_hil_DW.statusBank_not_empty "" UBYTE inverter_hil_CM_boolean 0 0 0 1 ECU_ADDRESS 0x002B8844
 /begin IF_DATA XCP
  /begin DAQ_EVENT VARIABLE /begin DEFAULT_EVENT_LIST EVENT 0x0000 /end DEFAULT_EVENT_LIST /end DAQ_EVENT
 /end IF_DATA
/end MEASUREMENT
/begin MEASUREMENT inverter_hil_DW.tickMs "" ULONG inverter_hil_CM_uint32 0 0 0 4294967295 ECU_ADDRESS 0x002B8728
 /begin IF_DATA XCP
  /begin DAQ_EVENT VARIABLE /begin DEFAULT_EVENT_LIST EVENT 0x0000 /end DEFAULT_EVENT_LIST /end DAQ_EVENT
 /end IF_DATA
/end MEASUREMENT
/begin MEASUREMENT inverter_hil_DW.tickMs_not_empty "" UBYTE inverter_hil_CM_boolean 0 0 0 1 ECU_ADDRESS 0x002B8845
 /begin IF_DATA XCP
  /begin DAQ_EVENT VARIABLE /begin DEFAULT_EVENT_LIST EVENT 0x0000 /end DEFAULT_EVENT_LIST /end DAQ_EVENT
 /end IF_DATA
/end MEASUREMENT
/begin MEASUREMENT inverter_hil_DW.ticks "" ULONG inverter_hil_CM_uint32 0 0 0 4294967295 ECU_ADDRESS 0x002B870C
 /begin IF_DATA XCP
  /begin DAQ_EVENT VARIABLE /begin DEFAULT_EVENT_LIST EVENT 0x0000 /end DEFAULT_EVENT_LIST /end DAQ_EVENT
 /end IF_DATA
/end MEASUREMENT
/begin MEASUREMENT inverter_hil_DW.ticksRemaining "" ULONG inverter_hil_CM_uint32 0 0 0 4294967295 ECU_ADDRESS 0x002B8718
 /begin IF_DATA XCP
  /begin DAQ_EVENT VARIABLE /begin DEFAULT_EVENT_LIST EVENT 0x0000 /end DEFAULT_EVENT_LIST /end DAQ_EVENT
 /end IF_DATA
/end MEASUREMENT
/begin MEASUREMENT inverter_hil_DW.ticksRemaining_h "" ULONG inverter_hil_CM_uint32 0 0 0 4294967295 ECU_ADDRESS 0x002B8720
 /begin IF_DATA XCP
  /begin DAQ_EVENT VARIABLE /begin DEFAULT_EVENT_LIST EVENT 0x0000 /end DEFAULT_EVENT_LIST /end DAQ_EVENT
 /end IF_DATA
/end MEASUREMENT
/begin MEASUREMENT inverter_hil_DW.ticksRemaining_not_empty "" UBYTE inverter_hil_CM_boolean 0 0 0 1 ECU_ADDRESS 0x002B8833
 /begin IF_DATA XCP
  /begin DAQ_EVENT VARIABLE /begin DEFAULT_EVENT_LIST EVENT 0x0000 /end DEFAULT_EVENT_LIST /end DAQ_EVENT
 /end IF_DATA
/end MEASUREMENT
/begin MEASUREMENT inverter_hil_DW.ticksRemaining_not_empty_n "" UBYTE inverter_hil_CM_boolean 0 0 0 1 ECU_ADDRESS 0x002B8839
 /begin IF_DATA XCP
  /begin DAQ_EVENT VARIABLE /begin DEFAULT_EVENT_LIST EVENT 0x0000 /end DEFAULT_EVENT_LIST /end DAQ_EVENT
 /end IF_DATA
/end MEASUREMENT
/begin MEASUREMENT inverter_hil_DW.ticks_not_empty "" UBYTE inverter_hil_CM_boolean 0 0 0 1 ECU_ADDRESS 0x002B8829
 /begin IF_DATA XCP
  /begin DAQ_EVENT VARIABLE /begin DEFAULT_EVENT_LIST EVENT 0x0000 /end DEFAULT_EVENT_LIST /end DAQ_EVENT
 /end IF_DATA
/end MEASUREMENT
/begin MEASUREMENT inverter_hil_DW.txCounter "" ULONG inverter_hil_CM_uint32 0 0 0 4294967295 ECU_ADDRESS 0x002B8724
 /begin IF_DATA XCP
  /begin DAQ_EVENT VARIABLE /begin DEFAULT_EVENT_LIST EVENT 0x0001 /end DEFAULT_EVENT_LIST /end DAQ_EVENT
 /end IF_DATA
/end MEASUREMENT
/begin MEASUREMENT inverter_hil_DW.txCounter_not_empty "" UBYTE inverter_hil_CM_boolean 0 0 0 1 ECU_ADDRESS 0x002B8841
 /begin IF_DATA XCP
  /begin DAQ_EVENT VARIABLE /begin DEFAULT_EVENT_LIST EVENT 0x0001 /end DEFAULT_EVENT_LIST /end DAQ_EVENT
 /end IF_DATA
/end MEASUREMENT
/begin COMPU_METHOD inverter_hil_CM_boolean "Q = V" IDENTICAL "%1.0" "" /end COMPU_METHOD
/begin COMPU_METHOD inverter_hil_CM_double "Q = V" IDENTICAL "%15.10" "" /end COMPU_METHOD
/begin COMPU_METHOD inverter_hil_CM_int32 "Q = V" IDENTICAL "%10.0" "" /end COMPU_METHOD
/begin COMPU_METHOD inverter_hil_CM_int8 "Q = V" IDENTICAL "%3.0" "" /end COMPU_METHOD
/begin COMPU_METHOD inverter_hil_CM_uint16 "Q = V" IDENTICAL "%5.0" "" /end COMPU_METHOD
/begin COMPU_METHOD inverter_hil_CM_uint32 "Q = V" IDENTICAL "%10.0" "" /end COMPU_METHOD
/begin COMPU_METHOD inverter_hil_CM_uint8 "Q = V" IDENTICAL "%3.0" "" /end COMPU_METHOD
/begin RECORD_LAYOUT Record_BOOLEAN FNC_VALUES 1 UBYTE COLUMN_DIR DIRECT /end RECORD_LAYOUT
/begin RECORD_LAYOUT Record_FLOAT64_IEEE FNC_VALUES 1 FLOAT64_IEEE COLUMN_DIR DIRECT /end RECORD_LAYOUT
/begin RECORD_LAYOUT Record_SBYTE FNC_VALUES 1 SBYTE COLUMN_DIR DIRECT /end RECORD_LAYOUT
/begin RECORD_LAYOUT Record_SLONG FNC_VALUES 1 SLONG COLUMN_DIR DIRECT /end RECORD_LAYOUT
/begin RECORD_LAYOUT Record_UBYTE FNC_VALUES 1 UBYTE COLUMN_DIR DIRECT /end RECORD_LAYOUT
/begin RECORD_LAYOUT Record_ULONG FNC_VALUES 1 ULONG COLUMN_DIR DIRECT /end RECORD_LAYOUT
/begin RECORD_LAYOUT Record_UWORD FNC_VALUES 1 UWORD COLUMN_DIR DIRECT /end RECORD_LAYOUT
/begin GROUP inverter_hil "inverter_hil" /* Root */ ROOT
 /begin SUB_GROUP inverter_hil_Ephorus_Channel_1 inverter_hil_Ephorus_Channel_2 inverter_hil_Ephorus_Channel_3 inverter_hil_Ephorus_Channel_4 inverter_hil_Ephorus_System_Status inverter_hil_Fault_Injection inverter_hil_GUI_Command_Parameters inverter_hil_Hardware_I_O___PRE_FLIGHT_DISABLED inverter_hil_IO614_CAN_Interface inverter_hil_Pedal_Sensor_Emulation inverter_hil_Test_Inputs inverter_hil_VCU_Digital_Interface inverter_hil_Virtual_VCU inverter_hil_Virtual_VCU_Observability /end SUB_GROUP
/end GROUP
/begin GROUP inverter_hil_B.IO614CANFIFOReadRaw_o2 ""
 /begin REF_MEASUREMENT inverter_hil_B.IO614CANFIFOReadRaw_o2.Extended inverter_hil_B.IO614CANFIFOReadRaw_o2.Length inverter_hil_B.IO614CANFIFOReadRaw_o2.Remote inverter_hil_B.IO614CANFIFOReadRaw_o2.Error inverter_hil_B.IO614CANFIFOReadRaw_o2.ID inverter_hil_B.IO614CANFIFOReadRaw_o2.Timestamp inverter_hil_B.IO614CANFIFOReadRaw_o2.Data /end REF_MEASUREMENT
/end GROUP
/begin GROUP inverter_hil_B.PortACANFIFORead_o2 ""
 /begin REF_MEASUREMENT inverter_hil_B.PortACANFIFORead_o2.Extended inverter_hil_B.PortACANFIFORead_o2.Length inverter_hil_B.PortACANFIFORead_o2.Remote inverter_hil_B.PortACANFIFORead_o2.Error inverter_hil_B.PortACANFIFORead_o2.ID inverter_hil_B.PortACANFIFORead_o2.Timestamp inverter_hil_B.PortACANFIFORead_o2.Data /end REF_MEASUREMENT
/end GROUP
/begin GROUP inverter_hil_Ephorus_Channel_1 "inverter_hil/Ephorus Channel 1"
 /begin REF_CHARACTERISTIC inverter_hil_cal_impl.SafeObservations_Ch1_Value inverter_hil_cal_impl.SafeStatus3X3_Ch1_Value inverter_hil_cal_impl.SafeStatus3X5_Ch1_Value /end REF_CHARACTERISTIC
 /begin REF_MEASUREMENT inverter_hil_B.SafeObservations_Ch1 inverter_hil_B.SafeStatus3X3_Ch1 inverter_hil_B.SafeStatus3X5_Ch1 /end REF_MEASUREMENT
/end GROUP
/begin GROUP inverter_hil_Ephorus_Channel_2 "inverter_hil/Ephorus Channel 2"
 /begin REF_CHARACTERISTIC inverter_hil_cal_impl.SafeObservations_Ch2_Value inverter_hil_cal_impl.SafeStatus3X3_Ch2_Value inverter_hil_cal_impl.SafeStatus3X5_Ch2_Value /end REF_CHARACTERISTIC
 /begin REF_MEASUREMENT inverter_hil_B.SafeObservations_Ch2 inverter_hil_B.SafeStatus3X3_Ch2 inverter_hil_B.SafeStatus3X5_Ch2 /end REF_MEASUREMENT
/end GROUP
/begin GROUP inverter_hil_Ephorus_Channel_3 "inverter_hil/Ephorus Channel 3"
 /begin REF_CHARACTERISTIC inverter_hil_cal_impl.SafeObservations_Ch3_Value inverter_hil_cal_impl.SafeStatus3X3_Ch3_Value inverter_hil_cal_impl.SafeStatus3X5_Ch3_Value /end REF_CHARACTERISTIC
 /begin REF_MEASUREMENT inverter_hil_B.SafeObservations_Ch3 inverter_hil_B.SafeStatus3X3_Ch3 inverter_hil_B.SafeStatus3X5_Ch3 /end REF_MEASUREMENT
/end GROUP
/begin GROUP inverter_hil_Ephorus_Channel_4 "inverter_hil/Ephorus Channel 4"
 /begin REF_CHARACTERISTIC inverter_hil_cal_impl.SafeObservations_Ch4_Value inverter_hil_cal_impl.SafeStatus3X3_Ch4_Value inverter_hil_cal_impl.SafeStatus3X5_Ch4_Value /end REF_CHARACTERISTIC
 /begin REF_MEASUREMENT inverter_hil_B.SafeObservations_Ch4 inverter_hil_B.SafeStatus3X3_Ch4 inverter_hil_B.SafeStatus3X5_Ch4 /end REF_MEASUREMENT
/end GROUP
/begin GROUP inverter_hil_Ephorus_System_Status "inverter_hil/Ephorus System Status"
 /begin REF_CHARACTERISTIC inverter_hil_cal_impl.EphorusRXObservationRT_InitialC inverter_hil_cal_impl.GuiCmdDcLink12VRT_InitialCondit inverter_hil_cal_impl.GuiCmdDcLink34VRT_InitialCondit inverter_hil_cal_impl.GuiCmdInverter1ConnectedRT_Init inverter_hil_cal_impl.GuiCmdInverter1LoadNmRT_Initial inverter_hil_cal_impl.GuiCmdInverter2ConnectedRT_Init inverter_hil_cal_impl.GuiCmdInverter2LoadNmRT_Initial inverter_hil_cal_impl.GuiCmdInverter3ConnectedRT_Init inverter_hil_cal_impl.GuiCmdInverter3LoadNmRT_Initial inverter_hil_cal_impl.GuiCmdInverter4ConnectedRT_Init inverter_hil_cal_impl.GuiCmdInverter4LoadNmRT_Initial /end REF_CHARACTERISTIC
 /begin REF_MEASUREMENT inverter_hil_B.AnalogInputsSignalCopy inverter_hil_B.EphorusRXObservationRT inverter_hil_B.GuiCmdDcLink12VRT inverter_hil_B.GuiCmdDcLink34VRT inverter_hil_B.GuiCmdInverter1ConnectedRT inverter_hil_B.GuiCmdInverter1LoadNmRT inverter_hil_B.GuiCmdInverter2ConnectedRT inverter_hil_B.GuiCmdInverter2LoadNmRT inverter_hil_B.GuiCmdInverter3ConnectedRT inverter_hil_B.GuiCmdInverter3LoadNmRT inverter_hil_B.GuiCmdInverter4ConnectedRT inverter_hil_B.GuiCmdInverter4LoadNmRT inverter_hil_B.IO614CANFIFOReadRaw_o1 inverter_hil_B.dcLinkV inverter_hil_B.payloads_e inverter_hil_B.rxObservation inverter_hil_B.rxObservationOut inverter_hil_B.txCount inverter_hil_DW.EphorusRXObservationRT_Buf inverter_hil_DW.EphorusRXObservationRT_RdBufIdx inverter_hil_DW.EphorusRXObservationRT_WrBufIdx inverter_hil_DW.GuiCmdDcLink12VRT_Buf inverter_hil_DW.GuiCmdDcLink12VRT_RdBufIdx inverter_hil_DW.GuiCmdDcLink12VRT_WrBufIdx inverter_hil_DW.GuiCmdDcLink34VRT_Buf inverter_hil_DW.GuiCmdDcLink34VRT_RdBufIdx inverter_hil_DW.GuiCmdDcLink34VRT_WrBufIdx inverter_hil_DW.GuiCmdInverter1ConnectedRT_Buf inverter_hil_DW.GuiCmdInverter1ConnectedRT_RdBu inverter_hil_DW.GuiCmdInverter1ConnectedRT_WrBu inverter_hil_DW.GuiCmdInverter1LoadNmRT_Buf inverter_hil_DW.GuiCmdInverter1LoadNmRT_RdBufId inverter_hil_DW.GuiCmdInverter1LoadNmRT_WrBufId inverter_hil_DW.GuiCmdInverter2ConnectedRT_Buf inverter_hil_DW.GuiCmdInverter2ConnectedRT_RdBu inverter_hil_DW.GuiCmdInverter2ConnectedRT_WrBu inverter_hil_DW.GuiCmdInverter2LoadNmRT_Buf inverter_hil_DW.GuiCmdInverter2LoadNmRT_RdBufId inverter_hil_DW.GuiCmdInverter2LoadNmRT_WrBufId inverter_hil_DW.GuiCmdInverter3ConnectedRT_Buf inverter_hil_DW.GuiCmdInverter3ConnectedRT_RdBu inverter_hil_DW.GuiCmdInverter3ConnectedRT_WrBu inverter_hil_DW.GuiCmdInverter3LoadNmRT_Buf inverter_hil_DW.GuiCmdInverter3LoadNmRT_RdBufId inverter_hil_DW.GuiCmdInverter3LoadNmRT_WrBufId inverter_hil_DW.GuiCmdInverter4ConnectedRT_Buf inverter_hil_DW.GuiCmdInverter4ConnectedRT_RdBu inverter_hil_DW.GuiCmdInverter4ConnectedRT_WrBu inverter_hil_DW.GuiCmdInverter4LoadNmRT_Buf inverter_hil_DW.GuiCmdInverter4LoadNmRT_RdBufId inverter_hil_DW.GuiCmdInverter4LoadNmRT_WrBufId inverter_hil_DW.bank_not_empty inverter_hil_DW.bank_not_empty_f inverter_hil_DW.doneDoubleBufferReInit_c inverter_hil_DW.doneDoubleBufferReInit_j inverter_hil_DW.plantState_not_empty inverter_hil_DW.sfEvent_e inverter_hil_DW.sfEvent_h inverter_hil_DW.state_not_empty_b inverter_hil_DW.statusBank_not_empty inverter_hil_DW.tickMs inverter_hil_DW.tickMs_not_empty inverter_hil_DW.txCounter inverter_hil_DW.txCounter_not_empty /end REF_MEASUREMENT
/end GROUP
/begin GROUP inverter_hil_Fault_Injection "inverter_hil/Fault Injection"
 /begin REF_CHARACTERISTIC inverter_hil_cal_impl.SafeFaultMask_Value inverter_hil_cal_impl.SafePreflightSafe_Value /end REF_CHARACTERISTIC
 /begin REF_MEASUREMENT inverter_hil_B.SafeFaultMask inverter_hil_B.SafePreflightSafe /end REF_MEASUREMENT
/end GROUP
/begin GROUP inverter_hil_GUI_Command_Parameters "inverter_hil/GUI Command Parameters"
 /begin REF_MEASUREMENT inverter_hil_B.Cmdhil_cal_pedals_pressed_v1 inverter_hil_B.Cmdhil_cal_pedals_pressed_v2 inverter_hil_B.Cmdhil_cal_pedals_pressed_v3 inverter_hil_B.Cmdhil_cal_pedals_pressed_v4 inverter_hil_B.Cmdhil_cal_pedals_released_v1 inverter_hil_B.Cmdhil_cal_pedals_released_v2 inverter_hil_B.Cmdhil_cal_pedals_released_v3 inverter_hil_B.Cmdhil_cal_pedals_released_v4 inverter_hil_B.Cmdhil_cmd_dc_link12_v inverter_hil_B.Cmdhil_cmd_dc_link34_v inverter_hil_B.Cmdhil_cmd_digital_cooling_swit inverter_hil_B.Cmdhil_cmd_digital_main_button inverter_hil_B.Cmdhil_cmd_digital_main_button_ inverter_hil_B.Cmdhil_cmd_digital_precharge_se inverter_hil_B.Cmdhil_cmd_digital_shutdown_fee inverter_hil_B.Cmdhil_cmd_gui_heartbeat inverter_hil_B.Cmdhil_cmd_inverter1_fault_mask inverter_hil_B.Cmdhil_cmd_inverter2_fault_mask inverter_hil_B.Cmdhil_cmd_inverter3_fault_mask inverter_hil_B.Cmdhil_cmd_inverter4_fault_mask inverter_hil_B.Cmdhil_cmd_pedals_brake inverter_hil_B.Cmdhil_cmd_pedals_plausibility_ inverter_hil_B.Cmdhil_cmd_pedals_throttle /end REF_MEASUREMENT
/end GROUP
/begin GROUP inverter_hil_Hardware_I_O___PRE_FLIGHT_DISABLED "inverter_hil/Hardware I O - PRE-FLIGHT DISABLED"
 /begin REF_CHARACTERISTIC inverter_hil_cal_impl.CANWrite0x383_P1 inverter_hil_cal_impl.CANWrite0x385_P1 inverter_hil_cal_impl.CANWrite0x393_P1 inverter_hil_cal_impl.CANWrite0x395_P1 inverter_hil_cal_impl.CANWrite0x3A3_P1 inverter_hil_cal_impl.CANWrite0x3A5_P1 inverter_hil_cal_impl.CANWrite0x3B3_P1 inverter_hil_cal_impl.CANWrite0x3B5_P1 inverter_hil_cal_impl.CANWrite0x400_P1 inverter_hil_cal_impl.DropStatusMaskRT_InitialConditi inverter_hil_cal_impl.IO183AI01AI04RailMonitor_P1 inverter_hil_cal_impl.IO183AI01AI04RailMonitor_P2 inverter_hil_cal_impl.IO183AI01AI04RailMonitor_P3 inverter_hil_cal_impl.IO183AI01AI04RailMonitor_P4 inverter_hil_cal_impl.IO183AI01AI04RailMonitor_P5 inverter_hil_cal_impl.IO183AO01AO04SafeZero_P1 inverter_hil_cal_impl.IO183AO01AO04SafeZero_P2 inverter_hil_cal_impl.IO183AO01AO04SafeZero_P3 inverter_hil_cal_impl.IO183AO01AO04SafeZero_P4 inverter_hil_cal_impl.IO183AO01AO04SafeZero_P5 inverter_hil_cal_impl.IO183AO01AO04SafeZero_P6 inverter_hil_cal_impl.IO183AO01AO04SafeZero_P7 inverter_hil_cal_impl.IO183DIO01DIO08SafeZero_P1 inverter_hil_cal_impl.IO183DIO01DIO08SafeZero_P2 inverter_hil_cal_impl.IO183DIO01DIO08SafeZero_P3 inverter_hil_cal_impl.IO183DIO01DIO08SafeZero_P4 inverter_hil_cal_impl.IO183DIO01DIO08SafeZero_P5 inverter_hil_cal_impl.IO183DIO01DIO08SafeZero_P6 inverter_hil_cal_impl.IO183DIO09DIO13VCUMonitor_P1 inverter_hil_cal_impl.IO183DIO09DIO13VCUMonitor_P2 inverter_hil_cal_impl.IO183DIO09DIO13VCUMonitor_P3 inverter_hil_cal_impl.IO183DIO09DIO13VCUMonitor_P4 inverter_hil_cal_impl.IO183Setup_P1 inverter_hil_cal_impl.IO183Setup_P10 inverter_hil_cal_impl.IO183Setup_P11 inverter_hil_cal_impl.IO183Setup_P2 inverter_hil_cal_impl.IO183Setup_P3 inverter_hil_cal_impl.IO183Setup_P4 inverter_hil_cal_impl.IO183Setup_P5 inverter_hil_cal_impl.IO183Setup_P6 inverter_hil_cal_impl.IO183Setup_P7 inverter_hil_cal_impl.IO183Setup_P8 inverter_hil_cal_impl.IO183Setup_P9 inverter_hil_cal_impl.IO614CANDiagnostics_P1 inverter_hil_cal_impl.IO614CANFIFOReadRaw_P1 inverter_hil_cal_impl.IO614CANSetup_P1 inverter_hil_cal_impl.IO614CANSetup_P2 inverter_hil_cal_impl.IO614CANSetup_P3 inverter_hil_cal_impl.UnusedSW_IN_1_Value inverter_hil_cal_impl.UnusedSW_IN_2_Value inverter_hil_cal_impl.UnusedSW_IN_3_Value inverter_hil_cal_impl.UnusedSW_IN_4_Value inverter_hil_cal_impl.XCPBrakePercentToFraction_Gain inverter_hil_cal_impl.XCPThrottlePercentToFraction_Ga /end REF_CHARACTERISTIC
 /begin REF_MEASUREMENT hil_cmd_xcp_pedals_active hil_cmd_xcp_pedals_brake hil_cmd_xcp_pedals_throttle inverter_hil_B.BrakeSourceSwitch inverter_hil_B.CastRefhil_cmd_digital_cooling_ inverter_hil_B.CastRefhil_cmd_digital_shutdown inverter_hil_B.DropStatusMaskRT inverter_hil_B.IO183AI01AI04RailMonitor_o1 inverter_hil_B.IO183AI01AI04RailMonitor_o2 inverter_hil_B.IO183AI01AI04RailMonitor_o3 inverter_hil_B.IO183AI01AI04RailMonitor_o4 inverter_hil_B.IO183DIO09DIO13VCUMonitor_o1 inverter_hil_B.IO183DIO09DIO13VCUMonitor_o2 inverter_hil_B.IO183DIO09DIO13VCUMonitor_o3 inverter_hil_B.IO183DIO09DIO13VCUMonitor_o4 inverter_hil_B.IO183DIO09DIO13VCUMonitor_o5 inverter_hil_B.IO614CANFIFOReadRaw_o1 inverter_hil_B.Refhil_cmd_xcp_pedals_active inverter_hil_B.Refhil_cmd_xcp_pedals_brake inverter_hil_B.Refhil_cmd_xcp_pedals_throttle inverter_hil_B.ThrottleSourceSwitch inverter_hil_B.UnusedSW_IN_1 inverter_hil_B.UnusedSW_IN_2 inverter_hil_B.UnusedSW_IN_3 inverter_hil_B.UnusedSW_IN_4 inverter_hil_B.XCPBrakePercentToFraction inverter_hil_B.XCPThrottlePercentToFraction inverter_hil_B.active inverter_hil_B.active_n inverter_hil_B.ao1 inverter_hil_B.ao2 inverter_hil_B.ao3 inverter_hil_B.ao4 inverter_hil_B.f1 inverter_hil_B.f2 inverter_hil_B.f3 inverter_hil_B.f4 inverter_hil_B.f5 inverter_hil_B.f6 inverter_hil_B.f7 inverter_hil_B.f8 inverter_hil_B.f9 inverter_hil_B.k1 inverter_hil_B.k2 inverter_hil_B.k3 inverter_hil_B.k4 inverter_hil_B.k5 inverter_hil_B.k6 inverter_hil_B.k7 inverter_hil_B.k8 inverter_hil_B.k9 inverter_hil_B.payloads_e inverter_hil_DW.DropStatusMaskRT_Buf inverter_hil_DW.DropStatusMaskRT_RdBufIdx inverter_hil_DW.DropStatusMaskRT_WrBufIdx inverter_hil_DW.doneDoubleBufferReInit_b inverter_hil_DW.doneDoubleBufferReInit_d inverter_hil_DW.doneDoubleBufferReInit_e inverter_hil_DW.doneDoubleBufferReInit_m inverter_hil_DW.doneDoubleBufferReInit_p inverter_hil_DW.initialized inverter_hil_DW.initialized_a inverter_hil_DW.initialized_not_empty inverter_hil_DW.initialized_not_empty_m inverter_hil_DW.prevCounter inverter_hil_DW.prevCounter_b inverter_hil_DW.prevCounter_not_empty inverter_hil_DW.prevCounter_not_empty_k inverter_hil_DW.sfEvent_j inverter_hil_DW.sfEvent_l inverter_hil_DW.sfEvent_l3 inverter_hil_DW.sfEvent_mr inverter_hil_DW.sfEvent_p inverter_hil_DW.ticksRemaining inverter_hil_DW.ticksRemaining_h inverter_hil_DW.ticksRemaining_not_empty inverter_hil_DW.ticksRemaining_not_empty_n /end REF_MEASUREMENT
/end GROUP
/begin GROUP inverter_hil_IO614_CAN_Interface "inverter_hil/IO614 CAN Interface"
 /begin REF_CHARACTERISTIC inverter_hil_cal_impl.SafeCANDiagnostics_Value inverter_hil_cal_impl.SafeDecodedCommands_Value /end REF_CHARACTERISTIC
 /begin REF_MEASUREMENT inverter_hil_B.SafeCANDiagnostics inverter_hil_B.SafeDecodedCommands /end REF_MEASUREMENT
/end GROUP
/begin GROUP inverter_hil_Pedal_Sensor_Emulation "inverter_hil/Pedal Sensor Emulation" /begin REF_CHARACTERISTIC inverter_hil_cal_impl.SafePedalVoltageV_Value /end REF_CHARACTERISTIC /begin REF_MEASUREMENT inverter_hil_B.SafePedalVoltageV /end REF_MEASUREMENT /end GROUP
/begin GROUP inverter_hil_Test_Inputs "inverter_hil/Test Inputs"
 /begin REF_CHARACTERISTIC inverter_hil_cal_impl.SafeControlFrames_Value inverter_hil_cal_impl.SafeDCLinkV_Value inverter_hil_cal_impl.SafeDigitalCommand_Value inverter_hil_cal_impl.SafeLoadTorqueNm_Value inverter_hil_cal_impl.SafePedalCommand_Value /end REF_CHARACTERISTIC
 /begin REF_MEASUREMENT inverter_hil_B.SafeControlFrames inverter_hil_B.SafeDCLinkV inverter_hil_B.SafeDigitalCommand inverter_hil_B.SafeLoadTorqueNm inverter_hil_B.SafePedalCommand /end REF_MEASUREMENT
/end GROUP
/begin GROUP inverter_hil_VCU_Digital_Interface "inverter_hil/VCU Digital Interface" /begin REF_CHARACTERISTIC inverter_hil_cal_impl.SafeDigitalStimulus_Value /end REF_CHARACTERISTIC /begin REF_MEASUREMENT inverter_hil_B.SafeDigitalStimulus /end REF_MEASUREMENT /end GROUP
/begin GROUP inverter_hil_Virtual_VCU "inverter_hil/Virtual VCU"
 /begin REF_CHARACTERISTIC inverter_hil_cal_impl.IO183Module2Setup_P1 inverter_hil_cal_impl.IO183Module2Setup_P10 inverter_hil_cal_impl.IO183Module2Setup_P11 inverter_hil_cal_impl.IO183Module2Setup_P2 inverter_hil_cal_impl.IO183Module2Setup_P3 inverter_hil_cal_impl.IO183Module2Setup_P4 inverter_hil_cal_impl.IO183Module2Setup_P5 inverter_hil_cal_impl.IO183Module2Setup_P6 inverter_hil_cal_impl.IO183Module2Setup_P7 inverter_hil_cal_impl.IO183Module2Setup_P8 inverter_hil_cal_impl.IO183Module2Setup_P9 inverter_hil_cal_impl.Module1DigitalUnwired3_Value inverter_hil_cal_impl.Module1DigitalUnwired4_Value inverter_hil_cal_impl.Module1DigitalUnwired6_Value inverter_hil_cal_impl.Module1DigitalUnwired7_Value inverter_hil_cal_impl.Module1DigitalUnwired8_Value inverter_hil_cal_impl.Module2AI01AI04_P1 inverter_hil_cal_impl.Module2AI01AI04_P2 inverter_hil_cal_impl.Module2AI01AI04_P3 inverter_hil_cal_impl.Module2AI01AI04_P4 inverter_hil_cal_impl.Module2AI01AI04_P5 inverter_hil_cal_impl.Module2DI01DI08_P1 inverter_hil_cal_impl.Module2DI01DI08_P2 inverter_hil_cal_impl.Module2DI01DI08_P3 inverter_hil_cal_impl.Module2DI01DI08_P4 inverter_hil_cal_impl.PortACANFIFORead_P1 inverter_hil_cal_impl.PortACANWrite1_P1 inverter_hil_cal_impl.PortACANWrite2_P1 inverter_hil_cal_impl.PortACANWrite3_P1 inverter_hil_cal_impl.PortACANWrite4_P1 inverter_hil_cal_impl.PortACANWrite5_P1 inverter_hil_cal_impl.PortAPayloadRateTransition1_Ini inverter_hil_cal_impl.PortAPayloadRateTransition2_Ini inverter_hil_cal_impl.PortAPayloadRateTransition3_Ini inverter_hil_cal_impl.PortAPayloadRateTransition4_Ini inverter_hil_cal_impl.PortAPayloadRateTransition5_Ini /end REF_CHARACTERISTIC
 /begin REF_MEASUREMENT inverter_hil_B.Module2AI01AI04_o1 inverter_hil_B.Module2AI01AI04_o2 inverter_hil_B.Module2AI01AI04_o3 inverter_hil_B.Module2AI01AI04_o4 inverter_hil_B.Module2DI01DI08_o1 inverter_hil_B.Module2DI01DI08_o2 inverter_hil_B.Module2DI01DI08_o3 inverter_hil_B.Module2DI01DI08_o4 inverter_hil_B.Module2DI01DI08_o5 inverter_hil_B.Module2DI01DI08_o6 inverter_hil_B.Module2DI01DI08_o7 inverter_hil_B.Module2DI01DI08_o8 inverter_hil_B.PortAPayloadRateTransition1 inverter_hil_B.PortAPayloadRateTransition2 inverter_hil_B.PortAPayloadRateTransition3 inverter_hil_B.PortAPayloadRateTransition4 inverter_hil_B.PortAPayloadRateTransition5 inverter_hil_B.VCUInputDouble2 inverter_hil_B.VCUInputDouble3 inverter_hil_B.VCUInputDouble4 inverter_hil_B.VCUInputDouble5 inverter_hil_B.VCUInputDouble6 inverter_hil_B.VCUInputDouble7 inverter_hil_B.appsBrakeFault inverter_hil_B.count inverter_hil_B.dcLinkV inverter_hil_B.payloads inverter_hil_B.torqueRequestNm inverter_hil_DW.PortAPayloadRateTransition1_Buf inverter_hil_DW.PortAPayloadRateTransition1_RdB inverter_hil_DW.PortAPayloadRateTransition1_WrB inverter_hil_DW.PortAPayloadRateTransition2_Buf inverter_hil_DW.PortAPayloadRateTransition2_RdB inverter_hil_DW.PortAPayloadRateTransition2_WrB inverter_hil_DW.PortAPayloadRateTransition3_Buf inverter_hil_DW.PortAPayloadRateTransition3_RdB inverter_hil_DW.PortAPayloadRateTransition3_WrB inverter_hil_DW.PortAPayloadRateTransition4_Buf inverter_hil_DW.PortAPayloadRateTransition4_RdB inverter_hil_DW.PortAPayloadRateTransition4_WrB inverter_hil_DW.PortAPayloadRateTransition5_Buf inverter_hil_DW.PortAPayloadRateTransition5_RdB inverter_hil_DW.PortAPayloadRateTransition5_WrB inverter_hil_DW.appsErrorLatch inverter_hil_DW.appsErrorLatch_not_empty inverter_hil_DW.dcLinkAccum inverter_hil_DW.dcLinkAccum_not_empty inverter_hil_DW.doneDoubleBufferReInit inverter_hil_DW.doneDoubleBufferReInit_n inverter_hil_DW.n inverter_hil_DW.n_not_empty inverter_hil_DW.rawFilt inverter_hil_DW.rawFilt_not_empty inverter_hil_DW.sfEvent inverter_hil_DW.sfEvent_m inverter_hil_DW.state_j inverter_hil_DW.state_not_empty inverter_hil_DW.ticks inverter_hil_DW.ticks_not_empty /end REF_MEASUREMENT
/end GROUP
/begin GROUP inverter_hil_Virtual_VCU_Observability "inverter_hil/Virtual VCU Observability"
 /begin REF_MEASUREMENT hil_obs_virtual_vcu_apps_brake_fault hil_obs_virtual_vcu_control_frame_1 hil_obs_virtual_vcu_inverter_control_enable hil_obs_virtual_vcu_main_enable hil_obs_virtual_vcu_pedal_payload hil_obs_virtual_vcu_pedal_tx_count hil_obs_virtual_vcu_precharge_enable hil_obs_virtual_vcu_state_id hil_obs_virtual_vcu_torque_request_nm inverter_hil_B.appsBrakeFault inverter_hil_B.count inverter_hil_B.payloads inverter_hil_B.torqueRequestNm /end REF_MEASUREMENT
/end GROUP
/end MODULE
/end PROJECT
/* (add any file trailer comments here) */
/* EOF inverter_hil.a2l*/
